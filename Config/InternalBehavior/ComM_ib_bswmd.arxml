AUTOSAR XML (schema 4-2-1)
package /MICROSAR/ComM_ib_bswmd/BswModuleDescriptions
  bsw module description ComM: provided-entrys=ComM_MainFunction_0
    bsw internal behavior ComMBehavior
      exclusive area COMM_EXCLUSIVE_AREA_0
      exclusive area COMM_EXCLUSIVE_AREA_1
      bsw schedulable entity ComM_MainFunction_0: implemented-entry=ComM_MainFunction_0
      bsw timing event ComM_MainFunction_0TimingEvent0: starts-on-event=ComM_MainFunction_0, period=0.02
  bsw module entry ComM_MainFunction_0: call-type=SCHEDULED, execution-context=TASK
