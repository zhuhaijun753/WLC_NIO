AUTOSAR XML (schema 4-2-1)
package /COM/VECTOR/CFG/WORKFLOW/SYSDESC/SYNC
  flat map FLATMAP
    69 x flat instance descriptor:
      SWC_WLCAPP: upstream-reference=EcuSwComposition.SWC_WLCAPP, ecu-extract-reference=COMPOSITIONTYPE.SWC_WLCAPP
      VehSpd: upstream-reference=EcuSwComposition.VehSpd.VehSpd, ecu-extract-reference=COMPOSITIONTYPE.VehSpd.VehSpd
      VehSpd_001: upstream-reference=EcuSwComposition.VehSpd, ecu-extract-reference=COMPOSITIONTYPE.VehSpd
      Hr: upstream-reference=EcuSwComposition.Hr.Hr, ecu-extract-reference=COMPOSITIONTYPE.Hr.Hr
      Hr_001: upstream-reference=EcuSwComposition.Hr, ecu-extract-reference=COMPOSITIONTYPE.Hr
      Mth: upstream-reference=EcuSwComposition.Mth.Mth, ecu-extract-reference=COMPOSITIONTYPE.Mth.Mth
      Mth_001: upstream-reference=EcuSwComposition.Mth, ecu-extract-reference=COMPOSITIONTYPE.Mth
      ComfEna: upstream-reference=EcuSwComposition.ComfEna.ComfEna, ecu-extract-reference=COMPOSITIONTYPE.ComfEna.ComfEna
      ComfEna_001: upstream-reference=EcuSwComposition.ComfEna, ecu-extract-reference=COMPOSITIONTYPE.ComfEna
      VehState: upstream-reference=EcuSwComposition.VehState.VehState, ecu-extract-reference=COMPOSITIONTYPE.VehState.VehState
      VehState_001: upstream-reference=EcuSwComposition.VehState, ecu-extract-reference=COMPOSITIONTYPE.VehState
      Yr: upstream-reference=EcuSwComposition.Yr.Yr, ecu-extract-reference=COMPOSITIONTYPE.Yr.Yr
      Yr_001: upstream-reference=EcuSwComposition.Yr, ecu-extract-reference=COMPOSITIONTYPE.Yr
      CGW_03_CRC: upstream-reference=EcuSwComposition.CGW_03_CRC.CGW_03_CRC, ecu-extract-reference=COMPOSITIONTYPE.CGW_03_CRC.CGW_03_CRC
      CGW_03_CRC_001: upstream-reference=EcuSwComposition.CGW_03_CRC, ecu-extract-reference=COMPOSITIONTYPE.CGW_03_CRC
      WLCChrgFctEnaReq: upstream-reference=EcuSwComposition.WLCChrgFctEnaReq.WLCChrgFctEnaReq, ecu-extract-reference=COMPOSITIONTYPE.WLCChrgFctEnaReq.WLCChrgFctEnaReq
      WLCChrgFctEnaReq_001: upstream-reference=EcuSwComposition.WLCChrgFctEnaReq, ecu-extract-reference=COMPOSITIONTYPE.WLCChrgFctEnaReq
      Day: upstream-reference=EcuSwComposition.Day.Day, ecu-extract-reference=COMPOSITIONTYPE.Day.Day
      Day_001: upstream-reference=EcuSwComposition.Day, ecu-extract-reference=COMPOSITIONTYPE.Day
      CGW_03_MsgCntr: upstream-reference=EcuSwComposition.CGW_03_MsgCntr.CGW_03_MsgCntr, ecu-extract-reference=COMPOSITIONTYPE.CGW_03_MsgCntr.CGW_03_MsgCntr
      CGW_03_MsgCntr_001: upstream-reference=EcuSwComposition.CGW_03_MsgCntr, ecu-extract-reference=COMPOSITIONTYPE.CGW_03_MsgCntr
      Sec: upstream-reference=EcuSwComposition.Sec.Sec, ecu-extract-reference=COMPOSITIONTYPE.Sec.Sec
      Sec_001: upstream-reference=EcuSwComposition.Sec, ecu-extract-reference=COMPOSITIONTYPE.Sec
      VehOdometer: upstream-reference=EcuSwComposition.VehOdometer.VehOdometer, ecu-extract-reference=COMPOSITIONTYPE.VehOdometer.VehOdometer
      VehOdometer_001: upstream-reference=EcuSwComposition.VehOdometer, ecu-extract-reference=COMPOSITIONTYPE.VehOdometer
      Min: upstream-reference=EcuSwComposition.Min.Min, ecu-extract-reference=COMPOSITIONTYPE.Min.Min
      Min_001: upstream-reference=EcuSwComposition.Min, ecu-extract-reference=COMPOSITIONTYPE.Min
      VehState_ASIL: upstream-reference=EcuSwComposition.VehState_ASIL.VehState_ASIL, ecu-extract-reference=COMPOSITIONTYPE.VehState_ASIL.VehState_ASIL
      VehState_ASIL_001: upstream-reference=EcuSwComposition.VehState_ASIL, ecu-extract-reference=COMPOSITIONTYPE.VehState_ASIL
      ComfEna_ASIL: upstream-reference=EcuSwComposition.ComfEna_ASIL.ComfEna_ASIL, ecu-extract-reference=COMPOSITIONTYPE.ComfEna_ASIL.ComfEna_ASIL
      ComfEna_ASIL_001: upstream-reference=EcuSwComposition.ComfEna_ASIL, ecu-extract-reference=COMPOSITIONTYPE.ComfEna_ASIL
      ImobEnaReq: upstream-reference=EcuSwComposition.ImobEnaReq.ImobEnaReq, ecu-extract-reference=COMPOSITIONTYPE.ImobEnaReq.ImobEnaReq
      ImobEnaReq_001: upstream-reference=EcuSwComposition.ImobEnaReq, ecu-extract-reference=COMPOSITIONTYPE.ImobEnaReq
      CGW_WLC_MsgCntr: upstream-reference=EcuSwComposition.CGW_WLC_MsgCntr.CGW_WLC_MsgCntr, ecu-extract-reference=COMPOSITIONTYPE.CGW_WLC_MsgCntr.CGW_WLC_MsgCntr
      CGW_WLC_MsgCntr_001: upstream-reference=EcuSwComposition.CGW_WLC_MsgCntr, ecu-extract-reference=COMPOSITIONTYPE.CGW_WLC_MsgCntr
      CGW_WLC_CRC: upstream-reference=EcuSwComposition.CGW_WLC_CRC.CGW_WLC_CRC, ecu-extract-reference=COMPOSITIONTYPE.CGW_WLC_CRC.CGW_WLC_CRC
      CGW_WLC_CRC_001: upstream-reference=EcuSwComposition.CGW_WLC_CRC, ecu-extract-reference=COMPOSITIONTYPE.CGW_WLC_CRC
      Communication_Read_APP: upstream-reference=EcuSwComposition.Communication_Read_APP, ecu-extract-reference=COMPOSITIONTYPE.Communication_Read_APP
      WLCImobSts: upstream-reference=EcuSwComposition.WLCImobSts.WLCImobSts, ecu-extract-reference=COMPOSITIONTYPE.WLCImobSts.WLCImobSts
      WLCImobSts_001: upstream-reference=EcuSwComposition.WLCImobSts, ecu-extract-reference=COMPOSITIONTYPE.WLCImobSts
      UsrData0_WLC: upstream-reference=EcuSwComposition.UsrData0_WLC.UsrData0_WLC, ecu-extract-reference=COMPOSITIONTYPE.UsrData0_WLC.UsrData0_WLC
      UsrData0_WLC_001: upstream-reference=EcuSwComposition.UsrData0_WLC, ecu-extract-reference=COMPOSITIONTYPE.UsrData0_WLC
      WLC_01_MsgCntr: upstream-reference=EcuSwComposition.WLC_01_MsgCntr.WLC_01_MsgCntr, ecu-extract-reference=COMPOSITIONTYPE.WLC_01_MsgCntr.WLC_01_MsgCntr
      WLC_01_MsgCntr_001: upstream-reference=EcuSwComposition.WLC_01_MsgCntr, ecu-extract-reference=COMPOSITIONTYPE.WLC_01_MsgCntr
      WLCChrgSts: upstream-reference=EcuSwComposition.WLCChrgSts.WLCChrgSts, ecu-extract-reference=COMPOSITIONTYPE.WLCChrgSts.WLCChrgSts
      WLCChrgSts_001: upstream-reference=EcuSwComposition.WLCChrgSts, ecu-extract-reference=COMPOSITIONTYPE.WLCChrgSts
      WLCCtrlSts: upstream-reference=EcuSwComposition.WLCCtrlSts.WLCCtrlSts, ecu-extract-reference=COMPOSITIONTYPE.WLCCtrlSts.WLCCtrlSts
      WLCCtrlSts_001: upstream-reference=EcuSwComposition.WLCCtrlSts, ecu-extract-reference=COMPOSITIONTYPE.WLCCtrlSts
      WLC_02_MsgCntr: upstream-reference=EcuSwComposition.WLC_02_MsgCntr.WLC_02_MsgCntr, ecu-extract-reference=COMPOSITIONTYPE.WLC_02_MsgCntr.WLC_02_MsgCntr
      WLC_02_MsgCntr_001: upstream-reference=EcuSwComposition.WLC_02_MsgCntr, ecu-extract-reference=COMPOSITIONTYPE.WLC_02_MsgCntr
      UsrData4_WLC: upstream-reference=EcuSwComposition.UsrData4_WLC.UsrData4_WLC, ecu-extract-reference=COMPOSITIONTYPE.UsrData4_WLC.UsrData4_WLC
      UsrData4_WLC_001: upstream-reference=EcuSwComposition.UsrData4_WLC, ecu-extract-reference=COMPOSITIONTYPE.UsrData4_WLC
      UsrData3_WLC: upstream-reference=EcuSwComposition.UsrData3_WLC.UsrData3_WLC, ecu-extract-reference=COMPOSITIONTYPE.UsrData3_WLC.UsrData3_WLC
      UsrData3_WLC_001: upstream-reference=EcuSwComposition.UsrData3_WLC, ecu-extract-reference=COMPOSITIONTYPE.UsrData3_WLC
      UsrData1_WLC: upstream-reference=EcuSwComposition.UsrData1_WLC.UsrData1_WLC, ecu-extract-reference=COMPOSITIONTYPE.UsrData1_WLC.UsrData1_WLC
      UsrData1_WLC_001: upstream-reference=EcuSwComposition.UsrData1_WLC, ecu-extract-reference=COMPOSITIONTYPE.UsrData1_WLC
      WLCFailSts: upstream-reference=EcuSwComposition.WLCFailSts.WLCFailSts, ecu-extract-reference=COMPOSITIONTYPE.WLCFailSts.WLCFailSts
      WLCFailSts_001: upstream-reference=EcuSwComposition.WLCFailSts, ecu-extract-reference=COMPOSITIONTYPE.WLCFailSts
      WLC_01_CRC: upstream-reference=EcuSwComposition.WLC_01_CRC.WLC_01_CRC, ecu-extract-reference=COMPOSITIONTYPE.WLC_01_CRC.WLC_01_CRC
      WLC_01_CRC_001: upstream-reference=EcuSwComposition.WLC_01_CRC, ecu-extract-reference=COMPOSITIONTYPE.WLC_01_CRC
      WLCMuteViaHW: upstream-reference=EcuSwComposition.WLCMuteViaHW.WLCMuteViaHW, ecu-extract-reference=COMPOSITIONTYPE.WLCMuteViaHW.WLCMuteViaHW
      WLCMuteViaHW_001: upstream-reference=EcuSwComposition.WLCMuteViaHW, ecu-extract-reference=COMPOSITIONTYPE.WLCMuteViaHW
      UsrData2_WLC: upstream-reference=EcuSwComposition.UsrData2_WLC.UsrData2_WLC, ecu-extract-reference=COMPOSITIONTYPE.UsrData2_WLC.UsrData2_WLC
      UsrData2_WLC_001: upstream-reference=EcuSwComposition.UsrData2_WLC, ecu-extract-reference=COMPOSITIONTYPE.UsrData2_WLC
      UsrData5_WLC: upstream-reference=EcuSwComposition.UsrData5_WLC.UsrData5_WLC, ecu-extract-reference=COMPOSITIONTYPE.UsrData5_WLC.UsrData5_WLC
      UsrData5_WLC_001: upstream-reference=EcuSwComposition.UsrData5_WLC, ecu-extract-reference=COMPOSITIONTYPE.UsrData5_WLC
      WLCChrgRate: upstream-reference=EcuSwComposition.WLCChrgRate.WLCChrgRate, ecu-extract-reference=COMPOSITIONTYPE.WLCChrgRate.WLCChrgRate
      WLCChrgRate_001: upstream-reference=EcuSwComposition.WLCChrgRate, ecu-extract-reference=COMPOSITIONTYPE.WLCChrgRate
      WLC_02_CRC: upstream-reference=EcuSwComposition.WLC_02_CRC, ecu-extract-reference=COMPOSITIONTYPE.WLC_02_CRC
