AUTOSAR XML (schema 00044)
package /ComponentTypes
  application sw component type SWC_BTandWifiPar
    behavior SWC_BTandWifiPar_InternalBehavior
  swc implementation SWC_BTandWifiPar_Implementation: behavior=SWC_BTandWifiPar_InternalBehavior
