AUTOSAR XML (schema 00044)
standard types defined: boolean, uint16, uint32, uint8
package /Predefined_DEV/ImplementationDataTypes
  impl type NvM_RequestResultType: compu {0=NVM_REQ_OK, 1=NVM_REQ_NOT_OK, 2=NVM_REQ_PENDING, 3=NVM_REQ_INTEGRITY_FAILED, 4=NVM_REQ_BLOCK_SKIPPED, 5=NVM_REQ_NV_INVALIDATED, 6=NVM_REQ_CANCELED, 7=NVM_REQ_REDUNDANCY_FAILED, 8=NVM_REQ_RESTORED_FROM_ROM}, implementation-data-type=uint8
  impl type NvM_ServiceIdType: compu {6=NVM_READ_BLOCK, 7=NVM_WRITE_BLOCK, 8=NVM_RESTORE_BLOCK_DEFAULTS, 9=NVM_ERASE_BLOCK, 11=NVM_INVALIDATE_NV_BLOCK, 12=NVM_READ_ALL}, implementation-data-type=uint8
  impl type Dem_UdsStatusByteType: compu {mask 1: 1=DEM_UDS_STATUS_TF, mask 2: 2=DEM_UDS_STATUS_TFTOC, mask 4: 4=DEM_UDS_STATUS_PDTC, mask 8: 8=DEM_UDS_STATUS_CDTC, mask 16: 16=DEM_UDS_STATUS_TNCSLC, mask 32: 32=DEM_UDS_STATUS_TFSLC, mask 64: 64=DEM_UDS_STATUS_TNCTOC, mask 128: 128=DEM_UDS_STATUS_WIR}, range raw 0..255, implementation-data-type=uint8
package /DataType/Semantics
  compu method CM_CGW_03_CRC: identical
  compu method CM_CGW_03_MsgCntr: identical
  compu method CM_CGW_WLC_CRC: identical
  compu method CM_CGW_WLC_MsgCntr: identical
  compu method CM_Day: identical
  compu method CM_Hr: identical
  compu method CM_Min: identical
  compu method CM_Sec: identical
  compu method CM_UsrData{0..5}_WLC: identical
  compu method CM_VehOdometer: identical
  compu method CM_WLC_01_CRC: identical
  compu method CM_WLC_01_MsgCntr: identical
  compu method CM_WLC_02_CRC: identical
  compu method CM_WLC_02_MsgCntr: identical
  compu method CM_VehSpd: phys=raw*0.05625 for raw 0..6400; unit km/h
  compu method CM_Yr: phys=raw+2000 for raw 0..254; unit Year
package /DataType/Unit
  7 x unit:
    U_Day: display-name=Day
    U_Hour: display-name=Hour
    U_km: display-name=km
    U_kmYh: display-name=km/h
    U_min: display-name=min
    U_Sec: display-name=Sec
    U_Year: display-name=Year
package /DataTypes
  34 x impl type, all with category=VALUE:
    VehSpd: base-type=uint16, range raw 0..8191
    Hr: base-type=uint8, range raw 0..23
    Mth: base-type=uint8, compu {0=Cx0_Unknown, 1=Cx1_January, 2=Cx2_February, 3=Cx3_March, 4=Cx4_April, 5=Cx5_May, 6=Cx6_June, 7=Cx7_July, 8=Cx8_August, 9=Cx9_September, 10=CxA_October, 11=CxB_November, 12=CxC_December, 13=CxD_Reserved, 14=CxE_Reserved, 15=CxF_Invalid}, range raw 0..15
    ComfEna: base-type=uint8, compu {0=Cx0_Comfort_not_enabled (Comfort not enabled), 1=Cx1_Comfort_enabled (Comfort enabled), 2=Cx2_Reserved, 3=Cx3_Invalid}, range raw 0..3
    VehState: base-type=uint8, compu {0=Cx0_Parked_vehicle_Off_ (Parked vehicle(Off)), 1=Cx1_Driver_present_On_ (Driver present(On)), 2=Cx2_Driving, 3=Cx3_Software_update (Software update), 4=Cx4_Reserved, 5=Cx5_Reserved, 6=Cx6_Reserved, 7=Cx7_Reserved, 8=Cx8_Reserved, 9=Cx9_Reserved, 10=CxA_Reserved, 11=CxB_Reserved, 12=CxC_Reserved, 13=CxD_Reserved, 14=CxE_Reserved, 15=CxF_Invalid}, range raw 0..15
    Yr: base-type=uint8
    CGW_03_CRC: base-type=uint8, range raw 0..255
    WLCChrgFctEnaReq: base-type=uint8, compu {0=Cx0_Disable_WLC_charging_function (Disable WLC charging function), 1=Cx1_Enable_WLC_charging_function (Enable WLC charging function), 2=Cx2_No_operation (No operation), 3=Cx3_Invalid}, range raw 0..3
    Day: base-type=uint8, range raw 0..31
    CGW_03_MsgCntr: base-type=uint8, range raw 0..15
    Sec: base-type=uint8, range raw 0..59
    VehOdometer: base-type=uint32, range raw 0..16777214
    Min: base-type=uint8, range raw 0..59
    VehState_ASIL: base-type=uint8, compu {0=Cx0_Parked_vehicle_Off_ (Parked vehicle(Off)), 1=Cx1_Driver_present_On_ (Driver present(On)), 2=Cx2_Driving, 3=Cx3_Software_update (Software update), 4=Cx4_Reserved, 5=Cx5_Reserved, 6=Cx6_Reserved, 7=Cx7_Reserved, 8=Cx8_Reserved, 9=Cx9_Reserved, 10=CxA_Reserved, 11=CxB_Reserved, 12=CxC_Reserved, 13=CxD_Reserved, 14=CxE_Reserved, 15=CxF_Invalid}, range raw 0..15
    ComfEna_ASIL: base-type=uint8, compu {0=Cx0_Comfort_not_enabled (Comfort not enabled), 1=Cx1_Comfort_enabled (Comfort enabled), 2=Cx2_Reserved, 3=Cx3_Invalid}, range raw 0..3
    ImobEnaReq: base-type=uint8, compu {0=Cx0_Disable, 1=Cx1_Enable_AID1 (Enable AID1), 2=Cx2_Enable_AID2 (Enable AID2), 3=Cx3_Invalid}, range raw 0..3
    CGW_WLC_MsgCntr: base-type=uint8, range raw 0..15
    CGW_WLC_CRC: base-type=uint8, range raw 0..255
    WLC_02_CRC: base-type=uint8, range raw 0..255
    WLCImobSts: base-type=uint8, compu {0=Cx0_Disable, 1=Cx1_Enable, 2=Cx2_Reserved, 3=Cx3_Invalid}, range raw 0..3
    UsrData0_WLC: base-type=uint8, range raw 0..255
    WLC_01_MsgCntr: base-type=uint8, range raw 0..15
    WLCChrgSts: base-type=uint8, compu {0=Cx0_WLC_stopped (WLC stopped), 1=Cx1_WLC_on_going (WLC on going), 2=Cx2_Charge_complete (Charge complete), 3=Cx3_Invalid}, range raw 0..3
    WLCCtrlSts: base-type=uint8, compu {0=Cx0_WLC_enabled (WLC enabled), 1=Cx1_WLC_disabled (WLC disabled), 2=Cx2_Reserved, 3=Cx3_Invalid}, range raw 0..3
    WLC_02_MsgCntr: base-type=uint8, range raw 0..15
    UsrData4_WLC: base-type=uint8, range raw 0..255
    UsrData3_WLC: base-type=uint8, range raw 0..255
    UsrData1_WLC: base-type=uint8, range raw 0..255
    WLCFailSts:
      base-type=uint8
      compu {0=Cx0_No_failure (No failure), 1=Cx1_Over_temperature (Over temperature), 2=Cx2_Under_voltage (Under voltage), 3=Cx3_Over_voltage (Over voltage), 4=Cx4_Internal_error (Internal error), 5=Cx5_Foreign_object_existing (Foreign object existing), 6=Cx6_Unknown_error (Unknown error), 7=Cx7_Smartphone_no_response_or_error (Smartphone no response or error), 8=Cx8_Conductive_Device_Detected (Conductive Device Detected), 9=Cx9_Reserved, 10=CxA_Reserved, 11=CxB_Reserved, 12=CxC_Reserved, 13=CxD_Reserved, 14=CxE_Reserved, 15=CxF_Invalid}
      range raw 0..15
    WLC_01_CRC: base-type=uint8, range raw 0..255
    WLCMuteViaHW: base-type=boolean, compu {0=Cx0_Active_Muted_ (Active (Muted)), 1=Cx1_Inactive_Not_muted_ (Inactive (Not muted))}
    UsrData2_WLC: base-type=uint8, range raw 0..255
    UsrData5_WLC: base-type=uint8, range raw 0..255
    WLCChrgRate: base-type=uint8, compu {0=Cx0_Not_started_ (Not started), 1=Cx1_Power_Requested_ (Power Requested), 2=Cx2_Power_Reduced_ (Power Reduced), 3=Cx3_Reserved}, range raw 0..3
