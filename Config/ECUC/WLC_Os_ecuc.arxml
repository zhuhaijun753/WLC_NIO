AUTOSAR XML (schema 4-2-1)
package /ActiveEcuC
  module config Os: implementation-config-variant=VARIANT-PRE-COMPILE, module-description=Os_Impl
    OsPublishedInformation: OsKernelVersion=7, OsPlatformName=Rh850
      RH850F1KM (OsDerivativeInformation):
        OsMpuAlignment = 4
        OsStackAlignment = 4
        OsExceptionVectorTableAlignment = 512
        OsInterruptVectorTableAlignment = 512
        OsHardwareManuals = RH850/F1KM Group Users Manual: Hardware Rev.0.50 Jan 2017 RH850G3KH Users Manual: Software Rev.1.10 Jul 2016
        3 x OsHardwareTimer, all with OsHardwareTimerUnit=PIT, OsHardwareTimerSize=32, OsHardwareTimerType=TAUJ:
          TAUJ0: OsHardwareTimerBaseAddress=4293197824, OsHardwareTimerId=0
            4 x OsHardwareTimerChannel:
              TAUJ0_CH3: OsHardwareTimerChannelIntSource=83, OsHardwareTimerChannelOffset=3, OsHardwareTimerChannelId=3
              TAUJ0_CH2: OsHardwareTimerChannelIntSource=82, OsHardwareTimerChannelOffset=2, OsHardwareTimerChannelId=2
              TAUJ0_CH1: OsHardwareTimerChannelIntSource=81, OsHardwareTimerChannelOffset=1, OsHardwareTimerChannelId=1
              TAUJ0_CH0: OsHardwareTimerChannelIntSource=80, OsHardwareTimerChannelOffset=0, OsHardwareTimerChannelId=0
          TAUJ1: OsHardwareTimerBaseAddress=4293201920, OsHardwareTimerId=1
            4 x OsHardwareTimerChannel:
              TAUJ1_CH3: OsHardwareTimerChannelIntSource=171, OsHardwareTimerChannelOffset=3, OsHardwareTimerChannelId=3
              TAUJ1_CH0: OsHardwareTimerChannelIntSource=168, OsHardwareTimerChannelOffset=0, OsHardwareTimerChannelId=0
              TAUJ1_CH2: OsHardwareTimerChannelIntSource=170, OsHardwareTimerChannelOffset=2, OsHardwareTimerChannelId=2
              TAUJ1_CH1: OsHardwareTimerChannelIntSource=169, OsHardwareTimerChannelOffset=1, OsHardwareTimerChannelId=1
          TAUJ2: OsHardwareTimerBaseAddress=4293198080, OsHardwareTimerId=2
            4 x OsHardwareTimerChannel:
              TAUJ2_CH1: OsHardwareTimerChannelIntSource=278, OsHardwareTimerChannelOffset=1, OsHardwareTimerChannelId=1
              TAUJ2_CH0: OsHardwareTimerChannelIntSource=277, OsHardwareTimerChannelOffset=0, OsHardwareTimerChannelId=0
              TAUJ2_CH3: OsHardwareTimerChannelIntSource=280, OsHardwareTimerChannelOffset=3, OsHardwareTimerChannelId=3
              TAUJ2_CH2: OsHardwareTimerChannelIntSource=279, OsHardwareTimerChannelOffset=2, OsHardwareTimerChannelId=2
        CORE0 (OsPhysicalCore):
          OsPhysicalCoreId = 0
          OsPhysicalCoreDefaultEntrySymbol = RESET_CORE0
          OsPhysicalCoreType = G3KH
          OsPhysicalCoreExceptionSources = 16
          OsPhysicalCoreIsAutostart = true
          OsPhysicalCoreMasterStartAllowed = false
          OsPhysicalCorePrivelegedHwAccess = true
          OsPhysicalCoreStackProtectionUnit = MPU_CORE0
          MPU_CORE0 (OsPhysicalCoreMpu): OsPhysicalCoreMpuId=0, OsPhysicalCoreMpuMaxRegions=16, OsPhysicalCoreMpuType=CORE_MPU_G3X
        INTC (OsSystemIntCtrl): OsSystemIntCtrlBaseAddress=4294896128, OsSystemIntCtrlMaxPrios=16, OsSystemIntCtrlMaxSources=512, OsSystemIntCtrlPrioOrder=DESC
          5 x OsSystemIntCtrlAddress:
            IPIR: OsSystemIntCtrlAddressValue=0
            INTC2: OsSystemIntCtrlAddressValue=4294946816
            EIBD1: OsSystemIntCtrlAddressValue=0
            INTC1: OsSystemIntCtrlAddressValue=4294896128
            EIBD2: OsSystemIntCtrlAddressValue=0
        TAUJ3 (OsHardwareTimer): OsHardwareTimerBaseAddress=4293202176, OsHardwareTimerUnit=PIT, OsHardwareTimerSize=32, OsHardwareTimerId=3, OsHardwareTimerType=TAUJ
          4 x OsHardwareTimerChannel:
            TAUJ3_CH0: OsHardwareTimerChannelIntSource=281, OsHardwareTimerChannelOffset=0, OsHardwareTimerChannelId=0
            TAUJ3_CH2: OsHardwareTimerChannelIntSource=283, OsHardwareTimerChannelOffset=2, OsHardwareTimerChannelId=2
            TAUJ3_CH1: OsHardwareTimerChannelIntSource=282, OsHardwareTimerChannelOffset=1, OsHardwareTimerChannelId=1
            TAUJ3_CH3: OsHardwareTimerChannelIntSource=284, OsHardwareTimerChannelOffset=3, OsHardwareTimerChannelId=3
        OSTM0 (OsHardwareTimer): OsHardwareTimerBaseAddress=4292280320, OsHardwareTimerUnit=FRTPIT, OsHardwareTimerSize=32, OsHardwareTimerId=0, OsHardwareTimerType=OSTM
          OSTM0 (OsHardwareTimerChannel): OsHardwareTimerChannelIntSource=84, OsHardwareTimerChannelOffset=0, OsHardwareTimerChannelId=0
        DEFAULT (OsInterruptSupportedType): OsInterruptSupportedTypeSeparateSources=false, OsInterruptSupportedTypeSeparatePriority=false
        MPAT (OsMemoryRegionSpecifics)
          6 x OsMemoryRegionAccess:
            SW: OsMemoryRegionAccessRights=W, OsMemoryRegionAccessType=SUPERVISOR
            SX: OsMemoryRegionAccessRights=X, OsMemoryRegionAccessType=SUPERVISOR
            UW: OsMemoryRegionAccessRights=W, OsMemoryRegionAccessType=USER
            UX: OsMemoryRegionAccessRights=X, OsMemoryRegionAccessType=USER
            UR: OsMemoryRegionAccessRights=R, OsMemoryRegionAccessType=USER
            SR: OsMemoryRegionAccessRights=R, OsMemoryRegionAccessType=SUPERVISOR
    OS_APPMODE_ANY (OsAppMode)
    OSDEFAULTAPPMODE (OsAppMode)
    OsOS:
      OsStackMonitoring = true
      OsStatus = EXTENDED
      OsUseGetServiceId = false
      OsUseParameterAccess = false
      OsUseResScheduler = false
      OsForcibleTermination = false
      OsGenerateCalloutStubs = true
      OsGenerateMemMap = COMPLETE
      OsGenerateMemMapForNearAddressing = true
      OsGenerateMemMapForThreads = false
      OsServiceProtection = false
      OsStackUsageMeasurement = false
      OsUseXSignalAsyncApiCalls = false
      OsFpuUsage = NONE
      OsScalabilityClass = SC1
      OsNumberOfCores = 1
      OsMasterCore = OsCore0
      OsSystemTimer = SystemTimer
      OsStackSummary
        8 x OsStack, all with OsStackSize=1024, OsStackCore=OsCore0:
          OsCore0_Error: OsStackType=CORE_ERROR_STACK, OsStackUser=OsCore0
          OsCore0_Init: OsStackType=CORE_INIT_STACK, OsStackUser=OsCore0
          OsCore0_Kernel: OsStackType=CORE_KERNEL_STACK, OsStackUser=OsCore0
          OsCore0_Isr_Core: OsStackType=ISR_SHARED_CORE_STACK, OsStackUser=CanIsrTx_0, OsStackUser=CanIsrGlobalStatus, OsStackUser=CanIsrRxFifo, OsStackUser=CanIsrStatus_0, OsStackUser=CounterIsr_SystemTimer
          OsCore0_Task_Prio4294967295: OsStackType=TASK_SHARED_PRIORITY_STACK, OsStackUser=IdleTask_OsCore0
          OsTask_BSW_SCHM: OsStackType=TASK_SHARED_PRIORITY_STACK, OsStackUser=Os/OsTask_BSW_SCHM
          OsCore0_Task_Prio0: OsStackType=TASK_SHARED_PRIORITY_STACK, OsStackUser=OsTask
          OsTask_APP: OsStackType=TASK_SHARED_PRIORITY_STACK, OsStackUser=Os/OsTask_APP
      OsHooks: OsErrorHook=true, OsPostTaskHook=false, OsPreTaskHook=false, OsShutdownHook=false, OsStartupHook=false
    SystemTimer (OsCounter):
      OsCounterMaxAllowedValue = 2147483647
      OsCounterMinCycle = 1
      OsCounterType = HARDWARE
      OsSecondsPerTick = 0.001
      OsCounterTicksPerBase = 1
      OsCounterAccessingApplication = SystemApplication_OsCore0
      OsDriver: OsDriverHighResolution=false, OsDriverHardwareTimerChannelRef=OSTM0/OSTM0, OsDriverIsrRef=CounterIsr_SystemTimer
    4 x OsIsr, all with OsIsrCategory=CATEGORY_2, OsIsrInterruptType=EXTERNAL, OsIsrInterruptPriority=0, OsIsrStackSize=1024, OsIsrEnableNesting=false, OsIsrUsesFpu=false, OsIsrInitialEnableInterruptSource=true, OsIsrInterruptMapping=DEFAULT:
      CanIsrTx_0: OsIsrInterruptSource=4  # /ActiveEcuC/Can PLAIN_TEXT Can TX message event of controller CT_NIO_ES6_RF_CAN_SR_V3_0_a63ca593. This OsIsr container has been created automatically based on the Can driver configuration.
      CanIsrGlobalStatus: OsIsrInterruptSource=1  # /ActiveEcuC/Can PLAIN_TEXT Global Can RX BasicCAN overrun event. This OsIsr container has been created automatically based on the Can driver configuration.
      CanIsrRxFifo: OsIsrInterruptSource=2  # /ActiveEcuC/Can PLAIN_TEXT Global Can RX BasicCAN message received event. This OsIsr container has been created automatically based on the Can driver configuration.
      CanIsrStatus_0: OsIsrInterruptSource=3  # /ActiveEcuC/Can PLAIN_TEXT Can busoff event of controller CT_NIO_ES6_RF_CAN_SR_V3_0_a63ca593. This OsIsr container has been created automatically based on the Can driver configuration.
    OsCore0 (OsCore):
      OsCoreIsAutostart = true
      OsCoreIsAutosar = true
      OsCoreEntrySymbol = RESET_CORE0
      OsCorePhysicalCoreRef = CORE0
      OsCoreEcucCoreRef = EcucCoreDefinition
      OsCoreIdleTask = IdleTask_OsCore0
      OsCoreSystemApplication = SystemApplication_OsCore0
      OsCoreStacks:
        OsCoreKernelStackSize = 1024
        OsCoreStartupStackSize = 1024
        OsCoreShutdownStackSize = 1024
        OsCoreErrorStackSize = 1024
        OsCoreProtectionStackSize = 1024
        OsCoreInitStackSize = 1024
    IdleTask_OsCore0 (OsTask):
      OsTaskActivation = 1
      OsTaskPriority = 4294967295
      OsTaskSchedule = FULL
      OsTaskStackSharing = false
      OsTaskStackSize = 1024
      OsTaskType = AUTO
      OsTaskUsesFpu = false
      OsTaskAccessingApplication = SystemApplication_OsCore0
      OsTaskAutostart: OsTaskAppModeRef=OS_APPMODE_ANY
    SystemApplication_OsCore0 (OsApplication):
      OsTrusted = true
      OsTrustedApplicationDelayTimingViolationCall = false
      OsTrustedApplicationWithProtection = false
      OsApplicationIsPrivileged = true
      OsAppUseTrustedFunctionStubs = false
      OsApplicationCoreRef = EcucCoreDefinition
      OsAppIsrRef = CanIsrGlobalStatus
      OsAppIsrRef = CanIsrRxFifo
      OsAppCounterRef = SystemTimer
      OsAppIsrRef = CanIsrStatus_0
      OsAppIsrRef = CanIsrTx_0
      OsAppTaskRef = IdleTask_OsCore0
      OsAppIsrRef = CounterIsr_SystemTimer
      OsAppTaskRef = Os/OsTask_BSW_SCHM
      OsAppTaskRef = OsTask
      OsAppAlarmRef = Rte_Al_TE2_OsTask_BSW_SCHM_0_10ms
      OsAppAlarmRef = Rte_Al_TE2_OsTask_BSW_SCHM_0_20ms
      OsAppAlarmRef = Rte_Al_TE_CanTp_CanTp_MainFunction
      OsAppTaskRef = Os/OsTask_APP
      OsAppAlarmRef = Rte_Al_TE_Communication_Read_APP_ComReadandWrite_Runnable
      OsAppAlarmRef = Rte_Al_TE_SWC_WLCAPP_WLC_Runnable
      OsApplicationHooks: OsAppErrorHook=false, OsAppShutdownHook=false, OsAppStartupHook=false
    CounterIsr_SystemTimer (OsIsr):
      OsIsrCategory = CATEGORY_2
      OsIsrInterruptType = EXTERNAL
      OsIsrInterruptSource = 84
      OsIsrInterruptPriority = 0
      OsIsrStackSize = 1024
      OsIsrEnableNesting = false
      OsIsrUsesFpu = false
      OsIsrInitialEnableInterruptSource = false
      OsIsrSpecialFunctionName = Os_TimerPitIsr
      OsIsrInterruptMapping = DEFAULT
    OsResource: OsResourceProperty=STANDARD, OsResourceAccessingApplication=SystemApplication_OsCore0
    OsTask_BSW_SCHM (OsTask):
      OsTaskActivation = 1
      OsTaskPriority = 0
      OsTaskSchedule = FULL
      OsTaskStackSharing = false
      OsTaskStackSize = 1024
      OsTaskType = AUTO
      OsTaskUsesFpu = false
      OsTaskAccessingApplication = SystemApplication_OsCore0
      OsTaskResourceRef = OsResource
      OsTaskEventRef = Rte_Ev_Cyclic2_OsTask_BSW_SCHM_0_10ms
      OsTaskEventRef = Rte_Ev_Cyclic2_OsTask_BSW_SCHM_0_20ms
      OsTaskEventRef = Rte_Ev_Run_CanTp_CanTp_MainFunction
    OsTask:
      OsTaskActivation = 1
      OsTaskPriority = 0
      OsTaskSchedule = FULL
      OsTaskStackSharing = false
      OsTaskStackSize = 1024
      OsTaskType = AUTO
      OsTaskUsesFpu = false
      OsTaskAccessingApplication = SystemApplication_OsCore0
    3 x OsAlarm, all with OsAlarmCounterRef=SystemTimer, OsAlarmAccessingApplication=SystemApplication_OsCore0:
      Rte_Al_TE2_OsTask_BSW_SCHM_0_10ms
        OsAlarmAction
          OsAlarmSetEvent: OsAlarmSetEventRef=Rte_Ev_Cyclic2_OsTask_BSW_SCHM_0_10ms, OsAlarmSetEventTaskRef=Os/OsTask_BSW_SCHM
      Rte_Al_TE2_OsTask_BSW_SCHM_0_20ms
        OsAlarmAction
          OsAlarmSetEvent: OsAlarmSetEventRef=Rte_Ev_Cyclic2_OsTask_BSW_SCHM_0_20ms, OsAlarmSetEventTaskRef=Os/OsTask_BSW_SCHM
      Rte_Al_TE_CanTp_CanTp_MainFunction
        OsAlarmAction
          OsAlarmSetEvent: OsAlarmSetEventRef=Rte_Ev_Run_CanTp_CanTp_MainFunction, OsAlarmSetEventTaskRef=Os/OsTask_BSW_SCHM
    3 x OsEvent:
      Rte_Ev_Cyclic2_OsTask_BSW_SCHM_0_10ms
      Rte_Ev_Cyclic2_OsTask_BSW_SCHM_0_20ms
      Rte_Ev_Run_CanTp_CanTp_MainFunction
    OsTask_APP (OsTask):
      OsTaskActivation = 1
      OsTaskPriority = 10
      OsTaskSchedule = NON
      OsTaskStackSharing = false
      OsTaskStackSize = 1024
      OsTaskType = AUTO
      OsTaskUsesFpu = false
      OsTaskAccessingApplication = SystemApplication_OsCore0
      OsTaskEventRef = Rte_Ev_Run_Communication_Read_APP_ComReadandWrite_Runnable
      OsTaskEventRef = Rte_Ev_Run_SWC_WLCAPP_WLC_Runnable
    Rte_Al_TE_Communication_Read_APP_ComReadandWrite_Runnable (OsAlarm): OsAlarmCounterRef=SystemTimer, OsAlarmAccessingApplication=SystemApplication_OsCore0
      OsAlarmAction
        OsAlarmSetEvent: OsAlarmSetEventRef=Rte_Ev_Run_Communication_Read_APP_ComReadandWrite_Runnable, OsAlarmSetEventTaskRef=Os/OsTask_APP
    Rte_Ev_Run_Communication_Read_APP_ComReadandWrite_Runnable (OsEvent)
    Rte_Al_TE_SWC_WLCAPP_WLC_Runnable (OsAlarm): OsAlarmCounterRef=SystemTimer, OsAlarmAccessingApplication=SystemApplication_OsCore0
      OsAlarmAction
        OsAlarmSetEvent: OsAlarmSetEventRef=Rte_Ev_Run_SWC_WLCAPP_WLC_Runnable, OsAlarmSetEventTaskRef=Os/OsTask_APP
    Rte_Ev_Run_SWC_WLCAPP_WLC_Runnable (OsEvent)
