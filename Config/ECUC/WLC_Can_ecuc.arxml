AUTOSAR XML (schema 4-2-1)
package /ActiveEcuC
  module config Can: implementation-config-variant=VARIANT-PRE-COMPILE, module-description=Can_Impl
    CanGeneral:
      CanIndex = 0
      CanChangeBaudrateApi = false
      CanDevErrorDetection = true
      CanHardwareCancellation = false
      CanIdenticalIdCancellation = false
      CanMainFunctionBusoffPeriod = 0.01
      CanMainFunctionModePeriod = 0.01
      CanMainFunctionWakeupPeriod = 0.01
      CanMultiplexedTransmission = false
      CanSetBaudrateApi = false
      CanTimeoutDuration = 0.01
      CanVersionInfoApi = false
      CanGenericPrecopy = false
      CanHardwareLoopCheck = true
      CanRxFullCANSupport = false
      CanTxFullCANSupport = false
      CanRxBasicCANSupport = true
      CanUseNestedCANInterrupts = false
      CanHardwareCancelByAppl = false
      CanIndividualProcessing = false
      CanGenericConfirmation = false
      CanGenericConfirmationAPI2 = false
      CanRxQueue = false
      CanSupportMixedID = false
      CanRxQueueSize = 10
      CanMultipleBasicCANObjects = false
      CanMultipleBasicCANTxObjects = false
      CanHardwareHandleType = UINT8
      CanOptimizeOneController = true
      CanInterruptCategory = CATEGORY2
      CanGetStatus = false
      CanInterruptLock = DRIVER
      CanWakeupSupport = false
      CanRamCheck = None
      CanOverrunNotification = DET
      CanReinitStart = false
      CanGenericPreTransmit = false
      CanFdSupport = NONE
      CanRuntimeMeasurementSupport = false
      CanMaxRxDataLen = 8
      CanMaxTxDataLen = 64
      CanUsePeripheralAccessApi = false
      CanMirrorModeSupport = false
      CanUseOsInterruptControl = true
      CanSafeBswChecks = false
      CanSilentModeSupport = false
      CanHwTxFifoSupport = false
      CanCheckWakeupCanRetType = false
      CanFdHardwareBufferOptimization = true
      CanNumberOfChannels = 8
      CanNumberOfRules = 1024
      CanNumberOfPoolbuffers = 1024
      CanNumberOfRxBuffers = 128
      CanNumberOfRxFifos = 8
      CanNumberOfTxFifos = 3
      CanNumberOfTxBuffers = 32
      CanBaseAddress = 4291821568
      CanIntcRxFifoBaseAddress = 4294896174
      CanIntcGlobalErrorBaseAddress = 4294896172
      CanExternalClockSource = false
      CanCanInterface = RSCAN_FD_V3
      CanCounterRef = SystemTimer
      CanMainFunctionRWPeriods
    CanConfigSet
      CN_NIO_ES6_RF_CAN_SR_V3_0_91fc07e0_Rx (CanHardwareObject):
        CanHandleType = BASIC
        CanIdType = STANDARD
        CanIdValue = 0
        CanObjectType = RECEIVE
        CanObjectId = 1
        CanHwProcessing = false
        CanObjectHwSize = 4
        CanObjectHwHandle = 0
        CanMaxDataLen = 8
        CanFdPaddingValue = 0
        CanObjectMultiplexedTransmission = false
        CanObjectHwFifo = false
        CanControllerRef = CT_NIO_ES6_RF_CAN_SR_V3_0_a63ca593
        CanFilterMaskRef = CanFilterMask
      CN_NIO_ES6_RF_CAN_SR_V3_0_d2612a1f_Tx (CanHardwareObject):
        CanHandleType = BASIC
        CanIdValue = 0
        CanObjectType = TRANSMIT
        CanIdType = STANDARD
        CanObjectId = 0
        CanHwProcessing = false
        CanObjectHwSize = 1
        CanObjectHwHandle = 0
        CanMaxDataLen = 64
        CanFdPaddingValue = 0
        CanObjectMultiplexedTransmission = false
        CanObjectHwFifo = false
        CanControllerRef = CT_NIO_ES6_RF_CAN_SR_V3_0_a63ca593
      CT_NIO_ES6_RF_CAN_SR_V3_0_a63ca593 (CanController):
        CanControllerActivation = true
        CanBusoffProcessing = INTERRUPT
        CanControllerBaseAddress = 4291821568
        CanControllerId = 0
        CanRxProcessing = INTERRUPT
        CanTxProcessing = INTERRUPT
        CanWakeupProcessing = INTERRUPT
        CanWakeupSupport = false
        CanWakeupSourceId = 0
        CanIntcChTxBaseAddress = 4294896180
        CanIntcChErrorBaseAddress = 4294896176
        CanIntcChWakeupBaseAddress = 4294946890
        CanPhysController = CAN0
        CanRxFullCanAllocation = 16
        CanRxBasicCanAllocation = 1
        CanRxFifoProcessCount = 255
        CanControllerDefaultBaudrate = CanControllerBaudrateConfig
        CanControllerSystemRef = CT_NIO_ES6_RF_CAN_SR_V3_0
        CanWakeupSourceRef = CN_NIO_ES6_RF_CAN_SR_V3_0_d2612a1f
        CanCpuClockRef = McuClockReferencePoint_CAN
        CanControllerBaudrateConfig:
          CanControllerBaudRate = 500
          CanControllerBaudRateConfigID = 0
          CanControllerPropSeg = 7
          CanControllerSeg1 = 4
          CanControllerSeg2 = 4
          CanControllerSyncJumpWidth = 4
          CanBaudrateClock = 40000
          CanBaudratePrescaler = 5
        CanFilterMask: CanFilterMaskValue=0, CanFilterCodeValue=0, IsLocked=false
