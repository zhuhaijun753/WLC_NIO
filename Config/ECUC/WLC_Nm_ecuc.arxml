AUTOSAR XML (schema 4-2-1)
package /ActiveEcuC
  module config Nm: implementation-config-variant=VARIANT-PRE-COMPILE, module-description=Nm_Impl
    NmGlobalConfig
      NmGlobalFeatures:
        NmComUserDataSupport = true
        NmNodeIdEnabled = true
        NmUserDataEnabled = true
        NmBusSynchronizationEnabled = false
        NmCoordinatorSyncSupport = false
        NmNodeDetectionEnabled = false
        NmStateChangeIndEnabled = true
        NmCarWakeUpRxEnabled = false
        NmComControlEnabled = true
        NmCoordinatorSupportEnabled = false
        NmPduRxIndicationEnabled = false
        NmRemoteSleepIndEnabled = false
        NmRepeatMsgIndEnabled = false
        NmMacroLayerEnabled = false
        NmRuntimeMeasurementSupport = false
        NmCoordinatorRequestChannelsInBusSleep = false
        NmCoordinatorPassiveStartUpForwarding = false
        NmStateChangeIndCallback = WLCUL_CANNM_StateChangeNotification
        NmCallbacksPrototypeHeader = Appl_Nm.h
      NmGeneration:
        NmOutOfBoundsWriteSanitizer = false
        NmOutOfBoundsReadSanitizer = false
        NmShortSymbols = false
        NmInterfacesForDeactivatedData = false
        NmReferringKeysInComments = false
      NmGlobalProperties: NmDevErrorDetect=false, NmVersionInfoApi=true, NmSafeBswChecks=false
      NmGlobalConstants
    CN_NIO_ES6_RF_CAN_SR_V3_0_d2612a1f (NmChannelConfig):
      NmChannelId = 0
      NmChannelSleepMaster = false
      NmStateReportEnabled = false
      NmSynchronizingNetwork = false
      NmPassiveModeEnabled = false
      NmComMChannelRef = CN_NIO_ES6_RF_CAN_SR_V3_0_d2612a1f
      NIO_ES6_RF_CAN_SR_V3_0_CAN_40361c2d (NmBusType)
        NmStandardBusNmConfig: NmStandardBusType=NM_BUSNM_CANNM  # NIO_ES6_RF_CAN_SR_V3_0_CAN
