AUTOSAR XML (schema 4-2-1)
package /ActiveEcuC
  module config Dcm: implementation-config-variant=VARIANT-PRE-COMPILE, module-description=Dcm_Impl
    DcmConfigSet
      DcmDsl
        DcmDslProtocol
          DcmDslProtocolRow_29812fbf (DcmDslProtocolRow):
            DcmDslProtocolEndiannessConvEnabled = false
            DcmDslProtocolID = DCM_UDS_ON_CAN
            DcmDslProtocolPreemptTimeout = 0
            DcmDslProtocolPriority = 0
            DcmSendRespPendOnTransToBoot = true
            DcmTimStrP2ServerAdjust = 0
            DcmTimStrP2StarServerAdjust = 0
            DcmDslProtocolMaximumResponseSize = 4095
            DcmDslProtocolRxBufferID = DcmDslBuffer
            DcmDslProtocolSIDTable = DcmDsdServiceTable
            DcmDslProtocolTxBufferID = DcmDslBuffer
            DcmDemClientRef = DemClient
            DcmDslConnection_18c13f27 (DcmDslConnection)
              DcmDslMainConnection: DcmDslProtocolRxTesterSourceAddr=0
                DIAG_REQ_AllECU_oNIO_ES6_RF_CAN_SR_V3_0_88b0846e_Rx_ec64cedc (DcmDslProtocolRx):
                  DcmDslProtocolRxAddrType = DCM_FUNCTIONAL_TYPE
                  DcmDslProtocolRxPduId = 0
                  DcmDslProtocolRxChannelId = 0
                  DcmDslProtocolRxComMChannelRef = CN_NIO_ES6_RF_CAN_SR_V3_0_d2612a1f
                  DcmDslProtocolRxPduRef = DIAG_REQ_AllECU_oNIO_ES6_RF_CAN_SR_V3_0_88b0846e_Rx
                DIAG_RESP_WLC_oNIO_ES6_RF_CAN_SR_V3_0_7db09b81_Tx_237b1533 (DcmDslProtocolTx): DcmDslTxConfirmationPduId=0, DcmDslProtocolTxPduRef=DIAG_RESP_WLC_oNIO_ES6_RF_CAN_SR_V3_0_7db09b81_Tx
                DIAG_REQ_WLC_oNIO_ES6_RF_CAN_SR_V3_0_499b8fdc_Rx_83001690 (DcmDslProtocolRx):
                  DcmDslProtocolRxAddrType = DCM_PHYSICAL_TYPE
                  DcmDslProtocolRxPduId = 1
                  DcmDslProtocolRxChannelId = 0
                  DcmDslProtocolRxComMChannelRef = CN_NIO_ES6_RF_CAN_SR_V3_0_d2612a1f
                  DcmDslProtocolRxPduRef = DIAG_REQ_WLC_oNIO_ES6_RF_CAN_SR_V3_0_499b8fdc_Rx
        DcmDslDiagResp: DcmDslDiagRespMaxNumRespPend=0, DcmDslDiagRespOnSecondDeclinedRequest=false, DcmDslDiagRespMaxNumOfDeclinedRequests=3
        DcmDslBuffer: DcmDslBufferSize=300
      DcmGeneral:
        DcmDevErrorDetect = false
        DcmRequestManufacturerNotificationEnabled = false
        DcmRequestSupplierNotificationEnabled = false
        DcmRespondAllRequest = true
        DcmTaskTime = 0.01
        DcmVersionInfoApi = true
        DcmDspDataDefaultEndianness = LITTLE_ENDIAN
        DcmSafeBswChecks = false
        DcmSupportedIDCalculationSuppressionEnabled = false
        DcmDtrDataProvisionViaDemEnabled = true
        DcmForeignDiagnosticRequestDetectionEnabled = false
        DcmSuppressResponseOnCanTpFuncMixedAddrRequests = false
        DcmSenderReceiverPRPortsEnabled = false
        DcmDemApiVersion = DCM_DEM_API_4_03_00
      DcmDsd
        DcmDsdServiceTable
          9 x DcmDsdService:
            ReadDtcInfo: DcmDsdSidTabServiceId=25, DcmDsdSidTabSubfuncAvail=true
              3 x DcmDsdSubService:
                RDTCEDRBDN: DcmDsdSubServiceId=6
                RDTCBSM: DcmDsdSubServiceId=2
                RNODTCBSM: DcmDsdSubServiceId=1
            ClearDiagInfo: DcmDsdSidTabServiceId=20, DcmDsdSidTabSubfuncAvail=false
            EcuReset: DcmDsdSidTabServiceId=17, DcmDsdSidTabSubfuncAvail=true
              Hard (DcmDsdSubService): DcmDsdSubServiceId=1
            ControlDtcSetting: DcmDsdSidTabServiceId=133, DcmDsdSidTabSubfuncAvail=true
              Disable (DcmDsdSubService): DcmDsdSubServiceId=2
              Enable (DcmDsdSubService): DcmDsdSubServiceId=1
            TesterPresent: DcmDsdSidTabServiceId=62, DcmDsdSidTabSubfuncAvail=true
              TesterPresent (DcmDsdSubService): DcmDsdSubServiceId=0
            WriteDataById: DcmDsdSidTabServiceId=46, DcmDsdSidTabSubfuncAvail=false
            ReadDataById: DcmDsdSidTabServiceId=34, DcmDsdSidTabSubfuncAvail=false
            SecurityAccess: DcmDsdSidTabServiceId=39, DcmDsdSidTabSubfuncAvail=true, DcmDsdSidTabSessionLevelRef=DcmDspSession/Programming, DcmDsdSidTabSessionLevelRef=DcmDspSession/Extended
              4 x DcmDsdSubService, all with DcmDsdSubServiceSessionLevelRef=DcmDspSession/Programming, DcmDsdSubServiceSessionLevelRef=DcmDspSession/Extended:
                Seed_Level1_Request: DcmDsdSubServiceId=1
                Level1_1_Send: DcmDsdSubServiceId=2
                Seed_Level2_Request: DcmDsdSubServiceId=3
                Level2_2_Send: DcmDsdSubServiceId=4
            DiagSessionControl: DcmDsdSidTabServiceId=16, DcmDsdSidTabSubfuncAvail=true
              3 x DcmDsdSubService:
                Programming: DcmDsdSubServiceId=2, DcmDsdSubServiceSessionLevelRef=DcmDspSession/Programming, DcmDsdSubServiceSessionLevelRef=DcmDspSession/Extended
                Default: DcmDsdSubServiceId=1
                Extended: DcmDsdSubServiceId=3
      DcmDsp: DcmDspMaxDidToRead=5, DcmDspReadDIDReportsNODIByte=false
        DidInfo_Diag_RWDI_LightOnOffCounter (DcmDspDidInfo)
          DcmDspDidAccess
            DcmDspDidWrite
            DcmDspDidRead
        Diag_RWDI_LightOnOffCounter (DcmDspDid):
          DcmDspDidIdentifier = 4096
          DcmDspDidUsed = true
          DcmDspDidUsePort = USE_DATA_ELEMENT_SPECIFIC_INTERFACES
          DcmDspDidInfoRef = DidInfo_Diag_RWDI_LightOnOffCounter
          LightOnOffCounter_Value (DcmDspDidSignal): DcmDspDidDataPos=0, DcmDspDidDataRef=Diag_RWDI_LightOnOffCounter_LightOnOffCounter_Value
        DcmDspControlDTCSetting: DcmSupportDTCSettingControlOptionRecord=true
        DataInfo_Diag_RWDI_LightOnOffCounter_LightOnOffCounter_Value (DcmDspDataInfo): DcmDspDataFixedLength=true, DcmDspDataScalingInfoSize=2
        DcmDspSession
          3 x DcmDspSessionRow, all with DcmDspSessionP2ServerMax=0.05, DcmDspSessionP2StarServerMax=5, DcmDspSessionForBoot=DCM_NO_BOOT:
            Default: DcmDspSessionLevel=1
            Programming: DcmDspSessionLevel=2
            Extended: DcmDspSessionLevel=3
        Diag_RWDI_LightOnOffCounter_LightOnOffCounter_Value (DcmDspData):
          DcmDspDataSize = 32
          DcmDspDataType = UINT32
          DcmDspDataUsePort = USE_DATA_ASYNCH_CLIENT_SERVER
          DcmDspDataReadFnc = LightOnOffCounter_ReadFnc_Callback
          DcmDspDataWriteFnc = LightOnOffCounter_WriteFnc_Callback
          DcmDspDataInfoRef = DataInfo_Diag_RWDI_LightOnOffCounter_LightOnOffCounter_Value
        DcmDspSecurity
          Level_01 (DcmDspSecurityRow):
            DcmDspSecurityDelayTime = 10
            DcmDspSecurityDelayTimeOnBoot = 0
            DcmDspSecurityKeySize = 2
            DcmDspSecurityLevel = 1
            DcmDspSecurityNumAttDelay = 3
            DcmDspSecuritySeedSize = 2
            DcmDspSecurityAttemptCounterEnabled = false
            DcmDspSecurityUsePort = USE_ASYNCH_CLIENT_SERVER
          Level_02 (DcmDspSecurityRow):
            DcmDspSecurityAttemptCounterEnabled = false
            DcmDspSecurityDelayTime = 10
            DcmDspSecurityDelayTimeOnBoot = 0
            DcmDspSecurityKeySize = 4
            DcmDspSecurityLevel = 2
            DcmDspSecurityNumAttDelay = 3
            DcmDspSecuritySeedSize = 4
            DcmDspSecurityUsePort = USE_ASYNCH_CLIENT_SERVER
        VM_HardwarePartNumber (DcmDspDid):
          DcmDspDidIdentifier = 61712
          DcmDspDidUsed = true
          DcmDspDidUsePort = USE_DATA_ELEMENT_SPECIFIC_INTERFACES
          DcmDspDidInfoRef = DidInfo_VM_HardwarePartNumber
          VM_HardwarePartNumber_Value (DcmDspDidSignal): DcmDspDidDataPos=0, DcmDspDidDataRef=Diag_VM_HardwarePartNumber
        Diag_VM_HardwarePartNumber (DcmDspData): DcmDspDataSize=32, DcmDspDataUsePort=USE_DATA_ASYNCH_CLIENT_SERVER, DcmDspDataType=UINT32, DcmDspDataInfoRef=DataInfo_VM_HardwarePartNumber
        DidInfo_VM_HardwarePartNumber (DcmDspDidInfo)
          DcmDspDidAccess
            DcmDspDidRead
            DcmDspDidWrite
        DataInfo_VM_HardwarePartNumber (DcmDspDataInfo): DcmDspDataFixedLength=true, DcmDspDataScalingInfoSize=11
        VM_HardwareBaseline (DcmDspDid): DcmDspDidIdentifier=61713, DcmDspDidUsed=true, DcmDspDidUsePort=USE_DATA_ELEMENT_SPECIFIC_INTERFACES, DcmDspDidInfoRef=DidInfo_VM_HardwareBaseline
          VM_HardwareBaseline_Value (DcmDspDidSignal): DcmDspDidDataPos=0, DcmDspDidDataRef=Diag_VM_HardwareBaseline
        DidInfo_VM_HardwareBaseline (DcmDspDidInfo)
          DcmDspDidAccess
            DcmDspDidRead
            DcmDspDidWrite
        Diag_VM_HardwareBaseline (DcmDspData): DcmDspDataSize=32, DcmDspDataUsePort=USE_DATA_ASYNCH_CLIENT_SERVER, DcmDspDataType=UINT32, DcmDspDataInfoRef=DataInfo_VM_HardwareBaseline
        DataInfo_VM_HardwareBaseline (DcmDspDataInfo): DcmDspDataFixedLength=true, DcmDspDataScalingInfoSize=2
        VM_SofwarePartNumber (DcmDspDid):
          DcmDspDidIdentifier = 61720
          DcmDspDidUsed = true
          DcmDspDidUsePort = USE_DATA_ELEMENT_SPECIFIC_INTERFACES
          DcmDspDidInfoRef = DcmDspDidInfo_VM_SofwarePartNumber
          DcmDspDidSignal_VM_SofwarePartNumber (DcmDspDidSignal): DcmDspDidDataPos=0, DcmDspDidDataRef=DcmDspData_VM_SofwarePartNumber
        DcmDspDidInfo_VM_SofwarePartNumber (DcmDspDidInfo)
          DcmDspDidAccess
            DcmDspDidWrite
            DcmDspDidRead
        DcmDspData_VM_SofwarePartNumber (DcmDspData): DcmDspDataSize=32, DcmDspDataUsePort=USE_DATA_ASYNCH_CLIENT_SERVER, DcmDspDataType=UINT32, DcmDspDataInfoRef=DcmDspDataInfo_VM_SofwarePartNumber
        DcmDspDataInfo_VM_SofwarePartNumber (DcmDspDataInfo): DcmDspDataFixedLength=true, DcmDspDataScalingInfoSize=11
        VM_SoftwarBaseline (DcmDspDid):
          DcmDspDidIdentifier = 61721
          DcmDspDidUsed = true
          DcmDspDidUsePort = USE_DATA_ELEMENT_SPECIFIC_INTERFACES
          DcmDspDidInfoRef = DcmDspDidInfo_VM_SoftwarBaseline
          DcmDspDidSignal_VM_SoftwarBaseline (DcmDspDidSignal): DcmDspDidDataPos=0, DcmDspDidDataRef=DcmDspData_VM_SoftwarBaseline
        DcmDspDidInfo_VM_SoftwarBaseline (DcmDspDidInfo)
          DcmDspDidAccess
            DcmDspDidRead
            DcmDspDidWrite
        DcmDspData_VM_SoftwarBaseline (DcmDspData): DcmDspDataSize=32, DcmDspDataUsePort=USE_DATA_ASYNCH_CLIENT_SERVER, DcmDspDataType=UINT32, DcmDspDataInfoRef=DcmDspDataInfo_VM_SoftwarBaseline
        DcmDspDataInfo_VM_SoftwarBaseline (DcmDspDataInfo): DcmDspDataFixedLength=true, DcmDspDataScalingInfoSize=2
        VM_FOTASpecialPartNumber (DcmDspDid):
          DcmDspDidIdentifier = 61728
          DcmDspDidUsed = true
          DcmDspDidUsePort = USE_DATA_ELEMENT_SPECIFIC_INTERFACES
          DcmDspDidInfoRef = DcmDspDidInfo_VM_FOTASpecialPartNumber
          DcmDspDidSignal_VM_FOTASpecialPartNumber (DcmDspDidSignal): DcmDspDidDataPos=0, DcmDspDidDataRef=DcmDspData_VM_FOTASpecialPartNumber
        DcmDspDidInfo_VM_FOTASpecialPartNumber (DcmDspDidInfo)
          DcmDspDidAccess
            DcmDspDidRead
            DcmDspDidWrite
        DcmDspData_VM_FOTASpecialPartNumber (DcmDspData):
          DcmDspDataSize = 32
          DcmDspDataUsePort = USE_DATA_ASYNCH_CLIENT_SERVER
          DcmDspDataType = UINT32
          DcmDspDataInfoRef = DcmDspDataInfo_VM_FOTASpecialPartNumber
        DcmDspDataInfo_VM_FOTASpecialPartNumber (DcmDspDataInfo): DcmDspDataFixedLength=true, DcmDspDataScalingInfoSize=11
        VM_CalibrarionPartNumber (DcmDspDid):
          DcmDspDidIdentifier = 61744
          DcmDspDidUsed = true
          DcmDspDidUsePort = USE_DATA_ELEMENT_SPECIFIC_INTERFACES
          DcmDspDidInfoRef = DcmDspDidInfo_VM_CalibrarionPartNumber
          DcmDspDidSignal_VM_CalibrarionPartNumber (DcmDspDidSignal): DcmDspDidDataPos=0, DcmDspDidDataRef=DcmDspData_VM_CalibrarionPartNumber
        DcmDspDidInfo_VM_CalibrarionPartNumber (DcmDspDidInfo)
          DcmDspDidAccess
            DcmDspDidRead
            DcmDspDidWrite
        DcmDspData_VM_CalibrarionPartNumber (DcmDspData):
          DcmDspDataSize = 32
          DcmDspDataUsePort = USE_DATA_ASYNCH_CLIENT_SERVER
          DcmDspDataType = UINT32
          DcmDspDataInfoRef = DcmDspDataInfo_VM_CalibrarionPartNumber
        DcmDspDataInfo_VM_CalibrarionPartNumber (DcmDspDataInfo): DcmDspDataFixedLength=true, DcmDspDataScalingInfoSize=11
        VM_CalibrationBaseline (DcmDspDid):
          DcmDspDidIdentifier = 61745
          DcmDspDidUsed = true
          DcmDspDidUsePort = USE_DATA_ELEMENT_SPECIFIC_INTERFACES
          DcmDspDidInfoRef = DcmDspDidInfo_VM_CalibrationBaseline
          DcmDspDidSignal_VM_CalibrationBaseline (DcmDspDidSignal): DcmDspDidDataPos=0, DcmDspDidDataRef=DcmDspData_VM_CalibrationBaseline
        DcmDspDidInfo_VM_CalibrationBaseline (DcmDspDidInfo)
          DcmDspDidAccess
            DcmDspDidRead
            DcmDspDidWrite
        DcmDspData_VM_CalibrationBaseline (DcmDspData): DcmDspDataSize=32, DcmDspDataUsePort=USE_DATA_ASYNCH_CLIENT_SERVER, DcmDspDataType=UINT32, DcmDspDataInfoRef=DcmDspDataInfo_VM_CalibrationBaseline
        DcmDspDataInfo_VM_CalibrationBaseline (DcmDspDataInfo): DcmDspDataFixedLength=true, DcmDspDataScalingInfoSize=2
        VM_Specialdatabaseline (DcmDspDid):
          DcmDspDidIdentifier = 61753
          DcmDspDidUsed = true
          DcmDspDidUsePort = USE_DATA_ELEMENT_SPECIFIC_INTERFACES
          DcmDspDidInfoRef = DcmDspDidInfo_VM_Specialdatabaseline
          DcmDspDidSignal_VM_Specialdatabaseline (DcmDspDidSignal): DcmDspDidDataPos=0, DcmDspDidDataRef=DcmDspData_VM_Specialdatabaseline
        DcmDspDidInfo_VM_Specialdatabaseline (DcmDspDidInfo)
          DcmDspDidAccess
            DcmDspDidRead
            DcmDspDidWrite
        DcmDspData_VM_Specialdatabaseline (DcmDspData): DcmDspDataSize=32, DcmDspDataUsePort=USE_DATA_ASYNCH_CLIENT_SERVER, DcmDspDataType=UINT32, DcmDspDataInfoRef=DcmDspDataInfo_VM_Specialdatabaseline
        DcmDspDataInfo_VM_Specialdatabaseline (DcmDspDataInfo): DcmDspDataFixedLength=false
        ReadFingerprint (DcmDspDid):
          DcmDspDidIdentifier = 61787
          DcmDspDidUsed = true
          DcmDspDidUsePort = USE_DATA_ELEMENT_SPECIFIC_INTERFACES
          DcmDspDidInfoRef = DcmDspDidInfo_ReadFingerprint
          DcmDspDidSignal_ReadFingerprint (DcmDspDidSignal): DcmDspDidDataPos=0, DcmDspDidDataRef=DcmDspData_ReadFingerprint
        DcmDspDidInfo_ReadFingerprint (DcmDspDidInfo)
          DcmDspDidAccess
            DcmDspDidRead
        DcmDspData_ReadFingerprint (DcmDspData): DcmDspDataSize=32, DcmDspDataUsePort=USE_DATA_ASYNCH_CLIENT_SERVER, DcmDspDataType=UINT32, DcmDspDataInfoRef=DcmDspDataInfo_ReadFingerprint
        DcmDspDataInfo_ReadFingerprint (DcmDspDataInfo): DcmDspDataFixedLength=true, DcmDspDataScalingInfoSize=12
        ReadActiveDiagSession (DcmDspDid):
          DcmDspDidIdentifier = 61830
          DcmDspDidUsed = true
          DcmDspDidUsePort = USE_DATA_ELEMENT_SPECIFIC_INTERFACES
          DcmDspDidInfoRef = DcmDspDidInfo_ReadActiveDiagSession
          DcmDspDidSignal_ReadActiveDiagSession (DcmDspDidSignal): DcmDspDidDataPos=0, DcmDspDidDataRef=DcmDspData_ReadActiveDiagSession
        DcmDspDidInfo_ReadActiveDiagSession (DcmDspDidInfo)
          DcmDspDidAccess
            DcmDspDidRead
        DcmDspData_ReadActiveDiagSession (DcmDspData): DcmDspDataSize=32, DcmDspDataUsePort=USE_DATA_ASYNCH_CLIENT_SERVER, DcmDspDataType=UINT32, DcmDspDataInfoRef=DcmDspDataInfo_ReadActiveDiagSession
        DcmDspDataInfo_ReadActiveDiagSession (DcmDspDataInfo): DcmDspDataFixedLength=true, DcmDspDataScalingInfoSize=1
        VM_SparepartNumber (DcmDspDid):
          DcmDspDidIdentifier = 61831
          DcmDspDidUsed = true
          DcmDspDidUsePort = USE_DATA_ELEMENT_SPECIFIC_INTERFACES
          DcmDspDidInfoRef = DcmDspDidInfo_VM_SparepartNumber
          DcmDspDidSignal_VM_SparepartNumber (DcmDspDidSignal): DcmDspDidDataPos=0, DcmDspDidDataRef=DcmDspData_VM_SparepartNumber
        DcmDspDidInfo_VM_SparepartNumber (DcmDspDidInfo)
          DcmDspDidAccess
            DcmDspDidRead
            DcmDspDidWrite
        DcmDspData_VM_SparepartNumber (DcmDspData): DcmDspDataSize=32, DcmDspDataUsePort=USE_DATA_ASYNCH_CLIENT_SERVER, DcmDspDataType=UINT32, DcmDspDataInfoRef=DcmDspDataInfo_VM_SparepartNumber
        DcmDspDataInfo_VM_SparepartNumber (DcmDspDataInfo): DcmDspDataFixedLength=true, DcmDspDataScalingInfoSize=11
        ECUDiagDatabaseVersion (DcmDspDid):
          DcmDspDidIdentifier = 61854
          DcmDspDidUsed = true
          DcmDspDidUsePort = USE_DATA_ELEMENT_SPECIFIC_INTERFACES
          DcmDspDidInfoRef = DcmDspDidInfo_ECUDiagDatabaseVersion
          DcmDspDidSignal_ECUDiagDatabaseVersion (DcmDspDidSignal): DcmDspDidDataPos=0, DcmDspDidDataRef=DcmDspData_ECUDiagDatabaseVersion
        DcmDspDidInfo_ECUDiagDatabaseVersion (DcmDspDidInfo)
          DcmDspDidAccess
            DcmDspDidRead
            DcmDspDidWrite
        DcmDspData_ECUDiagDatabaseVersion (DcmDspData): DcmDspDataSize=32, DcmDspDataUsePort=USE_DATA_ASYNCH_CLIENT_SERVER, DcmDspDataType=UINT32, DcmDspDataInfoRef=DcmDspDataInfo_ECUDiagDatabaseVersion
        DcmDspDataInfo_ECUDiagDatabaseVersion (DcmDspDataInfo): DcmDspDataFixedLength=true, DcmDspDataScalingInfoSize=3
        BootloaderVersion (DcmDspDid):
          DcmDspDidIdentifier = 61776
          DcmDspDidUsed = true
          DcmDspDidUsePort = USE_DATA_ELEMENT_SPECIFIC_INTERFACES
          DcmDspDidInfoRef = DcmDspDidInfo_BootloaderVersion
          DcmDspDidSignal_BootloaderVersion (DcmDspDidSignal): DcmDspDidDataPos=0, DcmDspDidDataRef=DcmDspData_BootloaderVersion
        DcmDspDidInfo_BootloaderVersion (DcmDspDidInfo)
          DcmDspDidAccess
            DcmDspDidRead
        DcmDspData_BootloaderVersion (DcmDspData): DcmDspDataSize=32, DcmDspDataUsePort=USE_DATA_ASYNCH_CLIENT_SERVER, DcmDspDataType=UINT32, DcmDspDataInfoRef=DcmDspDataInfo_BootloaderVersion
        DcmDspDataInfo_BootloaderVersion (DcmDspDataInfo): DcmDspDataFixedLength=false
        SystemSupplierIdData (DcmDspDid):
          DcmDspDidIdentifier = 61834
          DcmDspDidUsed = true
          DcmDspDidUsePort = USE_DATA_ELEMENT_SPECIFIC_INTERFACES
          DcmDspDidInfoRef = DcmDspDidInfo_SystemSupplierIdData
          DcmDspDidSignal_SystemSupplierIdData (DcmDspDidSignal): DcmDspDidDataPos=0, DcmDspDidDataRef=DcmDspData_SystemSupplierIdData
        DcmDspDidInfo_SystemSupplierIdData (DcmDspDidInfo)
          DcmDspDidAccess
            DcmDspDidRead
        DcmDspData_SystemSupplierIdData (DcmDspData): DcmDspDataSize=32, DcmDspDataUsePort=USE_DATA_ASYNCH_CLIENT_SERVER, DcmDspDataType=UINT32, DcmDspDataInfoRef=DcmDspDataInfo_SystemSupplierIdData
        DcmDspDataInfo_SystemSupplierIdData (DcmDspDataInfo): DcmDspDataFixedLength=true, DcmDspDataScalingInfoSize=8
        ECUManufacturingDate (DcmDspDid):
          DcmDspDidIdentifier = 61835
          DcmDspDidUsed = true
          DcmDspDidUsePort = USE_DATA_ELEMENT_SPECIFIC_INTERFACES
          DcmDspDidInfoRef = DcmDspDidInfo_ECUManufacturingDate
          DcmDspDidSignal_ECUManufacturingDate (DcmDspDidSignal): DcmDspDidDataPos=0, DcmDspDidDataRef=DcmDspData_ECUManufacturingDate
        DcmDspDidInfo_ECUManufacturingDate (DcmDspDidInfo)
          DcmDspDidAccess
            DcmDspDidRead
        DcmDspData_ECUManufacturingDate (DcmDspData): DcmDspDataSize=32, DcmDspDataUsePort=USE_DATA_ASYNCH_CLIENT_SERVER, DcmDspDataType=UINT32, DcmDspDataInfoRef=DcmDspDataInfo_ECUManufacturingDate
        DcmDspDataInfo_ECUManufacturingDate (DcmDspDataInfo): DcmDspDataFixedLength=true, DcmDspDataScalingInfoSize=3
        ECUSerialNumber (DcmDspDid):
          DcmDspDidIdentifier = 61836
          DcmDspDidUsed = true
          DcmDspDidUsePort = USE_DATA_ELEMENT_SPECIFIC_INTERFACES
          DcmDspDidInfoRef = DcmDspDidInfo_ECUSerialNumber
          DcmDspDidSignal_ECUSerialNumber (DcmDspDidSignal): DcmDspDidDataPos=0, DcmDspDidDataRef=DcmDspData_ECUSerialNumber
        DcmDspDidInfo_ECUSerialNumber (DcmDspDidInfo)
          DcmDspDidAccess
            DcmDspDidRead
        DcmDspData_ECUSerialNumber (DcmDspData): DcmDspDataSize=32, DcmDspDataUsePort=USE_DATA_ASYNCH_CLIENT_SERVER, DcmDspDataType=UINT32, DcmDspDataInfoRef=DcmDspDataInfo_ECUSerialNumber
        DcmDspDataInfo_ECUSerialNumber (DcmDspDataInfo): DcmDspDataFixedLength=true, DcmDspDataScalingInfoSize=10
        VIN (DcmDspDid): DcmDspDidIdentifier=61840, DcmDspDidUsed=true, DcmDspDidUsePort=USE_DATA_ELEMENT_SPECIFIC_INTERFACES, DcmDspDidInfoRef=DcmDspDidInfo_VIN
          DcmDspDidSignal_VIN (DcmDspDidSignal): DcmDspDidDataPos=0, DcmDspDidDataRef=DcmDspData_VIN
        DcmDspDidInfo_VIN (DcmDspDidInfo)
          DcmDspDidAccess
            DcmDspDidRead
            DcmDspDidWrite
        DcmDspData_VIN (DcmDspData): DcmDspDataSize=32, DcmDspDataUsePort=USE_DATA_ASYNCH_CLIENT_SERVER, DcmDspDataType=UINT32, DcmDspDataInfoRef=DcmDspDataInfo_VIN
        DcmDspDataInfo_VIN (DcmDspDataInfo): DcmDspDataFixedLength=true, DcmDspDataScalingInfoSize=17
        SystemName (DcmDspDid): DcmDspDidIdentifier=61847, DcmDspDidUsed=true, DcmDspDidUsePort=USE_DATA_ELEMENT_SPECIFIC_INTERFACES, DcmDspDidInfoRef=DcmDspDidInfo_SystemName
          DcmDspDidSignal_SystemName (DcmDspDidSignal): DcmDspDidDataPos=0, DcmDspDidDataRef=DcmDspData_SystemName
        DcmDspDidInfo_SystemName (DcmDspDidInfo)
          DcmDspDidAccess
            DcmDspDidRead
        DcmDspData_SystemName (DcmDspData): DcmDspDataSize=32, DcmDspDataUsePort=USE_DATA_ASYNCH_CLIENT_SERVER, DcmDspDataType=UINT32, DcmDspDataInfoRef=DcmDspDataInfo_SystemName
        DcmDspDataInfo_SystemName (DcmDspDataInfo): DcmDspDataFixedLength=false
        RepairShopFingerPrint (DcmDspDid):
          DcmDspDidIdentifier = 61848
          DcmDspDidUsed = true
          DcmDspDidUsePort = USE_DATA_ELEMENT_SPECIFIC_INTERFACES
          DcmDspDidInfoRef = DcmDspDidInfo_RepairShopFingerPrint
          DcmDspDidSignal_RepairShopFingerPrint (DcmDspDidSignal): DcmDspDidDataPos=0, DcmDspDidDataRef=DcmDspData_RepairShopFingerPrint
        DcmDspDidInfo_RepairShopFingerPrint (DcmDspDidInfo)
          DcmDspDidAccess
            DcmDspDidRead
            DcmDspDidWrite
        DcmDspData_RepairShopFingerPrint (DcmDspData): DcmDspDataSize=32, DcmDspDataUsePort=USE_DATA_ASYNCH_CLIENT_SERVER, DcmDspDataType=UINT32, DcmDspDataInfoRef=DcmDspDataInfo_RepairShopFingerPrint
        DcmDspDataInfo_RepairShopFingerPrint (DcmDspDataInfo): DcmDspDataFixedLength=true, DcmDspDataScalingInfoSize=12
        ECUProgrammingDate (DcmDspDid):
          DcmDspDidIdentifier = 61849
          DcmDspDidUsed = true
          DcmDspDidUsePort = USE_DATA_ELEMENT_SPECIFIC_INTERFACES
          DcmDspDidInfoRef = DcmDspDidInfo_ECUProgrammingDate
          DcmDspDidSignal_ECUProgrammingDate (DcmDspDidSignal): DcmDspDidDataPos=0, DcmDspDidDataRef=DcmDspData_ECUProgrammingDate
        DcmDspDidInfo_ECUProgrammingDate (DcmDspDidInfo)
          DcmDspDidAccess
            DcmDspDidRead
        DcmDspData_ECUProgrammingDate (DcmDspData): DcmDspDataSize=32, DcmDspDataUsePort=USE_DATA_ASYNCH_CLIENT_SERVER, DcmDspDataType=UINT32, DcmDspDataInfoRef=DcmDspDataInfo_ECUProgrammingDate
        DcmDspDataInfo_ECUProgrammingDate (DcmDspDataInfo): DcmDspDataFixedLength=true, DcmDspDataScalingInfoSize=3
        ECUConfigurarion (DcmDspDid):
          DcmDspDidIdentifier = 61697
          DcmDspDidUsed = true
          DcmDspDidUsePort = USE_DATA_ELEMENT_SPECIFIC_INTERFACES
          DcmDspDidInfoRef = DcmDspDidInfo_ECUConfigurarion
          DcmDspDidSignal_ECUConfigurarion (DcmDspDidSignal): DcmDspDidDataPos=0, DcmDspDidDataRef=DcmDspData_ECUConfigurarion
        DcmDspDidInfo_ECUConfigurarion (DcmDspDidInfo)
          DcmDspDidAccess
            DcmDspDidRead
            DcmDspDidWrite
        DcmDspData_ECUConfigurarion (DcmDspData): DcmDspDataSize=32, DcmDspDataUsePort=USE_DATA_ASYNCH_CLIENT_SERVER, DcmDspDataType=UINT32, DcmDspDataInfoRef=DcmDspDataInfo_ECUConfigurarion
        DcmDspDataInfo_ECUConfigurarion (DcmDspDataInfo): DcmDspDataFixedLength=true, DcmDspDataScalingInfoSize=25
        ConfigurarionFingerprint (DcmDspDid):
          DcmDspDidIdentifier = 61788
          DcmDspDidUsed = true
          DcmDspDidUsePort = USE_DATA_ELEMENT_SPECIFIC_INTERFACES
          DcmDspDidInfoRef = DcmDspDidInfo_ConfigurarionFingerprint
          DcmDspDidSignal_ConfigurarionFingerprint (DcmDspDidSignal): DcmDspDidDataPos=0, DcmDspDidDataRef=DcmDspData_ConfigurarionFingerprint
        DcmDspDidInfo_ConfigurarionFingerprint (DcmDspDidInfo)
          DcmDspDidAccess
            DcmDspDidRead
            DcmDspDidWrite
        DcmDspData_ConfigurarionFingerprint (DcmDspData):
          DcmDspDataSize = 32
          DcmDspDataUsePort = USE_DATA_ASYNCH_CLIENT_SERVER
          DcmDspDataType = UINT32
          DcmDspDataInfoRef = DcmDspDataInfo_ConfigurarionFingerprint
        DcmDspDataInfo_ConfigurarionFingerprint (DcmDspDataInfo): DcmDspDataFixedLength=true, DcmDspDataScalingInfoSize=12
      DcmPageBufferCfg: DcmPagedBufferEnabled=true
