AUTOSAR XML (schema 4-2-1)
package /ActiveEcuC
  module config CanIf: implementation-config-variant=VARIANT-PRE-COMPILE, module-description=CanIf_Impl
    CanIfCtrlDrvCfg_7d254554 (CanIfCtrlDrvCfg): CanIfCtrlDrvTxCancellation=false, CanIfCtrlDrvInitHohConfigRef=CanIfInitHohCfg, CanIfCtrlDrvNameRef=CanGeneral
      CT_NIO_ES6_RF_CAN_SR_V3_0_a63ca593 (CanIfCtrlCfg): CanIfCtrlId=0, CanIfCtrlWakeupSupport=false, CanIfCtrlJ1939DynAddrSupport=DISABLED, CanIfCtrlCanCtrlRef=CT_NIO_ES6_RF_CAN_SR_V3_0_a63ca593
    CanIfDispatchCfg:
      CanIfDispatchUserCtrlBusOffName = CanSM_ControllerBusOff
      CanIfDispatchUserCtrlBusOffUL = CAN_SM
      CanIfDispatchUserCtrlModeIndicationName = CanSM_ControllerModeIndication
      CanIfDispatchUserCtrlModeIndicationUL = CAN_SM
      CanIfDispatchDataChecksumRxErrorIndicationUL = NONE
      CanIfDispatchDataChecksumRxErrorIndicationName = NULL_PTR
    CanIfInitCfg
      WLC_01_oNIO_ES6_RF_CAN_SR_V3_0_1dd10da5_Tx (CanIfTxPduCfg):
        CanIfTxPduCanId = 995
        CanIfTxPduCanIdType = STANDARD_CAN
        CanIfTxPduDlc = 3
        CanIfTxPduUserTxConfirmationName = PduR_CanIfTxConfirmation
        CanIfTxPduUserTxConfirmationUL = PDUR
        CanIfTxPduId = 4
        CanIfTxPduReadNotifyStatus = false
        CanIfTxPduType = STATIC
        CanIfTxPduDataChecksumPdu = true
        CanIfTxPduBufferRef = CHNL_3145ee01
        CanIfTxPduRef = WLC_01_oNIO_ES6_RF_CAN_SR_V3_0_49299080_Tx
      WLC_02_oNIO_ES6_RF_CAN_SR_V3_0_adb4aee2_Tx (CanIfTxPduCfg):
        CanIfTxPduCanId = 832
        CanIfTxPduCanIdType = STANDARD_CAN
        CanIfTxPduDlc = 2
        CanIfTxPduUserTxConfirmationName = PduR_CanIfTxConfirmation
        CanIfTxPduUserTxConfirmationUL = PDUR
        CanIfTxPduId = 5
        CanIfTxPduReadNotifyStatus = false
        CanIfTxPduType = STATIC
        CanIfTxPduDataChecksumPdu = true
        CanIfTxPduBufferRef = CHNL_3145ee01
        CanIfTxPduRef = WLC_02_oNIO_ES6_RF_CAN_SR_V3_0_60d6e62c_Tx
      6 x CanIfRxPduCfg, all with CanIfRxPduCanIdType=STANDARD_CAN, CanIfRxPduReadData=false, CanIfRxPduReadNotifyStatus=false, CanIfRxPduDlcCheck=true, CanIfRxPduHrhIdRef=CN_NIO_ES6_RF_CAN_SR_V3_0_91fc07e0_Rx:
        CGW_WLC_oNIO_ES6_RF_CAN_SR_V3_0_411e58d5_Rx: CanIfRxPduCanId=958, CanIfRxPduDlc=8, CanIfRxPduUserRxIndicationName=PduR_CanIfRxIndication, CanIfRxPduUserRxIndicationUL=PDUR, CanIfRxPduId=5, CanIfRxPduDataChecksumPdu=true, CanIfRxPduRef=CGW_WLC_oNIO_ES6_RF_CAN_SR_V3_0_57df1db7_Rx
        DIAG_REQ_WLC_Tp_oNIO_ES6_RF_CAN_SR_V3_0_dcbbcb37_Rx: CanIfRxPduCanId=1592, CanIfRxPduDlc=8, CanIfRxPduUserRxIndicationName=CanTp_RxIndication, CanIfRxPduUserRxIndicationType=PDUID_PDUINFOPTR, CanIfRxPduUserRxIndicationUL=CAN_TP, CanIfRxPduId=1, CanIfRxPduRef=DIAG_REQ_WLC_Tp_oNIO_ES6_RF_CAN_SR_V3_0_18ec0086_Rx
        CGW_02_oNIO_ES6_RF_CAN_SR_V3_0_e6e0b02d_Rx: CanIfRxPduCanId=707, CanIfRxPduDlc=2, CanIfRxPduUserRxIndicationName=PduR_CanIfRxIndication, CanIfRxPduUserRxIndicationUL=PDUR, CanIfRxPduId=8, CanIfRxPduRef=CGW_02_oNIO_ES6_RF_CAN_SR_V3_0_371b1f5e_Rx
        WLC_DEVLP_02_oNIO_ES6_RF_CAN_SR_V3_0_52a3faed_Rx: CanIfRxPduCanId=1212, CanIfRxPduDlc=8, CanIfRxPduId=3, CanIfRxPduUserRxIndicationName=CanTp_RxIndication, CanIfRxPduUserRxIndicationUL=CAN_TP, CanIfRxPduRef=WLC_DEVLP_02_oNIO_ES6_RF_CAN_SR_V3_0_2ddc8841_Rx
        DIAG_REQ_AllECU_Tp_oNIO_ES6_RF_CAN_SR_V3_0_23f8e329_Rx: CanIfRxPduCanId=1537, CanIfRxPduDlc=8, CanIfRxPduUserRxIndicationName=CanTp_RxIndication, CanIfRxPduUserRxIndicationType=PDUID_PDUINFOPTR, CanIfRxPduUserRxIndicationUL=CAN_TP, CanIfRxPduId=2, CanIfRxPduRef=DIAG_REQ_AllECU_Tp_oNIO_ES6_RF_CAN_SR_V3_0_3d6a4915_Rx
        WLC_d9d2b008_Rx: CanIfRxPduDlc=8, CanIfRxPduUserRxIndicationName=CanNm_RxIndication, CanIfRxPduUserRxIndicationUL=CAN_NM, CanIfRxPduId=0, CanIfRxPduRef=WLC_4a7e70e4_Rx
          CHNL_f62b2008 (CanIfRxPduCanIdRange): CanIfRxPduCanIdRangeLowerCanId=1280, CanIfRxPduCanIdRangeUpperCanId=1407
      CHNL_3145ee01 (CanIfBufferCfg):
        CanIfBufferSize = 7
        CanIfTxBufferHandlingType = PRIO_BY_CANID
        CanIfTxBufferMappedTxPdus = 7
        CanIfTxBufferMaxPduLength = 8
        CanIfBufferHthRef = CN_NIO_ES6_RF_CAN_SR_V3_0_d2612a1f_Tx
      CDC_IC_01_oNIO_ES6_RF_CAN_SR_V3_0_6ce0b6d1_Rx (CanIfRxPduCfg):
        CanIfRxPduCanId = 938
        CanIfRxPduCanIdType = STANDARD_CAN
        CanIfRxPduDlc = 3
        CanIfRxPduUserRxIndicationName = PduR_CanIfRxIndication
        CanIfRxPduUserRxIndicationUL = PDUR
        CanIfRxPduId = 7
        CanIfRxPduReadData = false
        CanIfRxPduReadNotifyStatus = false
        CanIfRxPduDlcCheck = true
        CanIfRxPduHrhIdRef = CN_NIO_ES6_RF_CAN_SR_V3_0_91fc07e0_Rx
        CanIfRxPduRef = CDC_IC_01_oNIO_ES6_RF_CAN_SR_V3_0_7ab33239_Rx
      CGW_TCU_01_oNIO_ES6_RF_CAN_SR_V3_0_a587df53_Rx (CanIfRxPduCfg):
        CanIfRxPduCanId = 946
        CanIfRxPduCanIdType = STANDARD_CAN
        CanIfRxPduDlc = 6
        CanIfRxPduUserRxIndicationName = PduR_CanIfRxIndication
        CanIfRxPduUserRxIndicationUL = PDUR
        CanIfRxPduId = 6
        CanIfRxPduReadData = false
        CanIfRxPduReadNotifyStatus = false
        CanIfRxPduDlcCheck = true
        CanIfRxPduHrhIdRef = CN_NIO_ES6_RF_CAN_SR_V3_0_91fc07e0_Rx
        CanIfRxPduRef = CGW_TCU_01_oNIO_ES6_RF_CAN_SR_V3_0_9e3e6b3d_Rx
      NM_WLC_oNIO_ES6_RF_CAN_SR_V3_0_76bbfea6_Tx (CanIfTxPduCfg):
        CanIfTxPduCanId = 1336
        CanIfTxPduCanIdType = STANDARD_CAN
        CanIfTxPduDlc = 8
        CanIfTxPduUserTxConfirmationName = CanNm_TxConfirmation
        CanIfTxPduUserTxConfirmationUL = CAN_NM
        CanIfTxPduId = 1
        CanIfTxPduReadNotifyStatus = false
        CanIfTxPduType = STATIC
        CanIfTxPduBufferRef = CHNL_3145ee01
        CanIfTxPduRef = NM_WLC_oNIO_ES6_RF_CAN_SR_V3_0_1915286e_Tx
      DIAG_RESP_WLC_Tp_oNIO_ES6_RF_CAN_SR_V3_0_00ce42fa_Tx (CanIfTxPduCfg):
        CanIfTxPduCanId = 1720
        CanIfTxPduCanIdType = STANDARD_CAN
        CanIfTxPduDlc = 8
        CanIfTxPduUserTxConfirmationName = CanTp_TxConfirmation
        CanIfTxPduUserTxConfirmationUL = CAN_TP
        CanIfTxPduId = 0
        CanIfTxPduReadNotifyStatus = false
        CanIfTxPduType = STATIC
        CanIfTxPduBufferRef = CHNL_3145ee01
        CanIfTxPduRef = DIAG_RESP_WLC_Tp_oNIO_ES6_RF_CAN_SR_V3_0_8004734c_Tx
      CDC_WLC_oNIO_ES6_RF_CAN_SR_V3_0_96cf9e96_Rx (CanIfRxPduCfg):
        CanIfRxPduCanId = 698
        CanIfRxPduCanIdType = STANDARD_CAN
        CanIfRxPduDlc = 1
        CanIfRxPduUserRxIndicationName = PduR_CanIfRxIndication
        CanIfRxPduUserRxIndicationUL = PDUR
        CanIfRxPduId = 9
        CanIfRxPduReadData = false
        CanIfRxPduReadNotifyStatus = false
        CanIfRxPduDlcCheck = true
        CanIfRxPduHrhIdRef = CN_NIO_ES6_RF_CAN_SR_V3_0_91fc07e0_Rx
        CanIfRxPduRef = CDC_WLC_oNIO_ES6_RF_CAN_SR_V3_0_cbd6c32f_Rx
      WLC_DEVLP_01_oNIO_ES6_RF_CAN_SR_V3_0_163e9779_Tx (CanIfTxPduCfg):
        CanIfTxPduCanId = 1211
        CanIfTxPduCanIdType = STANDARD_CAN
        CanIfTxPduDlc = 8
        CanIfTxPduId = 2
        CanIfTxPduReadNotifyStatus = false
        CanIfTxPduType = STATIC
        CanIfTxPduUserTxConfirmationUL = CAN_TP
        CanIfTxPduUserTxConfirmationName = CanTp_TxConfirmation
        CanIfTxPduBufferRef = CHNL_3145ee01
        CanIfTxPduRef = WLC_DEVLP_01_oNIO_ES6_RF_CAN_SR_V3_0_0423feed_Tx
      CanIfInitHohCfg: CanIfInitRefCfgSet=CanConfigSet
        CN_NIO_ES6_RF_CAN_SR_V3_0_d2612a1f_Tx (CanIfHthCfg): CanIfHthCanCtrlIdRef=CT_NIO_ES6_RF_CAN_SR_V3_0_a63ca593, CanIfHthIdSymRef=CN_NIO_ES6_RF_CAN_SR_V3_0_d2612a1f_Tx
        CN_NIO_ES6_RF_CAN_SR_V3_0_91fc07e0_Rx (CanIfHrhCfg): CanIfHrhSoftwareFilter=true, CanIfHrhCanCtrlIdRef=CT_NIO_ES6_RF_CAN_SR_V3_0_a63ca593, CanIfHrhIdSymRef=CN_NIO_ES6_RF_CAN_SR_V3_0_91fc07e0_Rx
      BCU_04_oNIO_ES6_RF_CAN_SR_V3_0_7f355556_Rx (CanIfRxPduCfg):
        CanIfRxPduCanId = 91
        CanIfRxPduCanIdType = STANDARD_CAN
        CanIfRxPduDlc = 8
        CanIfRxPduUserRxIndicationName = PduR_CanIfRxIndication
        CanIfRxPduUserRxIndicationUL = PDUR
        CanIfRxPduId = 11
        CanIfRxPduReadData = false
        CanIfRxPduReadNotifyStatus = false
        CanIfRxPduDlcCheck = true
        CanIfRxPduDataChecksumPdu = true
        CanIfRxPduHrhIdRef = CN_NIO_ES6_RF_CAN_SR_V3_0_91fc07e0_Rx
        CanIfRxPduRef = BCU_04_oNIO_ES6_RF_CAN_SR_V3_0_b06c3b94_Rx
      CGW_03_oNIO_ES6_RF_CAN_SR_V3_0_3fecd32f_Rx (CanIfRxPduCfg):
        CanIfRxPduCanId = 268
        CanIfRxPduCanIdType = STANDARD_CAN
        CanIfRxPduDlc = 8
        CanIfRxPduUserRxIndicationName = PduR_CanIfRxIndication
        CanIfRxPduUserRxIndicationUL = PDUR
        CanIfRxPduId = 10
        CanIfRxPduReadData = false
        CanIfRxPduReadNotifyStatus = false
        CanIfRxPduDlcCheck = true
        CanIfRxPduDataChecksumPdu = true
        CanIfRxPduHrhIdRef = CN_NIO_ES6_RF_CAN_SR_V3_0_91fc07e0_Rx
        CanIfRxPduRef = CGW_03_oNIO_ES6_RF_CAN_SR_V3_0_2fb1cd3a_Rx
      WLC_CDC_NFC_oNIO_ES6_RF_CAN_SR_V3_0_f65364a2_Tx (CanIfTxPduCfg):
        CanIfTxPduCanId = 1198
        CanIfTxPduCanIdType = STANDARD_CAN
        CanIfTxPduDlc = 8
        CanIfTxPduId = 3
        CanIfTxPduReadNotifyStatus = false
        CanIfTxPduType = STATIC
        CanIfTxPduUserTxConfirmationUL = CAN_TP
        CanIfTxPduUserTxConfirmationName = CanTp_TxConfirmation
        CanIfTxPduBufferRef = CHNL_3145ee01
        CanIfTxPduRef = WLC_CDC_NFC_oNIO_ES6_RF_CAN_SR_V3_0_e08c50f2_Tx
      IMOB_WLC_CGW_oNIO_ES6_RF_CAN_SR_V3_0_4f44c7a2_Tx (CanIfTxPduCfg):
        CanIfTxPduCanId = 40
        CanIfTxPduCanIdType = STANDARD_CAN
        CanIfTxPduDlc = 8
        CanIfTxPduId = 6
        CanIfTxPduReadNotifyStatus = false
        CanIfTxPduType = STATIC
        CanIfTxPduUserTxConfirmationUL = CAN_TP
        CanIfTxPduUserTxConfirmationName = CanTp_TxConfirmation
        CanIfTxPduBufferRef = CHNL_3145ee01
        CanIfTxPduRef = IMOB_WLC_CGW_oNIO_ES6_RF_CAN_SR_V3_0_efb0805f_Tx
      CDC_WLC_NFC_oNIO_ES6_RF_CAN_SR_V3_0_0c4c3dd1_Rx (CanIfRxPduCfg):
        CanIfRxPduCanId = 1199
        CanIfRxPduCanIdType = STANDARD_CAN
        CanIfRxPduDlc = 8
        CanIfRxPduId = 4
        CanIfRxPduReadData = false
        CanIfRxPduReadNotifyStatus = false
        CanIfRxPduUserRxIndicationName = CanTp_RxIndication
        CanIfRxPduUserRxIndicationUL = CAN_TP
        CanIfRxPduDlcCheck = true
        CanIfRxPduUserRxIndicationType = PDUID_PDUINFOPTR
        CanIfRxPduHrhIdRef = CN_NIO_ES6_RF_CAN_SR_V3_0_91fc07e0_Rx
        CanIfRxPduRef = CDC_WLC_NFC_oNIO_ES6_RF_CAN_SR_V3_0_01b0c2d6_Rx
      IMOB_CGW_WLC_oNIO_ES6_RF_CAN_SR_V3_0_451c91a3_Rx (CanIfRxPduCfg):
        CanIfRxPduCanId = 39
        CanIfRxPduCanIdType = STANDARD_CAN
        CanIfRxPduDlc = 8
        CanIfRxPduId = 12
        CanIfRxPduReadData = false
        CanIfRxPduReadNotifyStatus = false
        CanIfRxPduUserRxIndicationName = CanTp_RxIndication
        CanIfRxPduUserRxIndicationUL = CAN_TP
        CanIfRxPduDlcCheck = true
        CanIfRxPduUserRxIndicationType = PDUID_PDUINFOPTR
        CanIfRxPduHrhIdRef = CN_NIO_ES6_RF_CAN_SR_V3_0_91fc07e0_Rx
        CanIfRxPduRef = IMOB_CGW_WLC_oNIO_ES6_RF_CAN_SR_V3_0_da4d0319_Rx
    CanIfPrivateCfg:
      CanIfPrivateSoftwareFilterType = LINEAR
      CanIfPrivateDlcCheck = true
      CanIfSupportTTCAN = false
      CanIfTransceiverMapping = false
      CanIfTransceiverHandling = false
      CanIfSupportExtendedIds = false
      CanIfSupportNmOsek = false
      CanIfTxBufferType = BYTE_QUEUE
      CanIfOptimizeOneController = true
      CanIfWakeupSupport = false
      CanIfStaticFdTxBufferSupport = false
      CanIfRxSearchConsiderMsgType = false
      CanIfTxBufferFifoSupport = false
      CanIfSetPduReceptionModeSupport = false
      CanIfDataChecksumRxSupport = true
      CanIfDataChecksumTxSupport = true
    CanIfPublicCfg:
      CanIfPublicPnSupport = false
      CanIfPublicCancelTransmitSupport = false
      CanIfPublicDevErrorDetect = false
      CanIfPublicHandleTypeEnum = UINT8
      CanIfPublicMultipleDrvSupport = false
      CanIfPublicNumberOfCanHwUnits = 1
      CanIfPublicReadRxPduDataApi = false
      CanIfPublicReadRxPduNotifyStatusApi = false
      CanIfPublicReadTxPduNotifyStatusApi = false
      CanIfPublicSetDynamicTxIdApi = false
      CanIfPublicTxBuffering = true
      CanIfPublicTxConfirmPollingSupport = false
      CanIfPublicVersionInfoApi = true
      CanIfPublicWakeupCheckValidSupport = false
      CanIfPnWakeupTxPduFilterSupport = false
      CanIfPnTrcvHandlingSupport = false
      CanIfJ1939DynAddrSupport = DISABLED
      CanIfSafeBswChecks = false
      CanIfBusMirroringSupport = false
      CanIfSetBaudrateApi = false
      CanIfPublicCddHeaderFile = Cdd_Cbk.h
