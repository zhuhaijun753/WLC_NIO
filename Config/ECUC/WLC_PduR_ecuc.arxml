AUTOSAR XML (schema 4-2-1)
package /ActiveEcuC
  module config PduR: implementation-config-variant=VARIANT-PRE-COMPILE, module-description=PduR_Impl
    PduRGeneral:
      PduRDevErrorDetect = false
      PduRVersionInfoApi = true
      PduRMetaDataSupport = false
      PduRPduCallback = false
      PduRSwitching = false
      PduRSafeBswChecks = false
      PduREnableDeferredTransmission = false
      PduREnableDeferredReception = false
      PduRSupportMulticore = false
      PduRRoutingTypeGateway = false
      PduRGeneration:
        PduROutOfBoundsWriteProtectionStrategy = NONE
        PduROutOfBoundsWriteSanitizer = false
        PduROutOfBoundsReadSanitizer = false
        PduRNumericalDataTypeMinimizationStrategy = WITH_CAST
        PduRReduceConstantData2Define = false
        PduRBoolDataInArrayOfStructStrategy = BITMASKING
        PduRDeduplicateIndirectedData = true
        PduRDataDeduplicationStrategy = WITH_CAST
        PduRReduceBoolDataByNegationThreshold = 2
        PduRReduceBoolDataByNumericalComparisonThreshold = 2
        PduRReduceBoolDataByNumericalRelationThreshold = 2
        PduRReduceBoolDataByNumericalOperandStrategy = WITH_ANY_VALUE
        PduRReduceNumericalDataByOffsetThreshold = 2
        PduRReduceNumericalDataByArraySubtractionThreshold = 2
        PduRReduceDataByStreaming = false
        PduRShortSymbols = false
        PduRInterfacesForDeactivatedData = false
        PduRReferringKeysInComments = false
    PduRRoutingTables: PduRConfigurationId=0
      PduRRoutingTable
        19 x PduRRoutingPath, all with PduRMulticoreRoutingPath=false, PduRLockRef=PduRLock_PduRExclusiveArea:
          CGW_WLC_oNIO_ES6_RF_CAN_SR_V3_0_57df1db7_Rx: PduRRoutingPathCommunicationType=COMMUNICATION_INTERFACE
            CGW_WLC_oNIO_ES6_RF_CAN_SR_V3_0_57df1db7_Rx_8b01a8ad_Rx (PduRDestPdu):
              PduRDestPduHandleId = 6
              PduRDestPduDirection = RECEIVE
              PduRDestPduRoutingType = API_FORWARDING
              PduRDestPduDataProcessing = IMMEDIATE
              PduRPduLengthHandlingStrategy = UNUSED
              PduRTransmissionConfirmation = false
              PduRDestPduRef = CGW_WLC_oNIO_ES6_RF_CAN_SR_V3_0_4780465a_Rx
              PduRDestPduPduRBswModulesRef = Com
            PduRSrcPdu_8b01a8ad (PduRSrcPdu): PduRSourcePduHandleId=6, PduRSrcPduDirection=RECEIVE, PduRSrcPduRef=CGW_WLC_oNIO_ES6_RF_CAN_SR_V3_0_57df1db7_Rx, PduRSrcPduPduRBswModulesRef=CanIf
          DIAG_REQ_AllECU_oNIO_ES6_RF_CAN_SR_V3_0_5b04e722_Rx: PduRRoutingPathCommunicationType=TRANSPORT_PROTOCOL
            DIAG_REQ_AllECU_oNIO_ES6_RF_CAN_SR_V3_0_5b04e722_Rx_392782f6_Rx (PduRDestPdu):
              PduRDestPduHandleId = 0
              PduRDestPduDirection = RECEIVE
              PduRDestPduRoutingType = API_FORWARDING
              PduRDestPduDataProcessing = IMMEDIATE
              PduRPduLengthHandlingStrategy = UNUSED
              PduRDestPduRef = DIAG_REQ_AllECU_oNIO_ES6_RF_CAN_SR_V3_0_88b0846e_Rx
              PduRDestPduPduRBswModulesRef = Dcm
            PduRSrcPdu_392782f6 (PduRSrcPdu):
              PduRSourcePduHandleId = 0
              PduRSrcPduDirection = RECEIVE
              PduRSrcPduRef = DIAG_REQ_AllECU_oNIO_ES6_RF_CAN_SR_V3_0_5b04e722_Rx
              PduRSrcPduPduRBswModulesRef = CanTp
          NM_WLC_oNIO_ES6_RF_CAN_SR_V3_0_9357dd65_Tx: PduRRoutingPathCommunicationType=COMMUNICATION_INTERFACE
            PduRSrcPdu_9febb8af (PduRSrcPdu): PduRSourcePduHandleId=2, PduRSrcPduDirection=TRANSMIT, PduRSrcPduRef=NM_WLC_oNIO_ES6_RF_CAN_SR_V3_0_9357dd65_Tx, PduRSrcPduPduRBswModulesRef=Com
            NM_WLC_oNIO_ES6_RF_CAN_SR_V3_0_9357dd65_Tx_9febb8af_Tx (PduRDestPdu):
              PduRDestPduHandleId = 1
              PduRDestPduDirection = TRANSMIT
              PduRDestPduRoutingType = API_FORWARDING
              PduRDestPduDataProcessing = IMMEDIATE
              PduRPduLengthHandlingStrategy = UNUSED
              PduRDestPduDataProvision = PDUR_TRIGGERTRANSMIT
              PduRTransmissionConfirmation = false
              PduRDestPduRef = NM_WLC_oNIO_ES6_RF_CAN_SR_V3_0_9357dd65_Tx
              PduRDestPduPduRBswModulesRef = CanNm
          CGW_TCU_01_oNIO_ES6_RF_CAN_SR_V3_0_9e3e6b3d_Rx: PduRRoutingPathCommunicationType=COMMUNICATION_INTERFACE
            CGW_TCU_01_oNIO_ES6_RF_CAN_SR_V3_0_9e3e6b3d_Rx_ece35bb2_Rx (PduRDestPdu):
              PduRDestPduHandleId = 5
              PduRDestPduDirection = RECEIVE
              PduRDestPduRoutingType = API_FORWARDING
              PduRDestPduDataProcessing = IMMEDIATE
              PduRPduLengthHandlingStrategy = UNUSED
              PduRTransmissionConfirmation = false
              PduRDestPduRef = CGW_TCU_01_oNIO_ES6_RF_CAN_SR_V3_0_49a017d3_Rx
              PduRDestPduPduRBswModulesRef = Com
            PduRSrcPdu_ece35bb2 (PduRSrcPdu):
              PduRSourcePduHandleId = 5
              PduRSrcPduDirection = RECEIVE
              PduRSrcPduRef = CGW_TCU_01_oNIO_ES6_RF_CAN_SR_V3_0_9e3e6b3d_Rx
              PduRSrcPduPduRBswModulesRef = CanIf
          WLC_02_oNIO_ES6_RF_CAN_SR_V3_0_3e708b41_Tx: PduRRoutingPathCommunicationType=COMMUNICATION_INTERFACE
            WLC_02_oNIO_ES6_RF_CAN_SR_V3_0_60d6e62c_Tx (PduRDestPdu):
              PduRDestPduHandleId = 3
              PduRDestPduDirection = TRANSMIT
              PduRDestPduRoutingType = API_FORWARDING
              PduRDestPduDataProcessing = IMMEDIATE
              PduRPduLengthHandlingStrategy = UNUSED
              PduRDestPduDataProvision = PDUR_DIRECT
              PduRTransmissionConfirmation = false
              PduRDestPduRef = WLC_02_oNIO_ES6_RF_CAN_SR_V3_0_60d6e62c_Tx
              PduRDestPduPduRBswModulesRef = CanIf
            PduRSrcPdu_19a519a0 (PduRSrcPdu): PduRSourcePduHandleId=4, PduRSrcPduDirection=TRANSMIT, PduRSrcPduRef=WLC_02_oNIO_ES6_RF_CAN_SR_V3_0_3e708b41_Tx, PduRSrcPduPduRBswModulesRef=Com
          CDC_IC_01_oNIO_ES6_RF_CAN_SR_V3_0_7ab33239_Rx: PduRRoutingPathCommunicationType=COMMUNICATION_INTERFACE
            CDC_IC_01_oNIO_ES6_RF_CAN_SR_V3_0_7ab33239_Rx_3feaaad3_Rx (PduRDestPdu):
              PduRDestPduHandleId = 1
              PduRDestPduDirection = RECEIVE
              PduRDestPduRoutingType = API_FORWARDING
              PduRDestPduDataProcessing = IMMEDIATE
              PduRPduLengthHandlingStrategy = UNUSED
              PduRTransmissionConfirmation = false
              PduRDestPduRef = CDC_IC_01_oNIO_ES6_RF_CAN_SR_V3_0_d7bf39a5_Rx
              PduRDestPduPduRBswModulesRef = Com
            PduRSrcPdu_3feaaad3 (PduRSrcPdu):
              PduRSourcePduHandleId = 1
              PduRSrcPduDirection = RECEIVE
              PduRSrcPduRef = CDC_IC_01_oNIO_ES6_RF_CAN_SR_V3_0_7ab33239_Rx
              PduRSrcPduPduRBswModulesRef = CanIf
          CDC_WLC_oNIO_ES6_RF_CAN_SR_V3_0_cbd6c32f_Rx: PduRRoutingPathCommunicationType=COMMUNICATION_INTERFACE
            CDC_WLC_oNIO_ES6_RF_CAN_SR_V3_0_cbd6c32f_Rx_8b049bb0_Rx (PduRDestPdu):
              PduRDestPduHandleId = 2
              PduRDestPduDirection = RECEIVE
              PduRDestPduRoutingType = API_FORWARDING
              PduRDestPduDataProcessing = IMMEDIATE
              PduRPduLengthHandlingStrategy = UNUSED
              PduRTransmissionConfirmation = false
              PduRDestPduRef = CDC_WLC_oNIO_ES6_RF_CAN_SR_V3_0_d2878c96_Rx
              PduRDestPduPduRBswModulesRef = Com
            PduRSrcPdu_8b049bb0 (PduRSrcPdu): PduRSourcePduHandleId=2, PduRSrcPduDirection=RECEIVE, PduRSrcPduRef=CDC_WLC_oNIO_ES6_RF_CAN_SR_V3_0_cbd6c32f_Rx, PduRSrcPduPduRBswModulesRef=CanIf
          DIAG_REQ_WLC_oNIO_ES6_RF_CAN_SR_V3_0_af2d88ff_Rx: PduRRoutingPathCommunicationType=TRANSPORT_PROTOCOL
            PduRSrcPdu_eddf36be (PduRSrcPdu):
              PduRSourcePduHandleId = 1
              PduRSrcPduDirection = RECEIVE
              PduRSrcPduRef = DIAG_REQ_WLC_oNIO_ES6_RF_CAN_SR_V3_0_af2d88ff_Rx
              PduRSrcPduPduRBswModulesRef = CanTp
            DIAG_REQ_WLC_oNIO_ES6_RF_CAN_SR_V3_0_af2d88ff_Rx_eddf36be_Rx (PduRDestPdu):
              PduRDestPduHandleId = 1
              PduRDestPduDirection = RECEIVE
              PduRDestPduRoutingType = API_FORWARDING
              PduRDestPduDataProcessing = IMMEDIATE
              PduRPduLengthHandlingStrategy = UNUSED
              PduRDestPduRef = DIAG_REQ_WLC_oNIO_ES6_RF_CAN_SR_V3_0_499b8fdc_Rx
              PduRDestPduPduRBswModulesRef = Dcm
          CGW_03_oNIO_ES6_RF_CAN_SR_V3_0_2fb1cd3a_Rx: PduRRoutingPathCommunicationType=COMMUNICATION_INTERFACE
            CGW_03_oNIO_ES6_RF_CAN_SR_V3_0_2fb1cd3a_Rx_8f6b5f25_Rx (PduRDestPdu):
              PduRDestPduHandleId = 4
              PduRDestPduDirection = RECEIVE
              PduRDestPduRoutingType = API_FORWARDING
              PduRDestPduDataProcessing = IMMEDIATE
              PduRPduLengthHandlingStrategy = UNUSED
              PduRTransmissionConfirmation = false
              PduRDestPduRef = CGW_03_oNIO_ES6_RF_CAN_SR_V3_0_0cc82007_Rx
              PduRDestPduPduRBswModulesRef = Com
            PduRSrcPdu_8f6b5f25 (PduRSrcPdu): PduRSourcePduHandleId=4, PduRSrcPduDirection=RECEIVE, PduRSrcPduRef=CGW_03_oNIO_ES6_RF_CAN_SR_V3_0_2fb1cd3a_Rx, PduRSrcPduPduRBswModulesRef=CanIf
          WLC_01_oNIO_ES6_RF_CAN_SR_V3_0_0b9d3d12_Tx: PduRRoutingPathCommunicationType=COMMUNICATION_INTERFACE
            PduRSrcPdu_2f5fea6f (PduRSrcPdu): PduRSourcePduHandleId=3, PduRSrcPduDirection=TRANSMIT, PduRSrcPduRef=WLC_01_oNIO_ES6_RF_CAN_SR_V3_0_0b9d3d12_Tx, PduRSrcPduPduRBswModulesRef=Com
            WLC_01_oNIO_ES6_RF_CAN_SR_V3_0_49299080_Tx (PduRDestPdu):
              PduRDestPduHandleId = 2
              PduRDestPduDirection = TRANSMIT
              PduRDestPduRoutingType = API_FORWARDING
              PduRDestPduDataProcessing = IMMEDIATE
              PduRPduLengthHandlingStrategy = UNUSED
              PduRDestPduDataProvision = PDUR_DIRECT
              PduRTransmissionConfirmation = false
              PduRDestPduRef = WLC_01_oNIO_ES6_RF_CAN_SR_V3_0_49299080_Tx
              PduRDestPduPduRBswModulesRef = CanIf
          DIAG_RESP_WLC_oNIO_ES6_RF_CAN_SR_V3_0_7db09b81_Tx: PduRRoutingPathCommunicationType=TRANSPORT_PROTOCOL
            PduRSrcPdu_cd65fdce (PduRSrcPdu):
              PduRSourcePduHandleId = 0
              PduRSrcPduDirection = TRANSMIT
              PduRSrcPduRef = DIAG_RESP_WLC_oNIO_ES6_RF_CAN_SR_V3_0_7db09b81_Tx
              PduRSrcPduPduRBswModulesRef = Dcm
            DIAG_RESP_WLC_oNIO_ES6_RF_CAN_SR_V3_0_ebfde8b0_Tx (PduRDestPdu):
              PduRDestPduHandleId = 0
              PduRDestPduDirection = TRANSMIT
              PduRDestPduRoutingType = API_FORWARDING
              PduRDestPduDataProcessing = IMMEDIATE
              PduRPduLengthHandlingStrategy = UNUSED
              PduRDestPduRef = DIAG_RESP_WLC_oNIO_ES6_RF_CAN_SR_V3_0_ebfde8b0_Tx
              PduRDestPduPduRBswModulesRef = CanTp
          CGW_02_oNIO_ES6_RF_CAN_SR_V3_0_371b1f5e_Rx: PduRRoutingPathCommunicationType=COMMUNICATION_INTERFACE
            PduRSrcPdu_f115c878 (PduRSrcPdu): PduRSourcePduHandleId=3, PduRSrcPduDirection=RECEIVE, PduRSrcPduRef=CGW_02_oNIO_ES6_RF_CAN_SR_V3_0_371b1f5e_Rx, PduRSrcPduPduRBswModulesRef=CanIf
            CGW_02_oNIO_ES6_RF_CAN_SR_V3_0_371b1f5e_Rx_f115c878_Rx (PduRDestPdu):
              PduRDestPduHandleId = 3
              PduRDestPduDirection = RECEIVE
              PduRDestPduRoutingType = API_FORWARDING
              PduRDestPduDataProcessing = IMMEDIATE
              PduRPduLengthHandlingStrategy = UNUSED
              PduRTransmissionConfirmation = false
              PduRDestPduRef = CGW_02_oNIO_ES6_RF_CAN_SR_V3_0_a943b009_Rx
              PduRDestPduPduRBswModulesRef = Com
          BCU_04_oNIO_ES6_RF_CAN_SR_V3_0_b06c3b94_Rx: PduRRoutingPathCommunicationType=COMMUNICATION_INTERFACE
            PduRSrcPdu_3ec2fcac (PduRSrcPdu): PduRSourcePduHandleId=0, PduRSrcPduDirection=RECEIVE, PduRSrcPduRef=BCU_04_oNIO_ES6_RF_CAN_SR_V3_0_b06c3b94_Rx, PduRSrcPduPduRBswModulesRef=CanIf
            BCU_04_oNIO_ES6_RF_CAN_SR_V3_0_b06c3b94_Rx_3ec2fcac_Rx (PduRDestPdu):
              PduRDestPduHandleId = 0
              PduRDestPduDirection = RECEIVE
              PduRDestPduRoutingType = API_FORWARDING
              PduRDestPduDataProcessing = IMMEDIATE
              PduRPduLengthHandlingStrategy = UNUSED
              PduRTransmissionConfirmation = false
              PduRDestPduRef = BCU_04_oNIO_ES6_RF_CAN_SR_V3_0_aafda74c_Rx
              PduRDestPduPduRBswModulesRef = Com
          CDC_WLC_NFC_CDDroute_RX: PduRRoutingPathCommunicationType=TRANSPORT_PROTOCOL
            PduRDestPdu:
              PduRDestPduHandleId = 2
              PduRDestPduDirection = RECEIVE
              PduRDestPduRoutingType = API_FORWARDING
              PduRDestPduDataProcessing = IMMEDIATE
              PduRPduLengthHandlingStrategy = UNUSED
              PduRDestPduRef = CDC_WLC_NFC_Pdu_CANTP
              PduRDestPduPduRBswModulesRef = CDDTp
            PduRSrcPdu: PduRSourcePduHandleId=2, PduRSrcPduDirection=RECEIVE, PduRSrcPduRef=CDC_WLC_NFC_Pdu_CANTP_001, PduRSrcPduPduRBswModulesRef=CanTp
          IMOB_CGW_WLC_PduRRoutingPath: PduRRoutingPathCommunicationType=COMMUNICATION_INTERFACE
            PduRDestPdu_1 (PduRDestPdu):
              PduRDestPduHandleId = 7
              PduRDestPduDirection = RECEIVE
              PduRDestPduRoutingType = API_FORWARDING
              PduRDestPduDataProcessing = IMMEDIATE
              PduRPduLengthHandlingStrategy = UNUSED
              PduRTransmissionConfirmation = false
              PduRDestPduRef = IMOB_CGW_WLC_oNIO_ES6_RF_CDDasCanTp
              PduRDestPduPduRBswModulesRef = CDDTp
            PduRSrcPdu_1 (PduRSrcPdu):
              PduRSourcePduHandleId = 7
              PduRSrcPduDirection = RECEIVE
              PduRSrcPduRef = IMOB_CGW_WLC_oNIO_ES6_RF_CAN_SR_V3_0_da4d0319_Rx
              PduRSrcPduPduRBswModulesRef = CanIf
          IMOB_WLC_CGW_oNIO_ES6_RF_CAN: PduRRoutingPathCommunicationType=COMMUNICATION_INTERFACE
            PduRDestPdu_2 (PduRDestPdu):
              PduRDestPduHandleId = 0
              PduRDestPduDirection = TRANSMIT
              PduRDestPduRoutingType = API_FORWARDING
              PduRDestPduDataProcessing = IMMEDIATE
              PduRPduLengthHandlingStrategy = UNUSED
              PduRDestPduDataProvision = PDUR_DIRECT
              PduRTransmissionConfirmation = true
              PduRDestPduRef = IMOB_WLC_CGW_oNIO_ES6_RF_CAN_SR_V3_0_efb0805f_Tx
              PduRDestPduPduRBswModulesRef = CanIf
            PduRSrcPdu_2 (PduRSrcPdu): PduRSourcePduHandleId=1, PduRSrcPduDirection=TRANSMIT, PduRSrcPduRef=IMOB_WLC_CGW_oNIO_ES6_RF_CAN_CDDAsCanTp, PduRSrcPduPduRBswModulesRef=CDDTp
          WLC_CDC_NFC_oNIO_ES6_RF_CAN_PduRRoutingPath_Tx: PduRRoutingPathCommunicationType=TRANSPORT_PROTOCOL
            PduRDestPdu_3 (PduRDestPdu):
              PduRDestPduHandleId = 1
              PduRDestPduDirection = TRANSMIT
              PduRDestPduRoutingType = API_FORWARDING
              PduRDestPduDataProcessing = IMMEDIATE
              PduRPduLengthHandlingStrategy = UNUSED
              PduRDestPduRef = WLC_CDC_NFC_oNIO_ES6_RF_CAN_CDDAsCanTp_001
              PduRDestPduPduRBswModulesRef = CanTp
            PduRSrcPdu_3 (PduRSrcPdu): PduRSourcePduHandleId=5, PduRSrcPduDirection=TRANSMIT, PduRSrcPduRef=WLC_CDC_NFC_oNIO_ES6_RF_CAN_CDDAsCanTp, PduRSrcPduPduRBswModulesRef=CDDTp
          WLC_DEVLP_01_oNIO_ES6_RF_CAN_PduRRoutingPath: PduRRoutingPathCommunicationType=COMMUNICATION_INTERFACE
            PduRDestPdu_4 (PduRDestPdu):
              PduRDestPduHandleId = 4
              PduRDestPduDirection = TRANSMIT
              PduRDestPduRoutingType = API_FORWARDING
              PduRDestPduDataProcessing = IMMEDIATE
              PduRPduLengthHandlingStrategy = UNUSED
              PduRDestPduDataProvision = PDUR_DIRECT
              PduRTransmissionConfirmation = true
              PduRDestPduRef = WLC_DEVLP_01_oNIO_ES6_RF_CAN_SR_V3_0_0423feed_Tx
              PduRDestPduPduRBswModulesRef = CanIf
            PduRSrcPdu_4 (PduRSrcPdu): PduRSourcePduHandleId=6, PduRSrcPduDirection=TRANSMIT, PduRSrcPduRef=WLC_DEVLP_01_oNIO_ES6_RF_CAN_CDDasCanTp, PduRSrcPduPduRBswModulesRef=CDDTp
          WLC_DEVLP_02_oNIO_ES6_RF_CAN_PduRRoutingPath: PduRRoutingPathCommunicationType=COMMUNICATION_INTERFACE
            PduRDestPdu_5 (PduRDestPdu):
              PduRDestPduHandleId = 8
              PduRDestPduDirection = RECEIVE
              PduRDestPduRoutingType = API_FORWARDING
              PduRDestPduDataProcessing = IMMEDIATE
              PduRPduLengthHandlingStrategy = UNUSED
              PduRTransmissionConfirmation = false
              PduRDestPduRef = WLC_DEVLP_02_oNIO_ES6_RF_CAN_CDDasCanTp
              PduRDestPduPduRBswModulesRef = CDDTp
            PduRSrcPdu_5 (PduRSrcPdu):
              PduRSourcePduHandleId = 8
              PduRSrcPduDirection = RECEIVE
              PduRSrcPduRef = WLC_DEVLP_02_oNIO_ES6_RF_CAN_SR_V3_0_2ddc8841_Rx
              PduRSrcPduPduRBswModulesRef = CanIf
      PduRLock_PduRExclusiveArea (PduRLock)
        PduRExclusiveArea: PduRExclusiveAreaId=0
    6 x PduRBswModules, all with PduRCancelReceive=false, PduRCancelTransmit=false, PduRChangeParameterRequestApi=false:
      CanIf: PduRCommunicationInterface=true, PduRLowerModule=true, PduRTransportProtocol=false, PduRTriggertransmit=false, PduRTxConfirmation=true, PduRUpperModule=false, PduRUseTag=false, PduRBswModuleRef=CanIf
      CanNm: PduRCommunicationInterface=true, PduRLowerModule=true, PduRTransportProtocol=false, PduRTriggertransmit=true, PduRTxConfirmation=false, PduRUpperModule=false, PduRUseTag=false, PduRBswModuleRef=CanNm
      CanTp: PduRCommunicationInterface=false, PduRLowerModule=true, PduRTransportProtocol=true, PduRTriggertransmit=false, PduRTxConfirmation=false, PduRUpperModule=false, PduRUseTag=false, PduRBswModuleRef=CanTp
      Com: PduRCommunicationInterface=true, PduRLowerModule=false, PduRTransportProtocol=false, PduRTriggertransmit=true, PduRTxConfirmation=false, PduRUpperModule=true, PduRUseTag=false, PduRBswModuleRef=Com
      Dcm: PduRCommunicationInterface=false, PduRLowerModule=false, PduRTransportProtocol=true, PduRTriggertransmit=false, PduRTxConfirmation=false, PduRUpperModule=true, PduRUseTag=true, PduRBswModuleRef=Dcm
      CDDTp: PduRCommunicationInterface=false, PduRLowerModule=false, PduRTransportProtocol=true, PduRTriggertransmit=false, PduRTxConfirmation=true, PduRUpperModule=true, PduRUseTag=true, PduRBswModuleRef=Cdd
