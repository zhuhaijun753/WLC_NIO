AUTOSAR XML (schema 4-2-1)
package /ActiveEcuC
  module config Cdd: implementation-config-variant=VARIANT-PRE-COMPILE, module-description=Cdd_Impl
    CddComStackContribution
      CddPduRUpperLayerContribution
        CDC_WLC_NFC_Pdu_CANTP (CddPduRUpperLayerRxPdu): CddPduRUpperLayerHandleId=0, CddPduRUpperLayerPduRef=CDC_WLC_NFC_Pdu_CANTP
        IMOB_CGW_WLC_CddPduRUpperLayerRxPdu (CddPduRUpperLayerRxPdu): CddPduRUpperLayerHandleId=2, CddPduRUpperLayerPduRef=IMOB_CGW_WLC_oNIO_ES6_RF_CDDasCanTp
        3 x CddPduRUpperLayerTxPdu:
          IMOB_WLC_CGW_oNIO_ES6_RF_CAN_CddPduRUpperLayerRxPdu: CddPduRUpperLayerHandleId=1, CddPduRUpperLayerPduRef=IMOB_WLC_CGW_oNIO_ES6_RF_CAN_CDDAsCanTp
          WLC_CDC_NFC_oNIO_ES6_RF_CAN_CddPduRUpperLayerTxPdu: CddPduRUpperLayerHandleId=2, CddPduRUpperLayerPduRef=WLC_CDC_NFC_oNIO_ES6_RF_CAN_CDDAsCanTp
          WLC_DEVLP_01_oNIO_ES6_RF_CAN_CddPduRUpperLayerTxPdu: CddPduRUpperLayerHandleId=0, CddPduRUpperLayerPduRef=WLC_DEVLP_01_oNIO_ES6_RF_CAN_CDDasCanTp
        WLC_DEVLP_02_oNIO_ES6_RF_CAN_CddPduRUpperLayerRxPdu (CddPduRUpperLayerRxPdu): CddPduRUpperLayerHandleId=1, CddPduRUpperLayerPduRef=WLC_DEVLP_02_oNIO_ES6_RF_CAN_CDDasCanTp
