AUTOSAR XML (schema 4-2-1)
package /ActiveEcuC
  module config vSet: implementation-config-variant=VARIANT-PRE-COMPILE, module-description=vSet_Impl
    vSetGeneral: vSetDummyStatementKind=SelfAssignment
    vSetPlatform:
      vSetSizeOfRAMPointer = Size32Bit
      vSetSizeOfInt = Size32Bit
      vSetBitOrder = LSB_to_MSB
      vSetCPUType = CPU32Bit
      vSetSizeOfEnum = Size32Bit
      vSetSizeOfROMPointer = Size32Bit
      vSetByteOrder = LITTLE_ENDIAN
    vSetCalibration
