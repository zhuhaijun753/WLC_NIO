AUTOSAR XML (schema 4-2-1)
package /ActiveEcuC
  module config Mcu: implementation-config-variant=VARIANT-POST-BUILD, module-description=Mcu_Impl
    McuModuleConfiguration:
      McuClockSrcFailureNotification = DISABLED
      McuCyclicRunModeBaseAddress = 4273963008
      McuLviDetectionLevel = DETECTION_LEVEL_0
      McuLviResetMask = RESET_REQUEST
      McuNumberOfMcuModes = 1
      McuRamSectors = 0
      McuRetentionRamAddress = 4273963008
      McuDemEventParameterRefs:
        MCU_E_CLOCK_FAILURE = DemEventParameter
        MCU_E_CVM_SETTING_FAILURE = DemEventParameter_001
        MCU_E_INCONCISTENCY_RESF_FAILURE = DemEventParameter_003
        MCU_E_LVI_FAILURE = DemEventParameter_004
        MCU_E_WRITE_TIMEOUT_FAILURE = DemEventParameter_006
        MCU_E_REG_WRITE_VERIFY = DemEventParameter_005
      McuModeSettingConf:
        McuMainOscOperation = true
        McuMode = 0
        McuModeTransitionReq = true
        McuModeType = RUN_MODE
        McuWakeUpFactor{0..2} = false
        McuWakeUpFactorIso0 = false
      McuClockSettingConfig:
        Mcu8MhzRingStopRequestMask = true
        McuClkModeSelect = MCU_EMCLK_ID_1
        McuClockSettingId = 0
        McuCpuClockDivider = DIVBY_1_ID_1
        McuCpuMainSysClk = 8000000
        McuOPBT0 = 3123183567
        McuUnitName = CPUCLK
        McuClockReferencePoint: McuClockReferencePointFrequency=0
        McuClockReferencePoint_CAN (McuClockReferencePoint): McuClockReferencePointFrequency=0
    McuGeneralConfiguration:
      McuClm0MonitoringClockAccuracy = 9
      McuClm0Operation = false
      McuClm0SamplingClockAccuracy = 9
      McuClm1MonitoringClockAccuracy = 9
      McuClm1Operation = false
      McuClm1SamplingClockAccuracy = 9
      McuClm2MonitoringClockAccuracy = 14
      McuClm2Operation = false
      McuClm2SamplingClockAccuracy = 14
      McuClm3MonitoringClockAccuracy = 14
      McuClm3Operation = false
      McuClm3SamplingClockAccuracy = 14
      McuCopyToSection = true
      McuCriticalSectionProtection = true
      McuCvmHighVoltageDetect = false
      McuCvmLowVoltageDetect = false
      McuDevErrorDetect = false
      McuDeviceName = R7F701649
      McuGetRamStateApi = false
      McuInitClock = true
      McuLoopCount = 5
      McuLowPowerSequencerOperation = false
      McuNoPll = false
      McuPerformResetApi = false
      McuPortGroupStatusBackUp = false
      McuRAMMirror = DISABLE
      McuResetReasonMultipleResets = true
      McuRetentionRamSourceAddress = 65536
      McuSwResetCallApi = false
      McuUseWriteVerifyErrorInterface = false
      McuVersionCheckExternalModules = false
      McuVersionInfoApi = false
      McuWakeUpFactorClearIsr = false
      McuWakeUpFactorsClearCentralised = true
      McuWriteVerify = WV_DISABLE
    McuPublishedInformation
      McuRstRsnConfClm3: McuResetReason=15
      McuRstRsnConfResf13: McuResetReason=14
      McuRstRsnConfLvi: McuResetReason=7
      McuRstRsnConfSwRst: McuResetReason=1
      McuRstRsnConfTer: McuResetReason=9
      McuRstRsnConfMultipleResets: McuResetReason=17
      McuRstRsnConfUnknown: McuResetReason=18
      McuRstRsnConfIso: McuResetReason=11
      McuRstRsnConfClm0: McuResetReason=4
      McuRstRsnConfClm1: McuResetReason=5
      McuRstRsnConfResf11: McuResetReason=12
      McuRstRsnConfWdta1: McuResetReason=3
      McuRstRsnConfUndef: McuResetReason=16
      McuRstRsnConfWdta0: McuResetReason=2
      McuRstRsnConfCvm: McuResetReason=8
      McuRstRsnConfPOR: McuResetReason=10
      McuRstRsnConfResf12: McuResetReason=13
      McuResetReasonConf: McuResetReason=0
    McuRamInitConfiguration: McuRamInitBaseAddress=4273733632, McuRamInitSize=256, McuRamInitValue=255, McuRamTypeSelection=CPU_LOCAL_RAM, McuRamWriteSizeSel=BIT_8
