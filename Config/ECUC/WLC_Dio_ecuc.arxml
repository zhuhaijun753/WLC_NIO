AUTOSAR XML (schema 4-2-1)
package /ActiveEcuC
  module config Dio: implementation-config-variant=VARIANT-LINK-TIME, module-description=Dio_Impl
    DioGeneral:
      DioVersionCheckExternalModules = false
      DioDevErrorDetect = true
      DioFlipChannelApi = false
      DioVersionInfoApi = false
      DioCriticalSectionProtection = false
      DioDeviceName = R7F701649
      DioMaskedWritePortApi = false
      DioRAMMirror = DISABLE
      DioReadChannelGroupOutputValueApi = false
      DioReadChannelOutputValueApi = false
      DioUseWriteVerifyErrorInterface = false
      DioWriteVerify = WV_DISABLE
    DioConfig
      DioPort: DioPortId=0, DioPortName=PORTGROUP_0_BITS_0_TO_14
        DioChannel_TooglePort (DioChannel): DioChannelId=0, DioChannelBitPosition=11
