AUTOSAR XML (schema 4-2-1)
package /ActiveEcuC
  ecuc value collection ActiveEcuC: ecu-extract=SYSTEM, ecuc-values=[Com, Mcu, Rte, EcuM, CanNm, Os, PduR, Dem, CanSM, Dcm, CanTp, Nm, Can, CanIf, Det, ComM, EcuC, BswM, Dio, vSet, Cdd, Crc]
