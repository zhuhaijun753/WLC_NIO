AUTOSAR XML (schema 4-2-1)
package /ActiveEcuC
  module config Com: implementation-config-variant=VARIANT-PRE-COMPILE, module-description=Com_Impl
    ComGeneration:
      ComOutOfBoundsWriteProtectionStrategy = NONE
      ComOutOfBoundsWriteSanitizer = false
      ComOutOfBoundsReadSanitizer = false
      ComReduceConstantData2Define = false
      ComBoolDataInArrayOfStructStrategy = BOOLEAN
      ComDeduplicateIndirectedData = true
      ComDataDeduplicationStrategy = WITH_CAST
      ComReduceBoolDataByNegationThreshold = 2
      ComReduceBoolDataByNumericalComparisonThreshold = 2
      ComReduceBoolDataByNumericalRelationThreshold = 2
      ComReduceBoolDataByNumericalOperandStrategy = WITH_ANY_VALUE
      ComReduceNumericalDataByOffsetThreshold = 2
      ComReduceNumericalDataByArraySubtractionThreshold = 2
      ComReduceDataByStreaming = false
      ComShortSymbols = false
      ComInterfacesForDeactivatedData = false
      ComReferringKeysInComments = false
    ComOptimization:
      ComTxCyclicProcessingISRLockThreshold = 1
      ComTxDeadlineMonitoringISRLockThreshold = 1
      ComTxProcessingISRLockThreshold = 1
      ComRxDeadlineMonitoringISRLockThreshold = 1
      ComRxDeferredProcessingISRLockThreshold = 1
      ComGatewayProcessingISRLockThreshold = 1
      ComGatewayDescriptionProcessingISRLockThreshold = 1
      ComIPduGroupISRLockThreshold = 1
    ComConfig: ComConfigurationId=0, ComRxDeferredNotificationCacheSize=0, ComRxImmediateNotificationCacheSize=0
      NM_WLC_oNIO_ES6_RF_CAN_SR_V3_0_9357dd65_Tx (ComIPdu):
        ComIPduDirection = SEND
        ComIPduType = NORMAL
        ComIPduHandleId = 0
        ComIPduSignalProcessing = DEFERRED
        ComIPduCancellationSupport = false
        ComIPduSignalRef = UsrData0_WLC_oNM_WLC_oNIO_ES6_RF_CAN_SR_V3_0_9b82ce18_Tx
        ComIPduSignalRef = UsrData1_WLC_oNM_WLC_oNIO_ES6_RF_CAN_SR_V3_0_1b72d907_Tx
        ComIPduSignalRef = UsrData2_WLC_oNM_WLC_oNIO_ES6_RF_CAN_SR_V3_0_4113e667_Tx
        ComIPduSignalRef = UsrData3_WLC_oNM_WLC_oNIO_ES6_RF_CAN_SR_V3_0_c1e3f178_Tx
        ComIPduSignalRef = UsrData4_WLC_oNM_WLC_oNIO_ES6_RF_CAN_SR_V3_0_f5d198a7_Tx
        ComIPduSignalRef = UsrData5_WLC_oNM_WLC_oNIO_ES6_RF_CAN_SR_V3_0_75218fb8_Tx
        ComPduIdRef = NM_WLC_oNIO_ES6_RF_CAN_SR_V3_0_9357dd65_Tx
        ComTxIPdu: ComTxIPduUnusedAreasDefault=0, ComMinimumDelayTime=0  # NM_WLC_oNIO_ES6_RF_CAN_SR_V3_0
          ComTxModeTrue
            ComTxMode: ComTxModeMode=NONE
          ComTxModeFalse
            ComTxMode: ComTxModeMode=NONE
      VehSpd_oBCU_04_oNIO_ES6_RF_CAN_SR_V3_0_91cf0813_Rx (ComSignal):
        ComBitPosition = 20
        ComBitSize = 13
        ComSignalEndianness = BIG_ENDIAN
        ComSignalInitValue = 0
        ComSignalType = UINT16
        ComTimeout = 0.15
        ComSignalAccess = ACCESS_UNCLEAR
        ComHandleId = 13
        ComSystemTemplateSystemSignalRef = VehSpd
      CDC_WLC_oNIO_ES6_RF_CAN_SR_V3_0_d2878c96_Rx (ComIPdu):
        ComIPduDirection = RECEIVE
        ComIPduType = NORMAL
        ComIPduHandleId = 2
        ComIPduSignalProcessing = DEFERRED
        ComIPduCancellationSupport = false
        ComIPduGroupRef = WLC_oNIO_ES6_RF_CAN_SR_V3_0_Rx_42316af2
        ComIPduSignalRef = WLCChrgFctEnaReq_oCDC_WLC_oNIO_ES6_RF_CAN_SR_V3_0_e37de241_Rx
        ComPduIdRef = CDC_WLC_oNIO_ES6_RF_CAN_SR_V3_0_d2878c96_Rx
      WLCChrgFctEnaReq_oCDC_WLC_oNIO_ES6_RF_CAN_SR_V3_0_e37de241_Rx (ComSignal):
        ComBitPosition = 1
        ComBitSize = 2
        ComSignalEndianness = BIG_ENDIAN
        ComSignalInitValue = 0
        ComSignalType = UINT8
        ComTimeout = 0.5
        ComSignalAccess = ACCESS_UNCLEAR
        ComHandleId = 16
        ComSystemTemplateSystemSignalRef = WLCChrgFctEnaReq
      WLC_oNIO_ES6_RF_CAN_SR_V3_0_Tx_146bcd74 (ComIPduGroup): ComIPduGroupHandleId=1
      8 x ComSignal, all with ComSignalEndianness=BIG_ENDIAN, ComSignalInitValue=0, ComSignalAccess=ACCESS_UNCLEAR:
        WLCMuteViaHW_oWLC_01_oNIO_ES6_RF_CAN_SR_V3_0_990775ce_Tx: ComBitPosition=10, ComBitSize=1, ComSignalType=BOOLEAN, ComTimeout=0, ComTransferProperty=PENDING, ComHandleId=11, ComSystemTemplateSystemSignalRef=WLCMuteViaHW
        UsrData2_WLC_oNM_WLC_oNIO_ES6_RF_CAN_SR_V3_0_4113e667_Tx: ComBitPosition=23, ComBitSize=8, ComSignalType=UINT8, ComTransferProperty=PENDING, ComHandleId=2, ComSystemTemplateSystemSignalRef=UsrData2_WLC
        WLCFailSts_oWLC_01_oNIO_ES6_RF_CAN_SR_V3_0_882ea33c_Tx: ComBitPosition=23, ComBitSize=4, ComSignalType=UINT8, ComTimeout=0, ComTransferProperty=PENDING, ComHandleId=9, ComSystemTemplateSystemSignalRef=WLCFailSts
        CGW_03_MsgCntr_oCGW_03_oNIO_ES6_RF_CAN_SR_V3_0_3e603ff9_Rx: ComBitPosition=15, ComBitSize=4, ComSignalType=UINT8, ComTimeout=0.15, ComHandleId=1, ComSystemTemplateSystemSignalRef=CGW_03_MsgCntr
        Min_oCGW_TCU_01_oNIO_ES6_RF_CAN_SR_V3_0_c05ffcb3_Rx: ComBitPosition=37, ComBitSize=6, ComSignalType=UINT8, ComTimeout=5, ComHandleId=9, ComSystemTemplateSystemSignalRef=Min
        Mth_oCGW_TCU_01_oNIO_ES6_RF_CAN_SR_V3_0_a0768b21_Rx: ComBitPosition=11, ComBitSize=4, ComSignalType=UINT8, ComTimeout=5, ComHandleId=10, ComSystemTemplateSystemSignalRef=Mth
        ComfEna_oCGW_02_oNIO_ES6_RF_CAN_SR_V3_0_1a60ba8c_Rx: ComBitPosition=3, ComBitSize=2, ComSignalType=UINT8, ComTimeout=0.15, ComHandleId=5, ComSystemTemplateSystemSignalRef=ComfEna
        Sec_oCGW_TCU_01_oNIO_ES6_RF_CAN_SR_V3_0_48a1d09a_Rx: ComBitPosition=45, ComBitSize=6, ComSignalType=UINT8, ComTimeout=5, ComHandleId=11, ComSystemTemplateSystemSignalRef=Sec
      CGW_WLC_oNIO_ES6_RF_CAN_SR_V3_0_4780465a_Rx (ComIPdu):
        ComIPduDirection = RECEIVE
        ComIPduType = NORMAL
        ComIPduHandleId = 6
        ComIPduSignalProcessing = DEFERRED
        ComIPduCancellationSupport = false
        ComIPduGroupRef = WLC_oNIO_ES6_RF_CAN_SR_V3_0_Rx_42316af2
        ComIPduSignalRef = CGW_WLC_CRC_oCGW_WLC_oNIO_ES6_RF_CAN_SR_V3_0_67a87047_Rx
        ComIPduSignalRef = CGW_WLC_MsgCntr_oCGW_WLC_oNIO_ES6_RF_CAN_SR_V3_0_2e39b55e_Rx
        ComPduIdRef = CGW_WLC_oNIO_ES6_RF_CAN_SR_V3_0_4780465a_Rx
      WLCChrgRate_oWLC_01_oNIO_ES6_RF_CAN_SR_V3_0_b69382aa_Tx (ComSignal):
        ComBitPosition = 9
        ComBitSize = 2
        ComSignalEndianness = BIG_ENDIAN
        ComSignalInitValue = 0
        ComSignalType = UINT8
        ComTimeout = 0
        ComTransferProperty = PENDING
        ComSignalAccess = ACCESS_UNCLEAR
        ComHandleId = 6
        ComSystemTemplateSystemSignalRef = WLCChrgRate
      CGW_03_oNIO_ES6_RF_CAN_SR_V3_0_0cc82007_Rx (ComIPdu):
        ComIPduDirection = RECEIVE
        ComIPduType = NORMAL
        ComIPduHandleId = 4
        ComIPduSignalProcessing = DEFERRED
        ComIPduCancellationSupport = false
        ComIPduGroupRef = WLC_oNIO_ES6_RF_CAN_SR_V3_0_Rx_42316af2
        ComIPduSignalRef = CGW_03_CRC_oCGW_03_oNIO_ES6_RF_CAN_SR_V3_0_bd877a03_Rx
        ComIPduSignalRef = CGW_03_MsgCntr_oCGW_03_oNIO_ES6_RF_CAN_SR_V3_0_3e603ff9_Rx
        ComIPduSignalRef = ComfEna_ASIL_oCGW_03_oNIO_ES6_RF_CAN_SR_V3_0_daac19b6_Rx
        ComIPduSignalRef = VehState_ASIL_oCGW_03_oNIO_ES6_RF_CAN_SR_V3_0_3e049202_Rx
        ComPduIdRef = CGW_03_oNIO_ES6_RF_CAN_SR_V3_0_0cc82007_Rx
      WLC_01_oNIO_ES6_RF_CAN_SR_V3_0_0b9d3d12_Tx (ComIPdu):
        ComIPduDirection = SEND
        ComIPduType = NORMAL
        ComIPduHandleId = 1
        ComIPduSignalProcessing = DEFERRED
        ComIPduCancellationSupport = false
        ComIPduGroupRef = WLC_oNIO_ES6_RF_CAN_SR_V3_0_Tx_146bcd74
        ComIPduSignalRef = WLCChrgRate_oWLC_01_oNIO_ES6_RF_CAN_SR_V3_0_b69382aa_Tx
        ComIPduSignalRef = WLCChrgSts_oWLC_01_oNIO_ES6_RF_CAN_SR_V3_0_eda08377_Tx
        ComIPduSignalRef = WLCCtrlSts_oWLC_01_oNIO_ES6_RF_CAN_SR_V3_0_a083bd17_Tx
        ComIPduSignalRef = WLCFailSts_oWLC_01_oNIO_ES6_RF_CAN_SR_V3_0_882ea33c_Tx
        ComIPduSignalRef = WLCMuteViaHW_oWLC_01_oNIO_ES6_RF_CAN_SR_V3_0_990775ce_Tx
        ComIPduSignalRef = WLC_01_CRC_oWLC_01_oNIO_ES6_RF_CAN_SR_V3_0_705754f3_Tx
        ComIPduSignalRef = WLC_01_MsgCntr_oWLC_01_oNIO_ES6_RF_CAN_SR_V3_0_c3fc8f8f_Tx
        ComPduIdRef = WLC_01_oNIO_ES6_RF_CAN_SR_V3_0_0b9d3d12_Tx
        ComTxIPdu: ComMinimumDelayTime=0, ComTxIPduUnusedAreasDefault=0
          ComTxModeTrue
            ComTxMode: ComTxModeMode=PERIODIC, ComTxModeTimeOffset=0, ComTxModeTimePeriod=1
          ComTxModeFalse
            ComTxMode: ComTxModeMode=PERIODIC, ComTxModeTimeOffset=0, ComTxModeTimePeriod=1
      5 x ComSignal, all with ComSignalEndianness=BIG_ENDIAN, ComSignalInitValue=0, ComSignalAccess=ACCESS_UNCLEAR:
        VehOdometer_oCDC_IC_01_oNIO_ES6_RF_CAN_SR_V3_0_c4f897da_Rx: ComBitPosition=7, ComBitSize=24, ComSignalType=UINT32, ComTimeout=5, ComHandleId=12, ComSystemTemplateSystemSignalRef=VehOdometer
        Yr_oCGW_TCU_01_oNIO_ES6_RF_CAN_SR_V3_0_cdf9e710_Rx: ComBitPosition=7, ComBitSize=8, ComSignalType=UINT8, ComTimeout=5, ComHandleId=17, ComSystemTemplateSystemSignalRef=Yr
        UsrData1_WLC_oNM_WLC_oNIO_ES6_RF_CAN_SR_V3_0_1b72d907_Tx: ComBitPosition=15, ComBitSize=8, ComSignalType=UINT8, ComTransferProperty=PENDING, ComHandleId=1, ComSystemTemplateSystemSignalRef=UsrData1_WLC
        WLC_01_MsgCntr_oWLC_01_oNIO_ES6_RF_CAN_SR_V3_0_c3fc8f8f_Tx: ComBitPosition=15, ComBitSize=4, ComSignalType=UINT8, ComTimeout=0, ComTransferProperty=PENDING, ComHandleId=13, ComSystemTemplateSystemSignalRef=WLC_01_MsgCntr
        UsrData4_WLC_oNM_WLC_oNIO_ES6_RF_CAN_SR_V3_0_f5d198a7_Tx: ComBitPosition=39, ComBitSize=8, ComSignalType=UINT8, ComTransferProperty=PENDING, ComHandleId=4, ComSystemTemplateSystemSignalRef=UsrData4_WLC
      BCU_04_oNIO_ES6_RF_CAN_SR_V3_0_aafda74c_Rx (ComIPdu):
        ComIPduDirection = RECEIVE
        ComIPduType = NORMAL
        ComIPduHandleId = 0
        ComIPduSignalProcessing = DEFERRED
        ComIPduCancellationSupport = false
        ComIPduGroupRef = WLC_oNIO_ES6_RF_CAN_SR_V3_0_Rx_42316af2
        ComIPduSignalRef = VehSpd_oBCU_04_oNIO_ES6_RF_CAN_SR_V3_0_91cf0813_Rx
        ComPduIdRef = BCU_04_oNIO_ES6_RF_CAN_SR_V3_0_aafda74c_Rx
      CGW_02_oNIO_ES6_RF_CAN_SR_V3_0_a943b009_Rx (ComIPdu):
        ComIPduDirection = RECEIVE
        ComIPduType = NORMAL
        ComIPduHandleId = 3
        ComIPduSignalProcessing = DEFERRED
        ComIPduCancellationSupport = false
        ComIPduGroupRef = WLC_oNIO_ES6_RF_CAN_SR_V3_0_Rx_42316af2
        ComIPduSignalRef = ComfEna_oCGW_02_oNIO_ES6_RF_CAN_SR_V3_0_1a60ba8c_Rx
        ComIPduSignalRef = ImobEnaReq_oCGW_02_oNIO_ES6_RF_CAN_SR_V3_0_a2f30745_Rx
        ComIPduSignalRef = VehState_oCGW_02_oNIO_ES6_RF_CAN_SR_V3_0_70d412f9_Rx
        ComPduIdRef = CGW_02_oNIO_ES6_RF_CAN_SR_V3_0_a943b009_Rx
      WLC_02_MsgCntr_oWLC_02_oNIO_ES6_RF_CAN_SR_V3_0_15588e7e_Tx (ComSignal):
        ComBitPosition = 15
        ComBitSize = 4
        ComSignalEndianness = BIG_ENDIAN
        ComSignalInitValue = 0
        ComSignalType = UINT8
        ComTimeout = 0
        ComTransferProperty = PENDING
        ComSignalAccess = ACCESS_UNCLEAR
        ComHandleId = 15
        ComSystemTemplateSystemSignalRef = WLC_02_MsgCntr
      ComTimeBase: ComRxTimeBase=0.01, ComTxTimeBase=0.01, ComGwTimeBase=0.01
      CDC_IC_01_oNIO_ES6_RF_CAN_SR_V3_0_d7bf39a5_Rx (ComIPdu):
        ComIPduDirection = RECEIVE
        ComIPduType = NORMAL
        ComIPduHandleId = 1
        ComIPduSignalProcessing = DEFERRED
        ComIPduCancellationSupport = false
        ComIPduGroupRef = WLC_oNIO_ES6_RF_CAN_SR_V3_0_Rx_42316af2
        ComIPduSignalRef = VehOdometer_oCDC_IC_01_oNIO_ES6_RF_CAN_SR_V3_0_c4f897da_Rx
        ComPduIdRef = CDC_IC_01_oNIO_ES6_RF_CAN_SR_V3_0_d7bf39a5_Rx
      3 x ComSignal, all with ComSignalEndianness=BIG_ENDIAN, ComSignalInitValue=0, ComSignalType=UINT8, ComSignalAccess=ACCESS_UNCLEAR:
        WLCChrgSts_oWLC_01_oNIO_ES6_RF_CAN_SR_V3_0_eda08377_Tx: ComBitPosition=19, ComBitSize=2, ComTimeout=0, ComTransferProperty=PENDING, ComHandleId=7, ComSystemTemplateSystemSignalRef=WLCChrgSts
        CGW_WLC_MsgCntr_oCGW_WLC_oNIO_ES6_RF_CAN_SR_V3_0_2e39b55e_Rx: ComBitPosition=15, ComBitSize=4, ComTimeout=5, ComHandleId=3, ComSystemTemplateSystemSignalRef=CGW_WLC_MsgCntr
        CGW_WLC_CRC_oCGW_WLC_oNIO_ES6_RF_CAN_SR_V3_0_67a87047_Rx: ComBitPosition=7, ComBitSize=8, ComTimeout=5, ComHandleId=2, ComSystemTemplateSystemSignalRef=CGW_WLC_CRC
      CGW_TCU_01_oNIO_ES6_RF_CAN_SR_V3_0_49a017d3_Rx (ComIPdu):
        ComIPduDirection = RECEIVE
        ComIPduType = NORMAL
        ComIPduHandleId = 5
        ComIPduSignalProcessing = DEFERRED
        ComIPduCancellationSupport = false
        ComIPduGroupRef = WLC_oNIO_ES6_RF_CAN_SR_V3_0_Rx_42316af2
        ComIPduSignalRef = Day_oCGW_TCU_01_oNIO_ES6_RF_CAN_SR_V3_0_76626f65_Rx
        ComIPduSignalRef = Hr_oCGW_TCU_01_oNIO_ES6_RF_CAN_SR_V3_0_f5c3e99f_Rx
        ComIPduSignalRef = Min_oCGW_TCU_01_oNIO_ES6_RF_CAN_SR_V3_0_c05ffcb3_Rx
        ComIPduSignalRef = Mth_oCGW_TCU_01_oNIO_ES6_RF_CAN_SR_V3_0_a0768b21_Rx
        ComIPduSignalRef = Sec_oCGW_TCU_01_oNIO_ES6_RF_CAN_SR_V3_0_48a1d09a_Rx
        ComIPduSignalRef = Yr_oCGW_TCU_01_oNIO_ES6_RF_CAN_SR_V3_0_cdf9e710_Rx
        ComPduIdRef = CGW_TCU_01_oNIO_ES6_RF_CAN_SR_V3_0_49a017d3_Rx
      3 x ComSignal, all with ComSignalEndianness=BIG_ENDIAN, ComSignalInitValue=0, ComSignalType=UINT8, ComSignalAccess=ACCESS_UNCLEAR:
        ImobEnaReq_oCGW_02_oNIO_ES6_RF_CAN_SR_V3_0_a2f30745_Rx: ComBitPosition=15, ComBitSize=2, ComTimeout=0.15, ComHandleId=8, ComSystemTemplateSystemSignalRef=ImobEnaReq
        UsrData5_WLC_oNM_WLC_oNIO_ES6_RF_CAN_SR_V3_0_75218fb8_Tx: ComBitPosition=47, ComBitSize=8, ComTransferProperty=PENDING, ComHandleId=5, ComSystemTemplateSystemSignalRef=UsrData5_WLC
        Day_oCGW_TCU_01_oNIO_ES6_RF_CAN_SR_V3_0_76626f65_Rx: ComBitPosition=20, ComBitSize=5, ComTimeout=5, ComHandleId=6, ComSystemTemplateSystemSignalRef=Day
      WLC_oNIO_ES6_RF_CAN_SR_V3_0_Rx_42316af2 (ComIPduGroup): ComIPduGroupHandleId=0
      7 x ComSignal, all with ComSignalEndianness=BIG_ENDIAN, ComSignalInitValue=0, ComSignalType=UINT8, ComSignalAccess=ACCESS_UNCLEAR:
        UsrData3_WLC_oNM_WLC_oNIO_ES6_RF_CAN_SR_V3_0_c1e3f178_Tx: ComBitPosition=31, ComBitSize=8, ComTransferProperty=PENDING, ComHandleId=3, ComSystemTemplateSystemSignalRef=UsrData3_WLC
        ComfEna_ASIL_oCGW_03_oNIO_ES6_RF_CAN_SR_V3_0_daac19b6_Rx: ComBitPosition=17, ComBitSize=2, ComTimeout=0.15, ComHandleId=4, ComSystemTemplateSystemSignalRef=ComfEna_ASIL
        WLC_01_CRC_oWLC_01_oNIO_ES6_RF_CAN_SR_V3_0_705754f3_Tx: ComBitPosition=7, ComBitSize=8, ComTimeout=0, ComTransferProperty=PENDING, ComHandleId=12, ComSystemTemplateSystemSignalRef=WLC_01_CRC
        VehState_ASIL_oCGW_03_oNIO_ES6_RF_CAN_SR_V3_0_3e049202_Rx: ComBitPosition=11, ComBitSize=4, ComTimeout=0.15, ComHandleId=14, ComSystemTemplateSystemSignalRef=VehState_ASIL
        VehState_oCGW_02_oNIO_ES6_RF_CAN_SR_V3_0_70d412f9_Rx: ComBitPosition=7, ComBitSize=4, ComTimeout=0.15, ComHandleId=15, ComSystemTemplateSystemSignalRef=VehState
        CGW_03_CRC_oCGW_03_oNIO_ES6_RF_CAN_SR_V3_0_bd877a03_Rx: ComBitPosition=7, ComBitSize=8, ComTimeout=0.15, ComHandleId=0, ComSystemTemplateSystemSignalRef=CGW_03_CRC
        WLCCtrlSts_oWLC_01_oNIO_ES6_RF_CAN_SR_V3_0_a083bd17_Tx: ComBitPosition=17, ComBitSize=2, ComTimeout=0, ComTransferProperty=PENDING, ComHandleId=8, ComSystemTemplateSystemSignalRef=WLCCtrlSts
      WLC_02_oNIO_ES6_RF_CAN_SR_V3_0_3e708b41_Tx (ComIPdu):
        ComIPduDirection = SEND
        ComIPduType = NORMAL
        ComIPduHandleId = 2
        ComIPduSignalProcessing = DEFERRED
        ComIPduCancellationSupport = false
        ComIPduGroupRef = WLC_oNIO_ES6_RF_CAN_SR_V3_0_Tx_146bcd74
        ComIPduSignalRef = WLCImobSts_oWLC_02_oNIO_ES6_RF_CAN_SR_V3_0_77a54935_Tx
        ComIPduSignalRef = WLC_02_CRC_oWLC_02_oNIO_ES6_RF_CAN_SR_V3_0_1fdbddc0_Tx
        ComIPduSignalRef = WLC_02_MsgCntr_oWLC_02_oNIO_ES6_RF_CAN_SR_V3_0_15588e7e_Tx
        ComPduIdRef = WLC_02_oNIO_ES6_RF_CAN_SR_V3_0_3e708b41_Tx
        ComTxIPdu: ComMinimumDelayTime=0, ComTxIPduUnusedAreasDefault=0
          ComTxModeTrue
            ComTxMode: ComTxModeMode=PERIODIC, ComTxModeTimeOffset=0, ComTxModeTimePeriod=0.1
          ComTxModeFalse
            ComTxMode: ComTxModeMode=PERIODIC, ComTxModeTimeOffset=0, ComTxModeTimePeriod=0.1
      4 x ComSignal, all with ComSignalEndianness=BIG_ENDIAN, ComSignalInitValue=0, ComSignalType=UINT8, ComSignalAccess=ACCESS_UNCLEAR:
        WLC_02_CRC_oWLC_02_oNIO_ES6_RF_CAN_SR_V3_0_1fdbddc0_Tx: ComBitPosition=7, ComBitSize=8, ComTimeout=0, ComTransferProperty=PENDING, ComHandleId=14, ComSystemTemplateSystemSignalRef=WLC_02_CRC
        UsrData0_WLC_oNM_WLC_oNIO_ES6_RF_CAN_SR_V3_0_9b82ce18_Tx: ComBitPosition=7, ComBitSize=8, ComTransferProperty=PENDING, ComHandleId=0, ComSystemTemplateSystemSignalRef=UsrData0_WLC
        Hr_oCGW_TCU_01_oNIO_ES6_RF_CAN_SR_V3_0_f5c3e99f_Rx: ComBitPosition=28, ComBitSize=5, ComTimeout=5, ComHandleId=7, ComSystemTemplateSystemSignalRef=Hr
        WLCImobSts_oWLC_02_oNIO_ES6_RF_CAN_SR_V3_0_77a54935_Tx: ComBitPosition=9, ComBitSize=2, ComTimeout=0, ComTransferProperty=PENDING, ComHandleId=10, ComSystemTemplateSystemSignalRef=WLCImobSts
    ComGeneral:
      ComConfigurationUseDet = false
      ComSafeBswChecks = false
      ComEnableSignalGroupArrayApi = false
      ComRetryFailedTransmitRequests = true
      ComSupportedIPduGroups = 2
      ComVersionInfoApi = true
      ComAdvancedIPduCallouts = true
      ComOptimizedIPduGroupHandling = false
      ComMetaDataSupport = false
      ComReceiveSignalMacroAPI = false
      ComDeferredEventCacheSupport = false
      ComMainfunctionTimingDomainSupport = false
      ComSignalGateway = false
      ComDescriptionGateway = false
      ComDescriptionRoutingCodeGeneration = false
