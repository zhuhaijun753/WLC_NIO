AUTOSAR XML (schema 4-2-1)
package /ActiveEcuC
  module config CanTp: implementation-config-variant=VARIANT-PRE-COMPILE, module-description=CanTp_Impl
    CanTpGeneral:
      CanTpChangeParameterApi = false
      CanTpDevErrorDetect = false
      CanTpPaddingByte = 204
      CanTpReadParameterApi = false
      CanTpVersionInfoApi = true
      CanTpPaddingActive = true
      CanTpHavePaddingByte = false
      CanTpNumRxChannels = 0
      CanTpNumTxChannels = 0
      CanTpEnableSplitMainFunction = false
      CanTpSupportStandardAddressing = true
      CanTpSupportExtendedAddressing = true
      CanTpSupportMixed11Addressing = true
      CanTpSupportMixed29Addressing = true
      CanTpSupportNormalFixedAddressing = true
      CanTpOnlyNotifyInformedAppl = true
      CanTpRc = false
      CanTpTc = false
      CanTpSafeBswChecks = false
      CanTpEnableConstantBS = true
      CanTpEnableTransmitQueue = false
      CanTpUseOnlyFirstFc = true
    CanTpConfig: CanTpMainFunctionPeriod=0.005
      5 x CanTpChannel, all with CanTpChannelMode=CANTP_MODE_FULL_DUPLEX:
        TPCH_0f5b0134
          CanTpRxNSdu_585bdea6 (CanTpRxNSdu):
            CanTpRxAddressingFormat = CANTP_STANDARD
            CanTpRxDl = 8
            CanTpRxTaType = CANTP_FUNCTIONAL
            CanTpNbr = 0.1
            CanTpRxNSduId = 1
            CanTpRxPaddingActivation = CANTP_ON
            CanTpRxNSduRef = DIAG_REQ_AllECU_oNIO_ES6_RF_CAN_SR_V3_0_5b04e722_Rx
            CanTpRxNPdu_210b33f5 (CanTpRxNPdu): CanTpRxNPduId=4, CanTpRxNPduRef=DIAG_REQ_AllECU_Tp_oNIO_ES6_RF_CAN_SR_V3_0_3d6a4915_Rx
        TPCH_aae5912e
          CanTpTxNSdu_fab217f5 (CanTpTxNSdu):
            CanTpTxAddressingFormat = CANTP_STANDARD
            CanTpTxDl = 8
            CanTpTxTaType = CANTP_PHYSICAL
            CanTpNas = 0.1
            CanTpNcs = 0.2
            CanTpTc = false
            CanTpTxNSduId = 3
            CanTpTxPaddingActivation = CANTP_ON
            CanTpNbs = 0.5
            CanTpTxNSduRef = DIAG_RESP_WLC_oNIO_ES6_RF_CAN_SR_V3_0_ebfde8b0_Tx
            CanTpTxNPdu_b9a7b042 (CanTpTxNPdu): CanTpTxNPduConfirmationPduId=0, CanTpTxNPduRef=DIAG_RESP_WLC_Tp_oNIO_ES6_RF_CAN_SR_V3_0_8004734c_Tx
            CanTpRxFcNPdu_b9a7b042 (CanTpRxFcNPdu): CanTpRxFcNPduId=1, CanTpRxFcNPduRef=DIAG_REQ_WLC_Tp_oNIO_ES6_RF_CAN_SR_V3_0_18ec0086_Rx
          CanTpRxNSdu_fab217f5 (CanTpRxNSdu):
            CanTpRxAddressingFormat = CANTP_STANDARD
            CanTpRxDl = 8
            CanTpRxTaType = CANTP_PHYSICAL
            CanTpNbr = 0.1
            CanTpRxNSduId = 4
            CanTpRxPaddingActivation = CANTP_ON
            CanTpBs = 8
            CanTpNar = 0.1
            CanTpNcr = 0.5
            CanTpRxWftMax = 15
            CanTpSTmin = 0.02
            CanTpRxNSduRef = DIAG_REQ_WLC_oNIO_ES6_RF_CAN_SR_V3_0_af2d88ff_Rx
            CanTpTxFcNPdu_9b5d64b0 (CanTpTxFcNPdu): CanTpTxFcNPduConfirmationPduId=0, CanTpTxFcNPduRef=DIAG_RESP_WLC_Tp_oNIO_ES6_RF_CAN_SR_V3_0_8004734c_Tx
            CanTpRxNPdu_9b5d64b0 (CanTpRxNPdu): CanTpRxNPduId=1, CanTpRxNPduRef=DIAG_REQ_WLC_Tp_oNIO_ES6_RF_CAN_SR_V3_0_18ec0086_Rx
        TPCH_01_CDC_WLC_NFC
          CanTpRxNSdu:
            CanTpNbr = 0.1
            CanTpRxAddressingFormat = CANTP_STANDARD
            CanTpRxNSduId = 2
            CanTpRxPaddingActivation = CANTP_ON
            CanTpRxTaType = CANTP_PHYSICAL
            CanTpBs = 8
            CanTpNar = 0.1
            CanTpNcr = 0.5
            CanTpRxWftMax = 15
            CanTpSTmin = 0.02
            CanTpRxNSduRef = CDC_WLC_NFC_Pdu_CANTP_001
            CanTpRxNPdu: CanTpRxNPduId=0, CanTpRxNPduRef=CDC_WLC_NFC_oNIO_ES6_RF_CAN_SR_V3_0_01b0c2d6_Rx
            CanTpTxFcNPdu: CanTpTxFcNPduConfirmationPduId=2, CanTpTxFcNPduRef=WLC_CDC_NFC_oNIO_ES6_RF_CAN_SR_V3_0_e08c50f2_Tx
          CanTpTxNSdu:
            CanTpNas = 0.1
            CanTpNcs = 0.2
            CanTpTc = false
            CanTpTxAddressingFormat = CANTP_STANDARD
            CanTpTxNSduId = 1
            CanTpTxPaddingActivation = CANTP_ON
            CanTpTxTaType = CANTP_PHYSICAL
            CanTpNbs = 0.5
            CanTpTxNSduRef = WLC_CDC_NFC_oNIO_ES6_RF_CAN_CDDAsCanTp_001
            CanTpTxNPdu: CanTpTxNPduConfirmationPduId=2, CanTpTxNPduRef=WLC_CDC_NFC_oNIO_ES6_RF_CAN_SR_V3_0_e08c50f2_Tx
            CanTpRxFcNPdu: CanTpRxFcNPduId=0, CanTpRxFcNPduRef=CDC_WLC_NFC_oNIO_ES6_RF_CAN_SR_V3_0_01b0c2d6_Rx
        TPCH_02_IMOB_CGW_WLC
          CanTpRxNSdu_001 (CanTpRxNSdu):
            CanTpNbr = 0.1
            CanTpRxAddressingFormat = CANTP_STANDARD
            CanTpRxNSduId = 3
            CanTpRxPaddingActivation = CANTP_ON
            CanTpRxTaType = CANTP_PHYSICAL
            CanTpBs = 8
            CanTpNar = 0.1
            CanTpNcr = 0.5
            CanTpRxWftMax = 15
            CanTpSTmin = 0.02
            CanTpRxNSduRef = IMOB_CGW_WLC_oNIO_ES6_RF_CDDasCanTp_001
            CanTpRxNPdu_1 (CanTpRxNPdu): CanTpRxNPduId=2, CanTpRxNPduRef=IMOB_CGW_WLC_oNIO_ES6_RF_CAN_SR_V3_0_da4d0319_Rx
            CanTpTxFcNPdu_001 (CanTpTxFcNPdu): CanTpTxFcNPduConfirmationPduId=1, CanTpTxFcNPduRef=IMOB_WLC_CGW_oNIO_ES6_RF_CAN_SR_V3_0_efb0805f_Tx
          CanTpTxNSdu_001 (CanTpTxNSdu):
            CanTpNas = 0.1
            CanTpNcs = 0.2
            CanTpTc = false
            CanTpTxAddressingFormat = CANTP_STANDARD
            CanTpTxNSduId = 2
            CanTpTxPaddingActivation = CANTP_ON
            CanTpTxTaType = CANTP_PHYSICAL
            CanTpNbs = 0.5
            CanTpTxNSduRef = IMOB_WLC_CGW_oNIO_ES6_RF_CAN_CDDAsCanTp_001
            CanTpTxNPdu_1 (CanTpTxNPdu): CanTpTxNPduConfirmationPduId=1, CanTpTxNPduRef=IMOB_WLC_CGW_oNIO_ES6_RF_CAN_SR_V3_0_efb0805f_Tx
            CanTpRxFcNPdu_01 (CanTpRxFcNPdu): CanTpRxFcNPduId=2, CanTpRxFcNPduRef=IMOB_CGW_WLC_oNIO_ES6_RF_CAN_SR_V3_0_da4d0319_Rx
        TPCH03_DEVP0102
          CanTpRxNSdu_002 (CanTpRxNSdu):
            CanTpNbr = 0.1
            CanTpRxAddressingFormat = CANTP_STANDARD
            CanTpRxNSduId = 0
            CanTpRxPaddingActivation = CANTP_ON
            CanTpRxTaType = CANTP_PHYSICAL
            CanTpBs = 8
            CanTpNar = 0.1
            CanTpNcr = 0.5
            CanTpRxWftMax = 15
            CanTpSTmin = 0.02
            CanTpRxNSduRef = WLC_DEVLP_02_oNIO_ES6_RF_CAN_CDDasCanTp_001
            CanTpRxNPdu_2 (CanTpRxNPdu): CanTpRxNPduId=3, CanTpRxNPduRef=WLC_DEVLP_02_oNIO_ES6_RF_CAN_SR_V3_0_2ddc8841_Rx
            CanTpTxFcNPdu_002 (CanTpTxFcNPdu): CanTpTxFcNPduConfirmationPduId=3, CanTpTxFcNPduRef=WLC_DEVLP_01_oNIO_ES6_RF_CAN_SR_V3_0_0423feed_Tx
          CanTpTxNSdu_002 (CanTpTxNSdu):
            CanTpNas = 0.1
            CanTpNcs = 0.2
            CanTpTc = false
            CanTpTxAddressingFormat = CANTP_STANDARD
            CanTpTxNSduId = 0
            CanTpTxPaddingActivation = CANTP_ON
            CanTpTxTaType = CANTP_PHYSICAL
            CanTpNbs = 0.5
            CanTpTxNSduRef = WLC_DEVLP_01_oNIO_ES6_RF_CAN_CDDasCanTp_001
            CanTpTxNPdu_2 (CanTpTxNPdu): CanTpTxNPduConfirmationPduId=3, CanTpTxNPduRef=WLC_DEVLP_01_oNIO_ES6_RF_CAN_SR_V3_0_0423feed_Tx
            CanTpRxFcNPdu_001 (CanTpRxFcNPdu): CanTpRxFcNPduId=3, CanTpRxFcNPduRef=WLC_DEVLP_02_oNIO_ES6_RF_CAN_SR_V3_0_2ddc8841_Rx
