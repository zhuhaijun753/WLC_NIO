AUTOSAR XML (schema 4-2-1)
package /ActiveEcuC
  module config EcuC: implementation-config-variant=VARIANT-PRE-COMPILE, module-description=EcuC_Impl
    EcucPduCollection: PduIdTypeEnum=UINT8, PduLengthTypeEnum=UINT16
      48 x Pdu, all with J1939Requestable=false:
        CGW_03_oNIO_ES6_RF_CAN_SR_V3_0_0cc82007_Rx: PduLength=8
        CDC_IC_01_oNIO_ES6_RF_CAN_SR_V3_0_d7bf39a5_Rx: PduLength=3
        CDC_WLC_NFC_oNIO_ES6_RF_CAN_SR_V3_0_01b0c2d6_Rx: PduLength=8, SysTPduToFrameMappingRef=CDC_WLC_NFC
        DIAG_RESP_WLC_oNIO_ES6_RF_CAN_SR_V3_0_ebfde8b0_Tx: PduLength=8
        WLC_01_oNIO_ES6_RF_CAN_SR_V3_0_0b9d3d12_Tx: PduLength=3
        CDC_WLC_oNIO_ES6_RF_CAN_SR_V3_0_d2878c96_Rx: PduLength=1
        DIAG_REQ_AllECU_oNIO_ES6_RF_CAN_SR_V3_0_5b04e722_Rx: PduLength=7
        CGW_02_oNIO_ES6_RF_CAN_SR_V3_0_a943b009_Rx: PduLength=2
        CGW_TCU_01_oNIO_ES6_RF_CAN_SR_V3_0_49a017d3_Rx: PduLength=6
        DIAG_REQ_AllECU_Tp_oNIO_ES6_RF_CAN_SR_V3_0_3d6a4915_Rx: PduLength=8, SysTPduToFrameMappingRef=DIAG_REQ_AllECU_Tp
        WLC_4a7e70e4_Rx: PduLength=8, SysTPduToFrameMappingRef=NM_CGW
        BCU_04_oNIO_ES6_RF_CAN_SR_V3_0_aafda74c_Rx: PduLength=8
        DIAG_REQ_WLC_oNIO_ES6_RF_CAN_SR_V3_0_af2d88ff_Rx: PduLength=8
        DIAG_REQ_WLC_oNIO_ES6_RF_CAN_SR_V3_0_499b8fdc_Rx: PduLength=8
        NM_WLC_oNIO_ES6_RF_CAN_SR_V3_0_9357dd65_Tx: PduLength=6
        NM_WLC_oNIO_ES6_RF_CAN_SR_V3_0_1915286e_Tx: PduLength=8, SysTPduToFrameMappingRef=NM_WLC
        CDC_WLC_oNIO_ES6_RF_CAN_SR_V3_0_cbd6c32f_Rx: PduLength=1, SysTPduToFrameMappingRef=CDC_WLC
        WLC_DEVLP_01_oNIO_ES6_RF_CAN_SR_V3_0_0423feed_Tx: PduLength=8, SysTPduToFrameMappingRef=WLC_DEVLP_01
        DIAG_REQ_AllECU_oNIO_ES6_RF_CAN_SR_V3_0_88b0846e_Rx: PduLength=7
        CGW_02_oNIO_ES6_RF_CAN_SR_V3_0_371b1f5e_Rx: PduLength=2, SysTPduToFrameMappingRef=CGW_02
        IMOB_WLC_CGW_oNIO_ES6_RF_CAN_SR_V3_0_efb0805f_Tx: PduLength=8, SysTPduToFrameMappingRef=IMOB_WLC_CGW
        CGW_03_oNIO_ES6_RF_CAN_SR_V3_0_2fb1cd3a_Rx: PduLength=8, SysTPduToFrameMappingRef=CGW_03
        DIAG_REQ_WLC_Tp_oNIO_ES6_RF_CAN_SR_V3_0_18ec0086_Rx: PduLength=8, SysTPduToFrameMappingRef=DIAG_REQ_WLC_Tp
        DIAG_RESP_WLC_oNIO_ES6_RF_CAN_SR_V3_0_7db09b81_Tx: PduLength=8
        CGW_WLC_oNIO_ES6_RF_CAN_SR_V3_0_4780465a_Rx: PduLength=8
        CGW_WLC_oNIO_ES6_RF_CAN_SR_V3_0_57df1db7_Rx: PduLength=8, SysTPduToFrameMappingRef=CGW_WLC
        CDC_IC_01_oNIO_ES6_RF_CAN_SR_V3_0_7ab33239_Rx: PduLength=3, SysTPduToFrameMappingRef=CDC_IC_01
        WLC_02_oNIO_ES6_RF_CAN_SR_V3_0_3e708b41_Tx: PduLength=2
        WLC_CDC_NFC_oNIO_ES6_RF_CAN_SR_V3_0_e08c50f2_Tx: PduLength=8, SysTPduToFrameMappingRef=WLC_CDC_NFC
        WLC_01_oNIO_ES6_RF_CAN_SR_V3_0_49299080_Tx: PduLength=3, SysTPduToFrameMappingRef=WLC_01
        BCU_04_oNIO_ES6_RF_CAN_SR_V3_0_b06c3b94_Rx: PduLength=8, SysTPduToFrameMappingRef=BCU_04
        CGW_TCU_01_oNIO_ES6_RF_CAN_SR_V3_0_9e3e6b3d_Rx: PduLength=6, SysTPduToFrameMappingRef=CGW_TCU_01
        IMOB_CGW_WLC_oNIO_ES6_RF_CAN_SR_V3_0_da4d0319_Rx: PduLength=8, SysTPduToFrameMappingRef=IMOB_CGW_WLC
        WLC_DEVLP_02_oNIO_ES6_RF_CAN_SR_V3_0_2ddc8841_Rx: PduLength=8, SysTPduToFrameMappingRef=WLC_DEVLP_02
        DIAG_RESP_WLC_Tp_oNIO_ES6_RF_CAN_SR_V3_0_8004734c_Tx: PduLength=8, SysTPduToFrameMappingRef=DIAG_RESP_WLC_Tp
        WLC_02_oNIO_ES6_RF_CAN_SR_V3_0_60d6e62c_Tx: PduLength=2, SysTPduToFrameMappingRef=WLC_02
        CDC_WLC_NFC_Pdu_CANTP: PduLength=8
        IMOB_CGW_WLC_oNIO_ES6_RF_CDDasCanTp: PduLength=8
        IMOB_WLC_CGW_oNIO_ES6_RF_CAN_CDDAsCanTp: PduLength=8
        WLC_CDC_NFC_oNIO_ES6_RF_CAN_CDDAsCanTp: PduLength=8
        WLC_DEVLP_01_oNIO_ES6_RF_CAN_CDDasCanTp: PduLength=8
        WLC_DEVLP_02_oNIO_ES6_RF_CAN_CDDasCanTp: PduLength=8
        CDC_WLC_NFC_Pdu_CANTP_001: PduLength=7
        WLC_CDC_NFC_oNIO_ES6_RF_CAN_CDDAsCanTp_001: PduLength=7
        IMOB_CGW_WLC_oNIO_ES6_RF_CDDasCanTp_001: PduLength=7
        IMOB_WLC_CGW_oNIO_ES6_RF_CAN_CDDAsCanTp_001: PduLength=8
        WLC_DEVLP_02_oNIO_ES6_RF_CAN_CDDasCanTp_001: PduLength=8
        WLC_DEVLP_01_oNIO_ES6_RF_CAN_CDDasCanTp_001: PduLength=7
    EcucGeneral:
      CPUType = CPU32Bit
      SizeOfInt = Size32Bit
      ByteOrder = LITTLE_ENDIAN
      BitOrder = LSB_to_MSB
      AtomicBitAccessInBitfield = false
      AtomicVariableAccess = Atomic32BitAccess
      SizeOfEnum = Size32Bit
      SizeOfROMPointer = Size32Bit
      SizeOfRAMPointer = Size32Bit
      BitFieldDataType = INT
      StructAlignment = Auto
      ArrayAlignment = Auto
      StructInArrayAlignment = Auto
      DummyFunction = false
      EcuCSafeBswChecks = false
      DummyStatement = true
      DummyStatementKind = SelfAssignment
      ConditionalGenerating = true
      EcucBswImplementationCodeType = EcuCSourceCode
      EcuCUseStdReturnTypeForRte = false
      BswInitialization
        34 x InitFunction:
          BswM_PreInit: Header=BswM.h, InitPhase=INIT_ONE, ConfigType=BswM_ConfigType, ConfigPtrName=BswM_Config_Ptr, ConfigPtrClass=BSWM_INIT_DATA, ModuleRef=BswM
          BswM_InitMemory: Header=BswM.h, InitPhase=INIT_MEMORY, ModuleRef=BswM
          BswM_Init: Header=BswM.h, InitPhase=NO_INIT, ConfigType=BswM_ConfigType, ConfigPtrName=BswM_Config_Ptr, ConfigPtrClass=BSWM_INIT_DATA, ModuleRef=BswM
          CanIf_Init: Header=CanIf.h, InitPhase=INIT_TWO_IF, ConfigType=CanIf_ConfigType, ConfigPtrName=CanIf_Config_Ptr, ConfigPtrClass=CANIF_INIT_DATA, ModuleRef=CanIf
          CanIf_InitMemory: Header=CanIf.h, InitPhase=INIT_MEMORY, ModuleRef=CanIf
          CanNm_InitMemory: Header=CanNm.h, InitPhase=INIT_MEMORY, ModuleRef=CanNm
          CanNm_Init: Header=CanNm.h, InitPhase=INIT_TWO_NM, ConfigType=CanNm_ConfigType, ConfigPtrName=CanNm_Config_Ptr, ConfigPtrClass=CANNM_INIT_DATA, ModuleRef=CanNm
          CanSM_InitMemory: Header=CanSM_EcuM.h, InitPhase=INIT_MEMORY, ModuleRef=CanSM
          CanSM_Init: Header=CanSM_EcuM.h, InitPhase=INIT_TWO_SM, ConfigType=CanSM_ConfigType, ConfigPtrName=CanSM_Config_Ptr, ConfigPtrClass=CANSM_INIT_DATA, ModuleRef=CanSM
          CanTp_InitMemory: Header=CanTp.h, InitPhase=INIT_MEMORY, ModuleRef=CanTp
          CanTp_Init: Header=CanTp.h, InitPhase=INIT_TWO_TP, ConfigType=CanTp_ConfigType, ConfigPtrName=CanTp_Config_Ptr, ConfigPtrClass=CANTP_INIT_DATA, ModuleRef=CanTp
          Can_InitMemory: Header=Can.h, InitPhase=INIT_MEMORY, ModuleRef=Can
          Can_Init: Header=Can.h, InitPhase=INIT_TWO_DRV, ConfigType=Can_ConfigType, ConfigPtrName=Can_Config_Ptr, ConfigPtrClass=CAN_INIT_DATA, ModuleRef=Can
          ComM_InitMemory: Header=ComM.h, InitPhase=INIT_MEMORY, ModuleRef=ComM
          ComM_Init: Header=ComM.h, InitPhase=INIT_TWO_POST_NVMREADALL, ModuleRef=ComM
          Com_InitMemory: Header=Com.h, InitPhase=INIT_MEMORY, ModuleRef=Com
          Com_Init: Header=Com.h, InitPhase=INIT_TWO_COM, ConfigType=Com_ConfigType, ConfigPtrName=Com_Config_Ptr, ConfigPtrClass=COM_INIT_DATA, ModuleRef=Com
          Dcm_InitMemory: Header=Dcm.h, InitPhase=INIT_MEMORY, ModuleRef=Dcm
          Dcm_Init: Header=Dcm.h, InitPhase=INIT_TWO_POST_NVMREADALL, ConfigType=Dcm_ConfigType, ConfigPtrName=NULL_PTR, ConfigPtrClass=DCM_CONST, ModuleRef=Dcm
          Dem_PreInit: Header=Dem.h, InitPhase=INIT_ZERO, ConfigType=Dem_ConfigType, ConfigPtrName=Dem_Config_Ptr, ConfigPtrClass=DEM_INIT_DATA, ModuleRef=Dem
          Dem_InitMemory: Header=Dem.h, InitPhase=INIT_MEMORY, ModuleRef=Dem
          Dem_Init: Header=Dem.h, InitPhase=INIT_TWO_POST_NVMREADALL, ConfigType=Dem_ConfigType, ConfigPtrName=Dem_Config_Ptr, ConfigPtrClass=DEM_INIT_DATA, ModuleRef=Dem
          Det_Init: Header=Det.h, InitPhase=INIT_ZERO, ConfigType=Det_ConfigType, ConfigPtrName=Det_Config_Ptr, ConfigPtrClass=DET_INIT_DATA, ModuleRef=Det
          Det_InitMemory: Header=Det.h, InitPhase=INIT_MEMORY, ModuleRef=Det
          EcuM_Init: Header=EcuM.h, InitPhase=NO_INIT, ConfigType=EcuM_PbConfigType, ConfigPtrName=EcuM_Config_Ptr, ConfigPtrClass=ECUM_INIT_DATA, ModuleRef=EcuM
          Mcu_Init: Header=Mcu.h, InitPhase=INIT_ONE_EARLY, ConfigType=Mcu_ConfigType, ConfigPtrName=McuModuleConfiguration, ConfigPtrClass=MCU_APPL_CONST, AdditionalInitCode=Mcu_InitClock(0); while (MCU_PLL_LOCKED != Mcu_GetPllStatus()); Mcu_DistributePllClock();, ModuleRef=Mcu
          Nm_InitMemory: Header=Nm.h, InitPhase=INIT_MEMORY, ModuleRef=Nm
          Nm_Init: Header=Nm.h, InitPhase=INIT_TWO_NM, ModuleRef=Nm
          PduR_InitMemory: Header=PduR.h, InitPhase=INIT_MEMORY, ModuleRef=PduR
          PduR_Init: Header=PduR.h, InitPhase=INIT_TWO_COM, ConfigType=PduR_PBConfigType, ConfigPtrName=PduR_Config_Ptr, ConfigPtrClass=PDUR_INIT_DATA, ModuleRef=PduR
          Rte_StartTiming: Header=Rte_Main.h, InitPhase=NO_INIT, ModuleRef=Rte
          Rte_InitMemory: Header=Rte_Main.h, InitPhase=INIT_MEMORY, ModuleRef=Rte
          SchM_Init: Header=Rte_Main.h, InitPhase=NO_INIT, ModuleRef=Rte
          Rte_Start: Header=Rte_Main.h, InitPhase=INIT_THREE, ModuleRef=Rte
    EcucHardware
      EcucCoreDefinition: EcucCoreId=0
