AUTOSAR XML (schema 4-2-1)
package /InitialEcuC
  ecuc value collection InitialEcuC: ecuc-values=[Can, CanIf, CanNm, CanSM, CanTp, Com, ComM, Dcm, Dem, EcuC, EcuM, Nm, PduR]
  module config Can
    CanConfigSet
      CT_NIO_ES6_RF_CAN_SR_V3_0_a63ca593 (CanController):
        CanControllerActivation = true
        CanControllerDefaultBaudrate = CanControllerBaudrateConfig
        CanControllerSystemRef = CT_NIO_ES6_RF_CAN_SR_V3_0
        CanWakeupSourceRef = EcuMCommonConfiguration/CN_NIO_ES6_RF_CAN_SR_V3_0_d2612a1f
        CanControllerBaudrateConfig: CanControllerBaudRate=500
      CN_NIO_ES6_RF_CAN_SR_V3_0_91fc07e0_Rx (CanHardwareObject): CanHandleType=BASIC, CanIdType=STANDARD, CanIdValue=0, CanObjectType=RECEIVE, CanControllerRef=CanConfigSet/CT_NIO_ES6_RF_CAN_SR_V3_0_a63ca593
      CN_NIO_ES6_RF_CAN_SR_V3_0_d2612a1f_Tx (CanHardwareObject): CanHandleType=BASIC, CanIdValue=0, CanObjectType=TRANSMIT, CanControllerRef=CanConfigSet/CT_NIO_ES6_RF_CAN_SR_V3_0_a63ca593
    CanGeneral: CanIndex=0
  module config CanIf
    CanIfCtrlDrvCfg_7d254554 (CanIfCtrlDrvCfg): CanIfCtrlDrvInitHohConfigRef=CanIfInitHohCfg, CanIfCtrlDrvNameRef=CanGeneral
      CT_NIO_ES6_RF_CAN_SR_V3_0_a63ca593 (CanIfCtrlCfg): CanIfCtrlCanCtrlRef=CanConfigSet/CT_NIO_ES6_RF_CAN_SR_V3_0_a63ca593
    CanIfInitCfg
      CHNL_3145ee01 (CanIfBufferCfg): CanIfBufferSize=0, CanIfBufferHthRef=CanIfInitHohCfg/CN_NIO_ES6_RF_CAN_SR_V3_0_d2612a1f_Tx
      CanIfInitHohCfg: CanIfInitRefCfgSet=CanConfigSet
        CN_NIO_ES6_RF_CAN_SR_V3_0_91fc07e0_Rx (CanIfHrhCfg):
          CanIfHrhCanCtrlIdRef = CanIfCtrlDrvCfg_7d254554/CT_NIO_ES6_RF_CAN_SR_V3_0_a63ca593
          CanIfHrhIdSymRef = CanConfigSet/CN_NIO_ES6_RF_CAN_SR_V3_0_91fc07e0_Rx
        CN_NIO_ES6_RF_CAN_SR_V3_0_d2612a1f_Tx (CanIfHthCfg):
          CanIfHthCanCtrlIdRef = CanIfCtrlDrvCfg_7d254554/CT_NIO_ES6_RF_CAN_SR_V3_0_a63ca593
          CanIfHthIdSymRef = CanConfigSet/CN_NIO_ES6_RF_CAN_SR_V3_0_d2612a1f_Tx
      13 x CanIfRxPduCfg, all with CanIfRxPduCanIdType=STANDARD_CAN, CanIfRxPduHrhIdRef=CanIfInitHohCfg/CN_NIO_ES6_RF_CAN_SR_V3_0_91fc07e0_Rx:
        BCU_04_oNIO_ES6_RF_CAN_SR_V3_0_7f355556_Rx: CanIfRxPduCanId=91, CanIfRxPduDlc=8, CanIfRxPduUserRxIndicationName=PduR_CanIfRxIndication, CanIfRxPduUserRxIndicationUL=PDUR, CanIfRxPduRef=EcucPduCollection/BCU_04_oNIO_ES6_RF_CAN_SR_V3_0_b06c3b94_Rx
        CDC_IC_01_oNIO_ES6_RF_CAN_SR_V3_0_6ce0b6d1_Rx: CanIfRxPduCanId=938, CanIfRxPduDlc=3, CanIfRxPduUserRxIndicationName=PduR_CanIfRxIndication, CanIfRxPduUserRxIndicationUL=PDUR, CanIfRxPduRef=EcucPduCollection/CDC_IC_01_oNIO_ES6_RF_CAN_SR_V3_0_7ab33239_Rx
        CDC_WLC_NFC_oNIO_ES6_RF_CAN_SR_V3_0_0c4c3dd1_Rx: CanIfRxPduCanId=1199, CanIfRxPduDlc=8, CanIfRxPduRef=CDC_WLC_NFC_oNIO_ES6_RF_CAN_SR_V3_0_01b0c2d6_Rx
        CDC_WLC_oNIO_ES6_RF_CAN_SR_V3_0_96cf9e96_Rx: CanIfRxPduCanId=698, CanIfRxPduDlc=1, CanIfRxPduUserRxIndicationName=PduR_CanIfRxIndication, CanIfRxPduUserRxIndicationUL=PDUR, CanIfRxPduRef=EcucPduCollection/CDC_WLC_oNIO_ES6_RF_CAN_SR_V3_0_cbd6c32f_Rx
        CGW_02_oNIO_ES6_RF_CAN_SR_V3_0_e6e0b02d_Rx: CanIfRxPduCanId=707, CanIfRxPduDlc=2, CanIfRxPduUserRxIndicationName=PduR_CanIfRxIndication, CanIfRxPduUserRxIndicationUL=PDUR, CanIfRxPduRef=EcucPduCollection/CGW_02_oNIO_ES6_RF_CAN_SR_V3_0_371b1f5e_Rx
        CGW_03_oNIO_ES6_RF_CAN_SR_V3_0_3fecd32f_Rx: CanIfRxPduCanId=268, CanIfRxPduDlc=8, CanIfRxPduUserRxIndicationName=PduR_CanIfRxIndication, CanIfRxPduUserRxIndicationUL=PDUR, CanIfRxPduRef=EcucPduCollection/CGW_03_oNIO_ES6_RF_CAN_SR_V3_0_2fb1cd3a_Rx
        CGW_TCU_01_oNIO_ES6_RF_CAN_SR_V3_0_a587df53_Rx: CanIfRxPduCanId=946, CanIfRxPduDlc=6, CanIfRxPduUserRxIndicationName=PduR_CanIfRxIndication, CanIfRxPduUserRxIndicationUL=PDUR, CanIfRxPduRef=EcucPduCollection/CGW_TCU_01_oNIO_ES6_RF_CAN_SR_V3_0_9e3e6b3d_Rx
        CGW_WLC_oNIO_ES6_RF_CAN_SR_V3_0_411e58d5_Rx: CanIfRxPduCanId=958, CanIfRxPduDlc=8, CanIfRxPduUserRxIndicationName=PduR_CanIfRxIndication, CanIfRxPduUserRxIndicationUL=PDUR, CanIfRxPduRef=EcucPduCollection/CGW_WLC_oNIO_ES6_RF_CAN_SR_V3_0_57df1db7_Rx
        DIAG_REQ_AllECU_Tp_oNIO_ES6_RF_CAN_SR_V3_0_23f8e329_Rx: CanIfRxPduCanId=1537, CanIfRxPduDlc=8, CanIfRxPduUserRxIndicationName=CanTp_RxIndication, CanIfRxPduUserRxIndicationType=PDUID_PDUINFOPTR, CanIfRxPduUserRxIndicationUL=CAN_TP, CanIfRxPduRef=DIAG_REQ_AllECU_Tp_oNIO_ES6_RF_CAN_SR_V3_0_3d6a4915_Rx
        DIAG_REQ_WLC_Tp_oNIO_ES6_RF_CAN_SR_V3_0_dcbbcb37_Rx: CanIfRxPduCanId=1592, CanIfRxPduDlc=8, CanIfRxPduUserRxIndicationName=CanTp_RxIndication, CanIfRxPduUserRxIndicationType=PDUID_PDUINFOPTR, CanIfRxPduUserRxIndicationUL=CAN_TP, CanIfRxPduRef=DIAG_REQ_WLC_Tp_oNIO_ES6_RF_CAN_SR_V3_0_18ec0086_Rx
        IMOB_CGW_WLC_oNIO_ES6_RF_CAN_SR_V3_0_451c91a3_Rx: CanIfRxPduCanId=39, CanIfRxPduDlc=8, CanIfRxPduRef=IMOB_CGW_WLC_oNIO_ES6_RF_CAN_SR_V3_0_da4d0319_Rx
        WLC_DEVLP_02_oNIO_ES6_RF_CAN_SR_V3_0_52a3faed_Rx: CanIfRxPduCanId=1212, CanIfRxPduDlc=8, CanIfRxPduRef=WLC_DEVLP_02_oNIO_ES6_RF_CAN_SR_V3_0_2ddc8841_Rx
        WLC_d9d2b008_Rx: CanIfRxPduDlc=8, CanIfRxPduUserRxIndicationName=CanNm_RxIndication, CanIfRxPduUserRxIndicationUL=CAN_NM, CanIfRxPduRef=WLC_4a7e70e4_Rx
          CHNL_f62b2008 (CanIfRxPduCanIdRange): CanIfRxPduCanIdRangeLowerCanId=1280, CanIfRxPduCanIdRangeUpperCanId=1407
      7 x CanIfTxPduCfg, all with CanIfTxPduCanIdType=STANDARD_CAN, CanIfTxPduBufferRef=CanIfInitCfg/CHNL_3145ee01:
        DIAG_RESP_WLC_Tp_oNIO_ES6_RF_CAN_SR_V3_0_00ce42fa_Tx: CanIfTxPduCanId=1720, CanIfTxPduDlc=8, CanIfTxPduUserTxConfirmationName=CanTp_TxConfirmation, CanIfTxPduUserTxConfirmationUL=CAN_TP, CanIfTxPduRef=DIAG_RESP_WLC_Tp_oNIO_ES6_RF_CAN_SR_V3_0_8004734c_Tx
        IMOB_WLC_CGW_oNIO_ES6_RF_CAN_SR_V3_0_4f44c7a2_Tx: CanIfTxPduCanId=40, CanIfTxPduDlc=8, CanIfTxPduRef=IMOB_WLC_CGW_oNIO_ES6_RF_CAN_SR_V3_0_efb0805f_Tx
        NM_WLC_oNIO_ES6_RF_CAN_SR_V3_0_76bbfea6_Tx: CanIfTxPduCanId=1336, CanIfTxPduDlc=8, CanIfTxPduUserTxConfirmationName=CanNm_TxConfirmation, CanIfTxPduUserTxConfirmationUL=CAN_NM, CanIfTxPduRef=EcucPduCollection/NM_WLC_oNIO_ES6_RF_CAN_SR_V3_0_1915286e_Tx
        WLC_01_oNIO_ES6_RF_CAN_SR_V3_0_1dd10da5_Tx: CanIfTxPduCanId=995, CanIfTxPduDlc=3, CanIfTxPduUserTxConfirmationName=PduR_CanIfTxConfirmation, CanIfTxPduUserTxConfirmationUL=PDUR, CanIfTxPduRef=EcucPduCollection/WLC_01_oNIO_ES6_RF_CAN_SR_V3_0_49299080_Tx
        WLC_02_oNIO_ES6_RF_CAN_SR_V3_0_adb4aee2_Tx: CanIfTxPduCanId=832, CanIfTxPduDlc=2, CanIfTxPduUserTxConfirmationName=PduR_CanIfTxConfirmation, CanIfTxPduUserTxConfirmationUL=PDUR, CanIfTxPduRef=EcucPduCollection/WLC_02_oNIO_ES6_RF_CAN_SR_V3_0_60d6e62c_Tx
        WLC_CDC_NFC_oNIO_ES6_RF_CAN_SR_V3_0_f65364a2_Tx: CanIfTxPduCanId=1198, CanIfTxPduDlc=8, CanIfTxPduRef=WLC_CDC_NFC_oNIO_ES6_RF_CAN_SR_V3_0_e08c50f2_Tx
        WLC_DEVLP_01_oNIO_ES6_RF_CAN_SR_V3_0_163e9779_Tx: CanIfTxPduCanId=1211, CanIfTxPduDlc=8, CanIfTxPduRef=WLC_DEVLP_01_oNIO_ES6_RF_CAN_SR_V3_0_0423feed_Tx
    CanIfPrivateCfg: CanIfPrivateSoftwareFilterType=LINEAR
    CanIfPublicCfg: CanIfPublicPnSupport=false
  module config CanNm
    CanNmGlobalConfig: CanNmComUserDataSupport=true, CanNmPnEiraCalcEnabled=false, CanNmUserDataEnabled=true
      NIO_ES6_RF_CAN_SR_V3_0_CAN_40361c2d (CanNmChannelConfig):
        CanNmMsgCycleTime = 0.64
        CanNmMsgReducedTime = 0.32
        CanNmNodeId = 56
        CanNmRepeatMessageTime = 3.2
        CanNmTimeoutTime = 2
        CanNmUserDataLength = 6
        CanNmWaitBusSleepTime = 2
        CanNmComMNetworkHandleRef = ComMConfigSet/CN_NIO_ES6_RF_CAN_SR_V3_0_d2612a1f
        NIO_ES6_RF_CAN_SR_V3_0_CAN_40361c2d_Rx (CanNmRxPdu): CanNmRxPduRef=WLC_4a7e70e4_Rx
        NM_WLC_oNIO_ES6_RF_CAN_SR_V3_0_1915286e_Tx (CanNmTxPdu): CanNmTxPduRef=EcucPduCollection/NM_WLC_oNIO_ES6_RF_CAN_SR_V3_0_1915286e_Tx
        NM_WLC_oNIO_ES6_RF_CAN_SR_V3_0_fd222ddc (CanNmUserDataTxPdu): CanNmTxUserDataPduRef=EcucPduCollection/NM_WLC_oNIO_ES6_RF_CAN_SR_V3_0_9357dd65_Tx
  module config CanSM
    CanSMConfiguration
      CHNL_3145ee01 (CanSMManagerNetwork): CanSMComMNetworkHandleRef=ComMConfigSet/CN_NIO_ES6_RF_CAN_SR_V3_0_d2612a1f
        CT_NIO_ES6_RF_CAN_SR_V3_0_1e3a2060 (CanSMController): CanSMControllerId=CanIfCtrlDrvCfg_7d254554/CT_NIO_ES6_RF_CAN_SR_V3_0_a63ca593
  module config CanTp
    CanTpConfig: CanTpMainFunctionPeriod=0.005
      TPCH_0f5b0134 (CanTpChannel): CanTpChannelMode=CANTP_MODE_FULL_DUPLEX
        CanTpRxNSdu_585bdea6 (CanTpRxNSdu):
          CanTpRxAddressingFormat = CANTP_STANDARD
          CanTpRxDl = 8
          CanTpRxTaType = CANTP_FUNCTIONAL
          CanTpRxNSduRef = EcucPduCollection/DIAG_REQ_AllECU_oNIO_ES6_RF_CAN_SR_V3_0_5b04e722_Rx
          CanTpRxNPdu_210b33f5 (CanTpRxNPdu): CanTpRxNPduRef=DIAG_REQ_AllECU_Tp_oNIO_ES6_RF_CAN_SR_V3_0_3d6a4915_Rx
      TPCH_aae5912e (CanTpChannel): CanTpChannelMode=CANTP_MODE_FULL_DUPLEX
        CanTpRxNSdu_fab217f5 (CanTpRxNSdu):
          CanTpRxAddressingFormat = CANTP_STANDARD
          CanTpRxDl = 8
          CanTpRxTaType = CANTP_PHYSICAL
          CanTpRxNSduRef = EcucPduCollection/DIAG_REQ_WLC_oNIO_ES6_RF_CAN_SR_V3_0_af2d88ff_Rx
          CanTpRxNPdu_9b5d64b0 (CanTpRxNPdu): CanTpRxNPduRef=DIAG_REQ_WLC_Tp_oNIO_ES6_RF_CAN_SR_V3_0_18ec0086_Rx
          CanTpTxFcNPdu_9b5d64b0 (CanTpTxFcNPdu): CanTpTxFcNPduRef=DIAG_RESP_WLC_Tp_oNIO_ES6_RF_CAN_SR_V3_0_8004734c_Tx
        CanTpTxNSdu_fab217f5 (CanTpTxNSdu):
          CanTpTxAddressingFormat = CANTP_STANDARD
          CanTpTxDl = 8
          CanTpTxTaType = CANTP_PHYSICAL
          CanTpTxNSduRef = EcucPduCollection/DIAG_RESP_WLC_oNIO_ES6_RF_CAN_SR_V3_0_ebfde8b0_Tx
          CanTpRxFcNPdu_b9a7b042 (CanTpRxFcNPdu): CanTpRxFcNPduRef=DIAG_REQ_WLC_Tp_oNIO_ES6_RF_CAN_SR_V3_0_18ec0086_Rx
          CanTpTxNPdu_b9a7b042 (CanTpTxNPdu): CanTpTxNPduRef=DIAG_RESP_WLC_Tp_oNIO_ES6_RF_CAN_SR_V3_0_8004734c_Tx
  module config Com
    ComConfig
      10 x ComIPdu, all with ComIPduType=NORMAL:
        BCU_04_oNIO_ES6_RF_CAN_SR_V3_0_aafda74c_Rx: ComIPduDirection=RECEIVE, ComIPduGroupRef=WLC_oNIO_ES6_RF_CAN_SR_V3_0_Rx_42316af2, ComIPduSignalRef=VehSpd_oBCU_04_oNIO_ES6_RF_CAN_SR_V3_0_91cf0813_Rx, ComPduIdRef=EcucPduCollection/BCU_04_oNIO_ES6_RF_CAN_SR_V3_0_aafda74c_Rx
        CDC_IC_01_oNIO_ES6_RF_CAN_SR_V3_0_d7bf39a5_Rx: ComIPduDirection=RECEIVE, ComIPduGroupRef=WLC_oNIO_ES6_RF_CAN_SR_V3_0_Rx_42316af2, ComIPduSignalRef=VehOdometer_oCDC_IC_01_oNIO_ES6_RF_CAN_SR_V3_0_c4f897da_Rx, ComPduIdRef=EcucPduCollection/CDC_IC_01_oNIO_ES6_RF_CAN_SR_V3_0_d7bf39a5_Rx
        CDC_WLC_oNIO_ES6_RF_CAN_SR_V3_0_d2878c96_Rx: ComIPduDirection=RECEIVE, ComIPduGroupRef=WLC_oNIO_ES6_RF_CAN_SR_V3_0_Rx_42316af2, ComIPduSignalRef=WLCChrgFctEnaReq_oCDC_WLC_oNIO_ES6_RF_CAN_SR_V3_0_e37de241_Rx, ComPduIdRef=EcucPduCollection/CDC_WLC_oNIO_ES6_RF_CAN_SR_V3_0_d2878c96_Rx
        CGW_02_oNIO_ES6_RF_CAN_SR_V3_0_a943b009_Rx: ComIPduDirection=RECEIVE, ComIPduGroupRef=WLC_oNIO_ES6_RF_CAN_SR_V3_0_Rx_42316af2, ComIPduSignalRef=ComfEna_oCGW_02_oNIO_ES6_RF_CAN_SR_V3_0_1a60ba8c_Rx, ComIPduSignalRef=ImobEnaReq_oCGW_02_oNIO_ES6_RF_CAN_SR_V3_0_a2f30745_Rx, ComIPduSignalRef=VehState_oCGW_02_oNIO_ES6_RF_CAN_SR_V3_0_70d412f9_Rx, ComPduIdRef=EcucPduCollection/CGW_02_oNIO_ES6_RF_CAN_SR_V3_0_a943b009_Rx
        CGW_03_oNIO_ES6_RF_CAN_SR_V3_0_0cc82007_Rx: ComIPduDirection=RECEIVE, ComIPduGroupRef=WLC_oNIO_ES6_RF_CAN_SR_V3_0_Rx_42316af2, ComIPduSignalRef=CGW_03_CRC_oCGW_03_oNIO_ES6_RF_CAN_SR_V3_0_bd877a03_Rx, ComIPduSignalRef=CGW_03_MsgCntr_oCGW_03_oNIO_ES6_RF_CAN_SR_V3_0_3e603ff9_Rx, ComIPduSignalRef=ComfEna_ASIL_oCGW_03_oNIO_ES6_RF_CAN_SR_V3_0_daac19b6_Rx, ComIPduSignalRef=VehState_ASIL_oCGW_03_oNIO_ES6_RF_CAN_SR_V3_0_3e049202_Rx, ComPduIdRef=EcucPduCollection/CGW_03_oNIO_ES6_RF_CAN_SR_V3_0_0cc82007_Rx
        CGW_TCU_01_oNIO_ES6_RF_CAN_SR_V3_0_49a017d3_Rx: ComIPduDirection=RECEIVE, ComIPduGroupRef=WLC_oNIO_ES6_RF_CAN_SR_V3_0_Rx_42316af2, ComIPduSignalRef=Day_oCGW_TCU_01_oNIO_ES6_RF_CAN_SR_V3_0_76626f65_Rx, ComIPduSignalRef=Hr_oCGW_TCU_01_oNIO_ES6_RF_CAN_SR_V3_0_f5c3e99f_Rx, ComIPduSignalRef=Min_oCGW_TCU_01_oNIO_ES6_RF_CAN_SR_V3_0_c05ffcb3_Rx, ComIPduSignalRef=Mth_oCGW_TCU_01_oNIO_ES6_RF_CAN_SR_V3_0_a0768b21_Rx, ComIPduSignalRef=Sec_oCGW_TCU_01_oNIO_ES6_RF_CAN_SR_V3_0_48a1d09a_Rx, ComIPduSignalRef=Yr_oCGW_TCU_01_oNIO_ES6_RF_CAN_SR_V3_0_cdf9e710_Rx, ComPduIdRef=EcucPduCollection/CGW_TCU_01_oNIO_ES6_RF_CAN_SR_V3_0_49a017d3_Rx
        CGW_WLC_oNIO_ES6_RF_CAN_SR_V3_0_4780465a_Rx: ComIPduDirection=RECEIVE, ComIPduGroupRef=WLC_oNIO_ES6_RF_CAN_SR_V3_0_Rx_42316af2, ComIPduSignalRef=CGW_WLC_CRC_oCGW_WLC_oNIO_ES6_RF_CAN_SR_V3_0_67a87047_Rx, ComIPduSignalRef=CGW_WLC_MsgCntr_oCGW_WLC_oNIO_ES6_RF_CAN_SR_V3_0_2e39b55e_Rx, ComPduIdRef=EcucPduCollection/CGW_WLC_oNIO_ES6_RF_CAN_SR_V3_0_4780465a_Rx
        NM_WLC_oNIO_ES6_RF_CAN_SR_V3_0_9357dd65_Tx: ComIPduDirection=SEND, ComIPduSignalRef=UsrData0_WLC_oNM_WLC_oNIO_ES6_RF_CAN_SR_V3_0_9b82ce18_Tx, ComIPduSignalRef=UsrData1_WLC_oNM_WLC_oNIO_ES6_RF_CAN_SR_V3_0_1b72d907_Tx, ComIPduSignalRef=UsrData2_WLC_oNM_WLC_oNIO_ES6_RF_CAN_SR_V3_0_4113e667_Tx, ComIPduSignalRef=UsrData3_WLC_oNM_WLC_oNIO_ES6_RF_CAN_SR_V3_0_c1e3f178_Tx, ComIPduSignalRef=UsrData4_WLC_oNM_WLC_oNIO_ES6_RF_CAN_SR_V3_0_f5d198a7_Tx, ComIPduSignalRef=UsrData5_WLC_oNM_WLC_oNIO_ES6_RF_CAN_SR_V3_0_75218fb8_Tx, ComPduIdRef=EcucPduCollection/NM_WLC_oNIO_ES6_RF_CAN_SR_V3_0_9357dd65_Tx
          ComTxIPdu: ComTxIPduUnusedAreasDefault=0  # NM_WLC_oNIO_ES6_RF_CAN_SR_V3_0
        WLC_01_oNIO_ES6_RF_CAN_SR_V3_0_0b9d3d12_Tx: ComIPduDirection=SEND, ComIPduGroupRef=WLC_oNIO_ES6_RF_CAN_SR_V3_0_Tx_146bcd74, ComIPduSignalRef=WLCChrgRate_oWLC_01_oNIO_ES6_RF_CAN_SR_V3_0_b69382aa_Tx, ComIPduSignalRef=WLCChrgSts_oWLC_01_oNIO_ES6_RF_CAN_SR_V3_0_eda08377_Tx, ComIPduSignalRef=WLCCtrlSts_oWLC_01_oNIO_ES6_RF_CAN_SR_V3_0_a083bd17_Tx, ComIPduSignalRef=WLCFailSts_oWLC_01_oNIO_ES6_RF_CAN_SR_V3_0_882ea33c_Tx, ComIPduSignalRef=WLCMuteViaHW_oWLC_01_oNIO_ES6_RF_CAN_SR_V3_0_990775ce_Tx, ComIPduSignalRef=WLC_01_CRC_oWLC_01_oNIO_ES6_RF_CAN_SR_V3_0_705754f3_Tx, ComIPduSignalRef=WLC_01_MsgCntr_oWLC_01_oNIO_ES6_RF_CAN_SR_V3_0_c3fc8f8f_Tx, ComPduIdRef=EcucPduCollection/WLC_01_oNIO_ES6_RF_CAN_SR_V3_0_0b9d3d12_Tx
          ComTxIPdu: ComMinimumDelayTime=0, ComTxIPduUnusedAreasDefault=0
            ComTxModeFalse
              ComTxMode: ComTxModeMode=PERIODIC, ComTxModeTimeOffset=0, ComTxModeTimePeriod=1
            ComTxModeTrue
              ComTxMode: ComTxModeMode=PERIODIC, ComTxModeTimeOffset=0, ComTxModeTimePeriod=1
        WLC_02_oNIO_ES6_RF_CAN_SR_V3_0_3e708b41_Tx: ComIPduDirection=SEND, ComIPduGroupRef=WLC_oNIO_ES6_RF_CAN_SR_V3_0_Tx_146bcd74, ComIPduSignalRef=WLCImobSts_oWLC_02_oNIO_ES6_RF_CAN_SR_V3_0_77a54935_Tx, ComIPduSignalRef=WLC_02_CRC_oWLC_02_oNIO_ES6_RF_CAN_SR_V3_0_1fdbddc0_Tx, ComIPduSignalRef=WLC_02_MsgCntr_oWLC_02_oNIO_ES6_RF_CAN_SR_V3_0_15588e7e_Tx, ComPduIdRef=EcucPduCollection/WLC_02_oNIO_ES6_RF_CAN_SR_V3_0_3e708b41_Tx
          ComTxIPdu: ComMinimumDelayTime=0, ComTxIPduUnusedAreasDefault=0
            ComTxModeFalse
              ComTxMode: ComTxModeMode=PERIODIC, ComTxModeTimeOffset=0, ComTxModeTimePeriod=0.1
            ComTxModeTrue
              ComTxMode: ComTxModeMode=PERIODIC, ComTxModeTimeOffset=0, ComTxModeTimePeriod=0.1
      WLC_oNIO_ES6_RF_CAN_SR_V3_0_Rx_42316af2 (ComIPduGroup)
      WLC_oNIO_ES6_RF_CAN_SR_V3_0_Tx_146bcd74 (ComIPduGroup)
      34 x ComSignal, all with ComSignalEndianness=BIG_ENDIAN, ComSignalInitValue=0:
        CGW_03_CRC_oCGW_03_oNIO_ES6_RF_CAN_SR_V3_0_bd877a03_Rx: ComBitPosition=7, ComBitSize=8, ComSignalType=UINT8, ComTimeout=0.15, ComSystemTemplateSystemSignalRef=CGW_03_CRC
        CGW_03_MsgCntr_oCGW_03_oNIO_ES6_RF_CAN_SR_V3_0_3e603ff9_Rx: ComBitPosition=15, ComBitSize=4, ComSignalType=UINT8, ComTimeout=0.15, ComSystemTemplateSystemSignalRef=CGW_03_MsgCntr
        CGW_WLC_CRC_oCGW_WLC_oNIO_ES6_RF_CAN_SR_V3_0_67a87047_Rx: ComBitPosition=7, ComBitSize=8, ComSignalType=UINT8, ComTimeout=5, ComSystemTemplateSystemSignalRef=CGW_WLC_CRC
        CGW_WLC_MsgCntr_oCGW_WLC_oNIO_ES6_RF_CAN_SR_V3_0_2e39b55e_Rx: ComBitPosition=15, ComBitSize=4, ComSignalType=UINT8, ComTimeout=5, ComSystemTemplateSystemSignalRef=CGW_WLC_MsgCntr
        ComfEna_ASIL_oCGW_03_oNIO_ES6_RF_CAN_SR_V3_0_daac19b6_Rx: ComBitPosition=17, ComBitSize=2, ComSignalType=UINT8, ComTimeout=0.15, ComSystemTemplateSystemSignalRef=ComfEna_ASIL
        ComfEna_oCGW_02_oNIO_ES6_RF_CAN_SR_V3_0_1a60ba8c_Rx: ComBitPosition=3, ComBitSize=2, ComSignalType=UINT8, ComTimeout=0.15, ComSystemTemplateSystemSignalRef=ComfEna
        Day_oCGW_TCU_01_oNIO_ES6_RF_CAN_SR_V3_0_76626f65_Rx: ComBitPosition=20, ComBitSize=5, ComSignalType=UINT8, ComTimeout=5, ComSystemTemplateSystemSignalRef=Day
        Hr_oCGW_TCU_01_oNIO_ES6_RF_CAN_SR_V3_0_f5c3e99f_Rx: ComBitPosition=28, ComBitSize=5, ComSignalType=UINT8, ComTimeout=5, ComSystemTemplateSystemSignalRef=Hr
        ImobEnaReq_oCGW_02_oNIO_ES6_RF_CAN_SR_V3_0_a2f30745_Rx: ComBitPosition=15, ComBitSize=2, ComSignalType=UINT8, ComTimeout=0.15, ComSystemTemplateSystemSignalRef=ImobEnaReq
        Min_oCGW_TCU_01_oNIO_ES6_RF_CAN_SR_V3_0_c05ffcb3_Rx: ComBitPosition=37, ComBitSize=6, ComSignalType=UINT8, ComTimeout=5, ComSystemTemplateSystemSignalRef=Min
        Mth_oCGW_TCU_01_oNIO_ES6_RF_CAN_SR_V3_0_a0768b21_Rx: ComBitPosition=11, ComBitSize=4, ComSignalType=UINT8, ComTimeout=5, ComSystemTemplateSystemSignalRef=Mth
        Sec_oCGW_TCU_01_oNIO_ES6_RF_CAN_SR_V3_0_48a1d09a_Rx: ComBitPosition=45, ComBitSize=6, ComSignalType=UINT8, ComTimeout=5, ComSystemTemplateSystemSignalRef=Sec
        UsrData0_WLC_oNM_WLC_oNIO_ES6_RF_CAN_SR_V3_0_9b82ce18_Tx: ComBitPosition=7, ComBitSize=8, ComSignalType=UINT8, ComTransferProperty=PENDING, ComSystemTemplateSystemSignalRef=UsrData0_WLC
        UsrData1_WLC_oNM_WLC_oNIO_ES6_RF_CAN_SR_V3_0_1b72d907_Tx: ComBitPosition=15, ComBitSize=8, ComSignalType=UINT8, ComTransferProperty=PENDING, ComSystemTemplateSystemSignalRef=UsrData1_WLC
        UsrData2_WLC_oNM_WLC_oNIO_ES6_RF_CAN_SR_V3_0_4113e667_Tx: ComBitPosition=23, ComBitSize=8, ComSignalType=UINT8, ComTransferProperty=PENDING, ComSystemTemplateSystemSignalRef=UsrData2_WLC
        UsrData3_WLC_oNM_WLC_oNIO_ES6_RF_CAN_SR_V3_0_c1e3f178_Tx: ComBitPosition=31, ComBitSize=8, ComSignalType=UINT8, ComTransferProperty=PENDING, ComSystemTemplateSystemSignalRef=UsrData3_WLC
        UsrData4_WLC_oNM_WLC_oNIO_ES6_RF_CAN_SR_V3_0_f5d198a7_Tx: ComBitPosition=39, ComBitSize=8, ComSignalType=UINT8, ComTransferProperty=PENDING, ComSystemTemplateSystemSignalRef=UsrData4_WLC
        UsrData5_WLC_oNM_WLC_oNIO_ES6_RF_CAN_SR_V3_0_75218fb8_Tx: ComBitPosition=47, ComBitSize=8, ComSignalType=UINT8, ComTransferProperty=PENDING, ComSystemTemplateSystemSignalRef=UsrData5_WLC
        VehOdometer_oCDC_IC_01_oNIO_ES6_RF_CAN_SR_V3_0_c4f897da_Rx: ComBitPosition=7, ComBitSize=24, ComSignalType=UINT32, ComTimeout=5, ComSystemTemplateSystemSignalRef=VehOdometer
        VehSpd_oBCU_04_oNIO_ES6_RF_CAN_SR_V3_0_91cf0813_Rx: ComBitPosition=20, ComBitSize=13, ComSignalType=UINT16, ComTimeout=0.15, ComSystemTemplateSystemSignalRef=VehSpd
        VehState_ASIL_oCGW_03_oNIO_ES6_RF_CAN_SR_V3_0_3e049202_Rx: ComBitPosition=11, ComBitSize=4, ComSignalType=UINT8, ComTimeout=0.15, ComSystemTemplateSystemSignalRef=VehState_ASIL
        VehState_oCGW_02_oNIO_ES6_RF_CAN_SR_V3_0_70d412f9_Rx: ComBitPosition=7, ComBitSize=4, ComSignalType=UINT8, ComTimeout=0.15, ComSystemTemplateSystemSignalRef=VehState
        WLCChrgFctEnaReq_oCDC_WLC_oNIO_ES6_RF_CAN_SR_V3_0_e37de241_Rx: ComBitPosition=1, ComBitSize=2, ComSignalType=UINT8, ComTimeout=0.5, ComSystemTemplateSystemSignalRef=WLCChrgFctEnaReq
        WLCChrgRate_oWLC_01_oNIO_ES6_RF_CAN_SR_V3_0_b69382aa_Tx: ComBitPosition=9, ComBitSize=2, ComSignalType=UINT8, ComTimeout=0, ComTransferProperty=PENDING, ComSystemTemplateSystemSignalRef=WLCChrgRate
        WLCChrgSts_oWLC_01_oNIO_ES6_RF_CAN_SR_V3_0_eda08377_Tx: ComBitPosition=19, ComBitSize=2, ComSignalType=UINT8, ComTimeout=0, ComTransferProperty=PENDING, ComSystemTemplateSystemSignalRef=WLCChrgSts
        WLCCtrlSts_oWLC_01_oNIO_ES6_RF_CAN_SR_V3_0_a083bd17_Tx: ComBitPosition=17, ComBitSize=2, ComSignalType=UINT8, ComTimeout=0, ComTransferProperty=PENDING, ComSystemTemplateSystemSignalRef=WLCCtrlSts
        WLCFailSts_oWLC_01_oNIO_ES6_RF_CAN_SR_V3_0_882ea33c_Tx: ComBitPosition=23, ComBitSize=4, ComSignalType=UINT8, ComTimeout=0, ComTransferProperty=PENDING, ComSystemTemplateSystemSignalRef=WLCFailSts
        WLCImobSts_oWLC_02_oNIO_ES6_RF_CAN_SR_V3_0_77a54935_Tx: ComBitPosition=9, ComBitSize=2, ComSignalType=UINT8, ComTimeout=0, ComTransferProperty=PENDING, ComSystemTemplateSystemSignalRef=WLCImobSts
        WLCMuteViaHW_oWLC_01_oNIO_ES6_RF_CAN_SR_V3_0_990775ce_Tx: ComBitPosition=10, ComBitSize=1, ComSignalType=BOOLEAN, ComTimeout=0, ComTransferProperty=PENDING, ComSystemTemplateSystemSignalRef=WLCMuteViaHW
        WLC_01_CRC_oWLC_01_oNIO_ES6_RF_CAN_SR_V3_0_705754f3_Tx: ComBitPosition=7, ComBitSize=8, ComSignalType=UINT8, ComTimeout=0, ComTransferProperty=PENDING, ComSystemTemplateSystemSignalRef=WLC_01_CRC
        WLC_01_MsgCntr_oWLC_01_oNIO_ES6_RF_CAN_SR_V3_0_c3fc8f8f_Tx: ComBitPosition=15, ComBitSize=4, ComSignalType=UINT8, ComTimeout=0, ComTransferProperty=PENDING, ComSystemTemplateSystemSignalRef=WLC_01_MsgCntr
        WLC_02_CRC_oWLC_02_oNIO_ES6_RF_CAN_SR_V3_0_1fdbddc0_Tx: ComBitPosition=7, ComBitSize=8, ComSignalType=UINT8, ComTimeout=0, ComTransferProperty=PENDING, ComSystemTemplateSystemSignalRef=WLC_02_CRC
        WLC_02_MsgCntr_oWLC_02_oNIO_ES6_RF_CAN_SR_V3_0_15588e7e_Tx: ComBitPosition=15, ComBitSize=4, ComSignalType=UINT8, ComTimeout=0, ComTransferProperty=PENDING, ComSystemTemplateSystemSignalRef=WLC_02_MsgCntr
        Yr_oCGW_TCU_01_oNIO_ES6_RF_CAN_SR_V3_0_cdf9e710_Rx: ComBitPosition=7, ComBitSize=8, ComSignalType=UINT8, ComTimeout=5, ComSystemTemplateSystemSignalRef=Yr
    ComGeneral
  module config ComM
    ComMConfigSet: ComMPncEnabled=false
      CN_NIO_ES6_RF_CAN_SR_V3_0_d2612a1f (ComMChannel): ComMBusType=COMM_BUS_TYPE_CAN, ComMChannelId=0
        ComMNetworkManagement: ComMNmVariant=FULL
        CN_NIO_ES6_RF_CAN_SR_V3_0_df82324b (ComMUserPerChannel): ComMUserChannel=CN_NIO_ES6_RF_CAN_SR_V3_0_e01a4c57
      CN_NIO_ES6_RF_CAN_SR_V3_0_e01a4c57 (ComMUser): ComMUserIdentifier=0
    ComMGeneral: ComMPncIdCounting=COMM_PNC_ID_COUNT_FROM_NM_MESSAGE, ComMPncSupport=false
  module config Dcm
    DcmConfigSet  # Diagnostics Data Import
      DcmDsl
        DcmDslProtocol
          DcmDslProtocolRow_29812fbf (DcmDslProtocolRow)
            DcmDslConnection_18c13f27 (DcmDslConnection)
              DcmDslMainConnection
                DIAG_REQ_AllECU_oNIO_ES6_RF_CAN_SR_V3_0_88b0846e_Rx_ec64cedc (DcmDslProtocolRx):
                  DcmDslProtocolRxAddrType = DCM_FUNCTIONAL_TYPE
                  DcmDslProtocolRxPduId = 1
                  DcmDslProtocolRxComMChannelRef = ComMConfigSet/CN_NIO_ES6_RF_CAN_SR_V3_0_d2612a1f
                  DcmDslProtocolRxPduRef = DIAG_REQ_AllECU_oNIO_ES6_RF_CAN_SR_V3_0_88b0846e_Rx
                DIAG_REQ_WLC_oNIO_ES6_RF_CAN_SR_V3_0_499b8fdc_Rx_83001690 (DcmDslProtocolRx):
                  DcmDslProtocolRxAddrType = DCM_PHYSICAL_TYPE
                  DcmDslProtocolRxPduId = 2
                  DcmDslProtocolRxComMChannelRef = ComMConfigSet/CN_NIO_ES6_RF_CAN_SR_V3_0_d2612a1f
                  DcmDslProtocolRxPduRef = DIAG_REQ_WLC_oNIO_ES6_RF_CAN_SR_V3_0_499b8fdc_Rx
                DIAG_RESP_WLC_oNIO_ES6_RF_CAN_SR_V3_0_7db09b81_Tx_237b1533 (DcmDslProtocolTx): DcmDslTxConfirmationPduId=0, DcmDslProtocolTxPduRef=EcucPduCollection/DIAG_RESP_WLC_oNIO_ES6_RF_CAN_SR_V3_0_7db09b81_Tx
      DcmDsp: DcmDspMaxDidToRead=5  # Diagnostics Data Import
        DcmDspSession  # Diagnostics Data Import
          3 x DcmDspSessionRow, all with DcmDspSessionP2ServerMax=0.05, DcmDspSessionP2StarServerMax=5:
            Extended: DcmDspSessionLevel=3, DcmDspSessionForBoot=DCM_NO_BOOT  # Diagnostics Data Import
            Programming: DcmDspSessionLevel=2  # Diagnostics Data Import
            Default: DcmDspSessionLevel=1, DcmDspSessionForBoot=DCM_NO_BOOT  # Diagnostics Data Import
        DcmDspSecurity  # Diagnostics Data Import
          Level_01 (DcmDspSecurityRow):  # Diagnostics Data Import
            DcmDspSecurityDelayTime = 10
            DcmDspSecurityDelayTimeOnBoot = 0
            DcmDspSecurityKeySize = 2
            DcmDspSecurityLevel = 1
            DcmDspSecurityNumAttDelay = 3
            DcmDspSecuritySeedSize = 2
        DcmDspControlDTCSetting: DcmSupportDTCSettingControlOptionRecord=true  # Diagnostics Data Import
        DidInfo_Diag_RWDI_LightOnOffCounter (DcmDspDidInfo)  # Diagnostics Data Import
          DcmDspDidAccess  # Diagnostics Data Import
            DcmDspDidWrite  # Diagnostics Data Import
            DcmDspDidRead  # Diagnostics Data Import
        Diag_RWDI_LightOnOffCounter (DcmDspDid): DcmDspDidIdentifier=4096, DcmDspDidInfoRef=DidInfo_Diag_RWDI_LightOnOffCounter  # Diagnostics Data Import
          LightOnOffCounter_Value (DcmDspDidSignal): DcmDspDidDataPos=0, DcmDspDidDataRef=Diag_RWDI_LightOnOffCounter_LightOnOffCounter_Value  # Diagnostics Data Import
        DataInfo_Diag_RWDI_LightOnOffCounter_LightOnOffCounter_Value (DcmDspDataInfo): DcmDspDataFixedLength=true  # Diagnostics Data Import
        Diag_RWDI_LightOnOffCounter_LightOnOffCounter_Value (DcmDspData): DcmDspDataSize=32, DcmDspDataType=UINT32, DcmDspDataInfoRef=DataInfo_Diag_RWDI_LightOnOffCounter_LightOnOffCounter_Value  # Diagnostics Data Import
      DcmDsd  # Diagnostics Data Import
        DcmDsdServiceTable  # Diagnostics Data Import
          9 x DcmDsdService:
            ControlDtcSetting: DcmDsdSidTabServiceId=133, DcmDsdSidTabSubfuncAvail=true  # Diagnostics Data Import
              Disable (DcmDsdSubService): DcmDsdSubServiceId=2  # Diagnostics Data Import
              Enable (DcmDsdSubService): DcmDsdSubServiceId=1  # Diagnostics Data Import
            TesterPresent: DcmDsdSidTabServiceId=62, DcmDsdSidTabSubfuncAvail=true  # Diagnostics Data Import
              TesterPresent (DcmDsdSubService): DcmDsdSubServiceId=0  # Diagnostics Data Import
            WriteDataById: DcmDsdSidTabServiceId=46, DcmDsdSidTabSubfuncAvail=false  # Diagnostics Data Import
            SecurityAccess: DcmDsdSidTabServiceId=39, DcmDsdSidTabSubfuncAvail=true, DcmDsdSidTabSessionLevelRef=DcmDspSession/Programming, DcmDsdSidTabSessionLevelRef=DcmDspSession/Extended  # Diagnostics Data Import
              Level1_1_Send (DcmDsdSubService): DcmDsdSubServiceId=2, DcmDsdSubServiceSessionLevelRef=DcmDspSession/Programming, DcmDsdSubServiceSessionLevelRef=DcmDspSession/Extended  # Diagnostics Data Import
              Seed_Level1_Request (DcmDsdSubService): DcmDsdSubServiceId=1, DcmDsdSubServiceSessionLevelRef=DcmDspSession/Programming, DcmDsdSubServiceSessionLevelRef=DcmDspSession/Extended  # Diagnostics Data Import
            ReadDataById: DcmDsdSidTabServiceId=34, DcmDsdSidTabSubfuncAvail=false  # Diagnostics Data Import
            ReadDtcInfo: DcmDsdSidTabServiceId=25, DcmDsdSidTabSubfuncAvail=true  # Diagnostics Data Import
              3 x DcmDsdSubService:
                RDTCEDRBDN: DcmDsdSubServiceId=6  # Diagnostics Data Import
                RNODTCBSM: DcmDsdSubServiceId=1  # Diagnostics Data Import
                RDTCBSM: DcmDsdSubServiceId=2  # Diagnostics Data Import
            ClearDiagInfo: DcmDsdSidTabServiceId=20, DcmDsdSidTabSubfuncAvail=false  # Diagnostics Data Import
            EcuReset: DcmDsdSidTabServiceId=17, DcmDsdSidTabSubfuncAvail=true  # Diagnostics Data Import
              Hard (DcmDsdSubService): DcmDsdSubServiceId=1  # Diagnostics Data Import
            DiagSessionControl: DcmDsdSidTabServiceId=16, DcmDsdSidTabSubfuncAvail=true  # Diagnostics Data Import
              3 x DcmDsdSubService:
                Extended: DcmDsdSubServiceId=3  # Diagnostics Data Import
                Programming: DcmDsdSubServiceId=2, DcmDsdSubServiceSessionLevelRef=DcmDspSession/Programming, DcmDsdSubServiceSessionLevelRef=DcmDspSession/Extended  # Diagnostics Data Import
                Default: DcmDsdSubServiceId=1  # Diagnostics Data Import
      DcmGeneral  # Diagnostics Data Import
  module config Dem
    DemGeneral:  # Diagnostics Data Import
      DemAgingCycleCounterProcessing = DEM_PROCESS_AGINGCTR_INTERN
      DemDebounceCounterBasedSupport = true
      DemDtcStatusAvailabilityMask = 121
      DemMaxNumberEventEntryMirror = 0
      DemPTOSupport = false
      DemTypeOfFreezeFrameRecordNumeration = DEM_FF_RECNUM_CALCULATED
      OdometerValue_OdometerValue (DemDataClass):  # Diagnostics Data Import
        DemDataElementDataSize = 4
        DemDataElementDataType = UINT32
        DemDataElementEndianness = LITTLE_ENDIAN
        DemDataElementUsePort = USE_DATA_CLIENT_SERVER_PORT
        DemDataElementStoreNonVolatile = true
      OccurrenceCounter_OccurenceCounter (DemDataClass):  # Diagnostics Data Import
        DemDataElementDataSize = 4
        DemDataElementDataType = UINT32
        DemDataElementEndianness = LITTLE_ENDIAN
        DemDataElementUsePort = USE_DATA_CLIENT_SERVER_PORT
        DemDataElementStoreNonVolatile = true
      IgnitionCycle (DemOperationCycle): DemOperationCycleType=DEM_OPCYC_IGNITION  # Diagnostics Data Import
      OdometerValue (DemExtendedDataRecordClass): DemExtendedDataRecordNumber=2, DemExtendedDataRecordUpdate=DEM_UPDATE_RECORD_NO, DemDataClassRef=OdometerValue_OdometerValue  # Diagnostics Data Import
      OccurrenceCounter (DemExtendedDataRecordClass): DemExtendedDataRecordNumber=1, DemExtendedDataRecordUpdate=DEM_UPDATE_RECORD_NO, DemDataClassRef=OccurrenceCounter_OccurenceCounter  # Diagnostics Data Import
    DemConfigSet  # Diagnostics Data Import
      DTC_0x000002 (DemEventParameter): DemEventKind=DEM_EVENT_KIND_SWC, DemDTCClassRef=DTCClass_DTC_0x000002  # Diagnostics Data Import
        DemEventClass:  # Diagnostics Data Import
          DemAgingAllowed = false
          DemAgingCycleCounterThreshold = 1
          DemEventDestination = DEM_DTC_ORIGIN_PRIMARY_MEMORY
          DemEventPriority = 2
          DemEventSignificance = DEM_EVENT_SIGNIFICANCE_FAULT
          DemAgingCycleRef = IgnitionCycle
          DemOperationCycleRef = IgnitionCycle
          DemDebounceAlgorithmClass  # Diagnostics Data Import
            DemDebounceCounterBased: DemDebounceCounterDecrementStepSize=1, DemDebounceCounterIncrementStepSize=1, DemDebounceCounterJumpDown=false, DemDebounceCounterJumpUp=true  # Diagnostics Data Import
      DTCClass_DTC_0x000002 (DemDTCClass): DemUdsDTC=2  # Diagnostics Data Import
  module config EcuC
    EcucPduCollection: PduIdTypeEnum=UINT8, PduLengthTypeEnum=UINT8
      36 x Pdu:
        BCU_04_oNIO_ES6_RF_CAN_SR_V3_0_aafda74c_Rx: PduLength=8
        BCU_04_oNIO_ES6_RF_CAN_SR_V3_0_b06c3b94_Rx: PduLength=8, SysTPduToFrameMappingRef=BCU_04
        CDC_IC_01_oNIO_ES6_RF_CAN_SR_V3_0_7ab33239_Rx: PduLength=3, SysTPduToFrameMappingRef=CDC_IC_01
        CDC_IC_01_oNIO_ES6_RF_CAN_SR_V3_0_d7bf39a5_Rx: PduLength=3
        CDC_WLC_NFC_oNIO_ES6_RF_CAN_SR_V3_0_01b0c2d6_Rx: PduLength=8, SysTPduToFrameMappingRef=CDC_WLC_NFC
        CDC_WLC_oNIO_ES6_RF_CAN_SR_V3_0_cbd6c32f_Rx: PduLength=1, SysTPduToFrameMappingRef=CDC_WLC
        CDC_WLC_oNIO_ES6_RF_CAN_SR_V3_0_d2878c96_Rx: PduLength=1
        CGW_02_oNIO_ES6_RF_CAN_SR_V3_0_371b1f5e_Rx: PduLength=2, SysTPduToFrameMappingRef=CGW_02
        CGW_02_oNIO_ES6_RF_CAN_SR_V3_0_a943b009_Rx: PduLength=2
        CGW_03_oNIO_ES6_RF_CAN_SR_V3_0_0cc82007_Rx: PduLength=8
        CGW_03_oNIO_ES6_RF_CAN_SR_V3_0_2fb1cd3a_Rx: PduLength=8, SysTPduToFrameMappingRef=CGW_03
        CGW_TCU_01_oNIO_ES6_RF_CAN_SR_V3_0_49a017d3_Rx: PduLength=6
        CGW_TCU_01_oNIO_ES6_RF_CAN_SR_V3_0_9e3e6b3d_Rx: PduLength=6, SysTPduToFrameMappingRef=CGW_TCU_01
        CGW_WLC_oNIO_ES6_RF_CAN_SR_V3_0_4780465a_Rx: PduLength=8
        CGW_WLC_oNIO_ES6_RF_CAN_SR_V3_0_57df1db7_Rx: PduLength=8, SysTPduToFrameMappingRef=CGW_WLC
        DIAG_REQ_AllECU_Tp_oNIO_ES6_RF_CAN_SR_V3_0_3d6a4915_Rx: PduLength=8, SysTPduToFrameMappingRef=DIAG_REQ_AllECU_Tp
        DIAG_REQ_AllECU_oNIO_ES6_RF_CAN_SR_V3_0_5b04e722_Rx: PduLength=7
        DIAG_REQ_AllECU_oNIO_ES6_RF_CAN_SR_V3_0_88b0846e_Rx: PduLength=7
        DIAG_REQ_WLC_Tp_oNIO_ES6_RF_CAN_SR_V3_0_18ec0086_Rx: PduLength=8, SysTPduToFrameMappingRef=DIAG_REQ_WLC_Tp
        DIAG_REQ_WLC_oNIO_ES6_RF_CAN_SR_V3_0_499b8fdc_Rx: PduLength=8
        DIAG_REQ_WLC_oNIO_ES6_RF_CAN_SR_V3_0_af2d88ff_Rx: PduLength=8
        DIAG_RESP_WLC_Tp_oNIO_ES6_RF_CAN_SR_V3_0_8004734c_Tx: PduLength=8, SysTPduToFrameMappingRef=DIAG_RESP_WLC_Tp
        DIAG_RESP_WLC_oNIO_ES6_RF_CAN_SR_V3_0_7db09b81_Tx: PduLength=8
        DIAG_RESP_WLC_oNIO_ES6_RF_CAN_SR_V3_0_ebfde8b0_Tx: PduLength=8
        IMOB_CGW_WLC_oNIO_ES6_RF_CAN_SR_V3_0_da4d0319_Rx: PduLength=8, SysTPduToFrameMappingRef=IMOB_CGW_WLC
        IMOB_WLC_CGW_oNIO_ES6_RF_CAN_SR_V3_0_efb0805f_Tx: PduLength=8, SysTPduToFrameMappingRef=IMOB_WLC_CGW
        NM_WLC_oNIO_ES6_RF_CAN_SR_V3_0_1915286e_Tx: PduLength=8, SysTPduToFrameMappingRef=NM_WLC
        NM_WLC_oNIO_ES6_RF_CAN_SR_V3_0_9357dd65_Tx: PduLength=6
        WLC_01_oNIO_ES6_RF_CAN_SR_V3_0_0b9d3d12_Tx: PduLength=3
        WLC_01_oNIO_ES6_RF_CAN_SR_V3_0_49299080_Tx: PduLength=3, SysTPduToFrameMappingRef=WLC_01
        WLC_02_oNIO_ES6_RF_CAN_SR_V3_0_3e708b41_Tx: PduLength=2
        WLC_02_oNIO_ES6_RF_CAN_SR_V3_0_60d6e62c_Tx: PduLength=2, SysTPduToFrameMappingRef=WLC_02
        WLC_4a7e70e4_Rx: PduLength=8, SysTPduToFrameMappingRef=NM_CGW
        WLC_CDC_NFC_oNIO_ES6_RF_CAN_SR_V3_0_e08c50f2_Tx: PduLength=8, SysTPduToFrameMappingRef=WLC_CDC_NFC
        WLC_DEVLP_01_oNIO_ES6_RF_CAN_SR_V3_0_0423feed_Tx: PduLength=8, SysTPduToFrameMappingRef=WLC_DEVLP_01
        WLC_DEVLP_02_oNIO_ES6_RF_CAN_SR_V3_0_2ddc8841_Rx: PduLength=8, SysTPduToFrameMappingRef=WLC_DEVLP_02
  module config EcuM
    EcuMConfiguration
      EcuMCommonConfiguration
        EcuMDriverInitListOne
        EcuMDriverRestartList
        CN_NIO_ES6_RF_CAN_SR_V3_0_d2612a1f (EcuMWakeupSource): EcuMWakeupSourceId=5, EcuMComMChannelRef=ComMConfigSet/CN_NIO_ES6_RF_CAN_SR_V3_0_d2612a1f
      EcuMFlexConfiguration: EcuMFlexModuleConfigurationRef=CanConfigSet
  module config Nm
    CN_NIO_ES6_RF_CAN_SR_V3_0_d2612a1f (NmChannelConfig): NmComMChannelRef=ComMConfigSet/CN_NIO_ES6_RF_CAN_SR_V3_0_d2612a1f
      NIO_ES6_RF_CAN_SR_V3_0_CAN_40361c2d (NmBusType)
        NmStandardBusNmConfig: NmStandardBusType=NM_BUSNM_CANNM  # NIO_ES6_RF_CAN_SR_V3_0_CAN
    NmGlobalConfig
      NmGlobalFeatures: NmComUserDataSupport=true, NmNodeIdEnabled=true, NmUserDataEnabled=true
      NmGlobalProperties
  module config PduR
    PduRGeneral
    PduRRoutingTables
      PduRRoutingTable
        13 x PduRRoutingPath:
          BCU_04_oNIO_ES6_RF_CAN_SR_V3_0_b06c3b94_Rx
            BCU_04_oNIO_ES6_RF_CAN_SR_V3_0_b06c3b94_Rx_3ec2fcac_Rx (PduRDestPdu): PduRDestPduRef=EcucPduCollection/BCU_04_oNIO_ES6_RF_CAN_SR_V3_0_aafda74c_Rx
            PduRSrcPdu_3ec2fcac (PduRSrcPdu): PduRSrcPduRef=EcucPduCollection/BCU_04_oNIO_ES6_RF_CAN_SR_V3_0_b06c3b94_Rx
          CDC_IC_01_oNIO_ES6_RF_CAN_SR_V3_0_7ab33239_Rx
            CDC_IC_01_oNIO_ES6_RF_CAN_SR_V3_0_7ab33239_Rx_3feaaad3_Rx (PduRDestPdu): PduRDestPduRef=EcucPduCollection/CDC_IC_01_oNIO_ES6_RF_CAN_SR_V3_0_d7bf39a5_Rx
            PduRSrcPdu_3feaaad3 (PduRSrcPdu): PduRSrcPduRef=EcucPduCollection/CDC_IC_01_oNIO_ES6_RF_CAN_SR_V3_0_7ab33239_Rx
          CDC_WLC_oNIO_ES6_RF_CAN_SR_V3_0_cbd6c32f_Rx
            CDC_WLC_oNIO_ES6_RF_CAN_SR_V3_0_cbd6c32f_Rx_8b049bb0_Rx (PduRDestPdu): PduRDestPduRef=EcucPduCollection/CDC_WLC_oNIO_ES6_RF_CAN_SR_V3_0_d2878c96_Rx
            PduRSrcPdu_8b049bb0 (PduRSrcPdu): PduRSrcPduRef=EcucPduCollection/CDC_WLC_oNIO_ES6_RF_CAN_SR_V3_0_cbd6c32f_Rx
          CGW_02_oNIO_ES6_RF_CAN_SR_V3_0_371b1f5e_Rx
            CGW_02_oNIO_ES6_RF_CAN_SR_V3_0_371b1f5e_Rx_f115c878_Rx (PduRDestPdu): PduRDestPduRef=EcucPduCollection/CGW_02_oNIO_ES6_RF_CAN_SR_V3_0_a943b009_Rx
            PduRSrcPdu_f115c878 (PduRSrcPdu): PduRSrcPduRef=EcucPduCollection/CGW_02_oNIO_ES6_RF_CAN_SR_V3_0_371b1f5e_Rx
          CGW_03_oNIO_ES6_RF_CAN_SR_V3_0_2fb1cd3a_Rx
            CGW_03_oNIO_ES6_RF_CAN_SR_V3_0_2fb1cd3a_Rx_8f6b5f25_Rx (PduRDestPdu): PduRDestPduRef=EcucPduCollection/CGW_03_oNIO_ES6_RF_CAN_SR_V3_0_0cc82007_Rx
            PduRSrcPdu_8f6b5f25 (PduRSrcPdu): PduRSrcPduRef=EcucPduCollection/CGW_03_oNIO_ES6_RF_CAN_SR_V3_0_2fb1cd3a_Rx
          CGW_TCU_01_oNIO_ES6_RF_CAN_SR_V3_0_9e3e6b3d_Rx
            CGW_TCU_01_oNIO_ES6_RF_CAN_SR_V3_0_9e3e6b3d_Rx_ece35bb2_Rx (PduRDestPdu): PduRDestPduRef=EcucPduCollection/CGW_TCU_01_oNIO_ES6_RF_CAN_SR_V3_0_49a017d3_Rx
            PduRSrcPdu_ece35bb2 (PduRSrcPdu): PduRSrcPduRef=EcucPduCollection/CGW_TCU_01_oNIO_ES6_RF_CAN_SR_V3_0_9e3e6b3d_Rx
          CGW_WLC_oNIO_ES6_RF_CAN_SR_V3_0_57df1db7_Rx
            CGW_WLC_oNIO_ES6_RF_CAN_SR_V3_0_57df1db7_Rx_8b01a8ad_Rx (PduRDestPdu): PduRDestPduRef=EcucPduCollection/CGW_WLC_oNIO_ES6_RF_CAN_SR_V3_0_4780465a_Rx
            PduRSrcPdu_8b01a8ad (PduRSrcPdu): PduRSrcPduRef=EcucPduCollection/CGW_WLC_oNIO_ES6_RF_CAN_SR_V3_0_57df1db7_Rx
          DIAG_REQ_AllECU_oNIO_ES6_RF_CAN_SR_V3_0_5b04e722_Rx
            DIAG_REQ_AllECU_oNIO_ES6_RF_CAN_SR_V3_0_5b04e722_Rx_392782f6_Rx (PduRDestPdu): PduRDestPduRef=DIAG_REQ_AllECU_oNIO_ES6_RF_CAN_SR_V3_0_88b0846e_Rx
            PduRSrcPdu_392782f6 (PduRSrcPdu): PduRSrcPduRef=EcucPduCollection/DIAG_REQ_AllECU_oNIO_ES6_RF_CAN_SR_V3_0_5b04e722_Rx
          DIAG_REQ_WLC_oNIO_ES6_RF_CAN_SR_V3_0_af2d88ff_Rx
            DIAG_REQ_WLC_oNIO_ES6_RF_CAN_SR_V3_0_af2d88ff_Rx_eddf36be_Rx (PduRDestPdu): PduRDestPduRef=DIAG_REQ_WLC_oNIO_ES6_RF_CAN_SR_V3_0_499b8fdc_Rx
            PduRSrcPdu_eddf36be (PduRSrcPdu): PduRSrcPduRef=EcucPduCollection/DIAG_REQ_WLC_oNIO_ES6_RF_CAN_SR_V3_0_af2d88ff_Rx
          DIAG_RESP_WLC_oNIO_ES6_RF_CAN_SR_V3_0_7db09b81_Tx
            DIAG_RESP_WLC_oNIO_ES6_RF_CAN_SR_V3_0_ebfde8b0_Tx (PduRDestPdu): PduRDestPduRef=EcucPduCollection/DIAG_RESP_WLC_oNIO_ES6_RF_CAN_SR_V3_0_ebfde8b0_Tx
            PduRSrcPdu_cd65fdce (PduRSrcPdu): PduRSrcPduRef=EcucPduCollection/DIAG_RESP_WLC_oNIO_ES6_RF_CAN_SR_V3_0_7db09b81_Tx
          NM_WLC_oNIO_ES6_RF_CAN_SR_V3_0_9357dd65_Tx
            NM_WLC_oNIO_ES6_RF_CAN_SR_V3_0_9357dd65_Tx_9febb8af_Tx (PduRDestPdu): PduRDestPduRef=EcucPduCollection/NM_WLC_oNIO_ES6_RF_CAN_SR_V3_0_9357dd65_Tx
            PduRSrcPdu_9febb8af (PduRSrcPdu): PduRSrcPduRef=EcucPduCollection/NM_WLC_oNIO_ES6_RF_CAN_SR_V3_0_9357dd65_Tx
          WLC_01_oNIO_ES6_RF_CAN_SR_V3_0_0b9d3d12_Tx
            WLC_01_oNIO_ES6_RF_CAN_SR_V3_0_49299080_Tx (PduRDestPdu): PduRDestPduRef=EcucPduCollection/WLC_01_oNIO_ES6_RF_CAN_SR_V3_0_49299080_Tx
            PduRSrcPdu_2f5fea6f (PduRSrcPdu): PduRSrcPduRef=EcucPduCollection/WLC_01_oNIO_ES6_RF_CAN_SR_V3_0_0b9d3d12_Tx
          WLC_02_oNIO_ES6_RF_CAN_SR_V3_0_3e708b41_Tx
            WLC_02_oNIO_ES6_RF_CAN_SR_V3_0_60d6e62c_Tx (PduRDestPdu): PduRDestPduRef=EcucPduCollection/WLC_02_oNIO_ES6_RF_CAN_SR_V3_0_60d6e62c_Tx
            PduRSrcPdu_19a519a0 (PduRSrcPdu): PduRSrcPduRef=EcucPduCollection/WLC_02_oNIO_ES6_RF_CAN_SR_V3_0_3e708b41_Tx
