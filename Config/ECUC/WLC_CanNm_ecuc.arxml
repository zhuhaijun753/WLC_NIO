AUTOSAR XML (schema 4-2-1)
package /ActiveEcuC
  module config CanNm: implementation-config-variant=VARIANT-PRE-COMPILE, module-description=CanNm_Impl
    CanNmGlobalConfig:
      CanNmComUserDataSupport = true
      CanNmPnEiraCalcEnabled = false
      CanNmUserDataEnabled = true
      CanNmBusLoadReductionEnabled = false
      CanNmBusSynchronizationEnabled = false
      CanNmCanIfRangeConfigDLCCheck = false
      CanNmImmediateTxconfEnabled = false
      CanNmNodeDetectionEnabled = false
      CanNmRepeatMsgIndEnabled = false
      CanNmStateChangeIndEnabled = true
      CanNmCoordinatorSyncSupport = false
      CanNmDevErrorDetect = false
      CanNmMainFunctionPeriod = 0.01
      CanNmPassiveModeEnabled = false
      CanNmPduRxIndicationEnabled = false
      CanNmRemoteSleepIndEnabled = false
      CanNmVersionInfoApi = true
      CanNmDisableTxErrReport = false
      CanNmApiOptimization = false
      CanNmRuntimeMeasurementSupport = false
      CanNmSafeBswChecks = false
      NIO_ES6_RF_CAN_SR_V3_0_CAN_40361c2d (CanNmChannelConfig):
        CanNmMsgCycleTime = 0.64
        CanNmMsgReducedTime = 0.001
        CanNmNodeId = 56
        CanNmRepeatMessageTime = 4
        CanNmTimeoutTime = 1
        CanNmUserDataLength = 6
        CanNmWaitBusSleepTime = 0.75
        CanNmBusLoadReductionActive = false
        CanNmCarWakeUpRxEnabled = false
        CanNmImmediateNmTransmissions = 10
        CanNmMsgCycleOffset = 0
        CanNmMsgTimeoutTime = 0.06
        CanNmPduCbvPosition = CANNM_PDU_BYTE_1
        CanNmPduNidPosition = CANNM_PDU_BYTE_0
        CanNmRemoteSleepIndTime = 1
        CanNmActiveWakeupBitEnabled = true
        CanNmNodeIdEnabled = true
        CanNmNodeDetectionEnabled = false
        CanNmRepeatMsgIndEnabled = false
        CanNmImmediateRestartEnabled = false
        CanNmComControlEnabled = true
        CanNmImmediateNmCycleTime = 0.01
        CanNmComMNetworkHandleRef = CN_NIO_ES6_RF_CAN_SR_V3_0_d2612a1f
        NM_WLC_oNIO_ES6_RF_CAN_SR_V3_0_1915286e_Tx (CanNmTxPdu): CanNmTxConfirmationPduId=0, CanNmTxPduRef=NM_WLC_oNIO_ES6_RF_CAN_SR_V3_0_1915286e_Tx
        NM_WLC_oNIO_ES6_RF_CAN_SR_V3_0_fd222ddc (CanNmUserDataTxPdu): CanNmTxUserDataPduId=0, CanNmTxUserDataPduRef=NM_WLC_oNIO_ES6_RF_CAN_SR_V3_0_9357dd65_Tx
        NIO_ES6_RF_CAN_SR_V3_0_CAN_40361c2d_Rx (CanNmRxPdu): CanNmRxPduId=0, CanNmRxPduRef=WLC_4a7e70e4_Rx
      CanNmGeneration: CanNmOutOfBoundsWriteSanitizer=false, CanNmOutOfBoundsReadSanitizer=false, CanNmInterfacesForDeactivatedData=false
